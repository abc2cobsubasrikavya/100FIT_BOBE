ASAP2_VERSION 1 70
/begin PROJECT _3G1_300 "varI04"
/begin HEADER "" VERSION "3G1_300_D_70_00_T02" PROJECT_NO _3G1_300 /end HEADER
/begin MODULE XCP_EPS_ECU "100FIT"
/begin MOD_COMMON "" BYTE_ORDER MSB_LAST ALIGNMENT_BYTE 1 ALIGNMENT_WORD 2 ALIGNMENT_LONG 4 ALIGNMENT_FLOAT32_IEEE 4 ALIGNMENT_FLOAT64_IEEE 8 /end MOD_COMMON
/begin AXIS_PTS UNT_FAC_FSOLL_GEN_XU16 "X-Achse fuer Unterstuetzungsfaktor generatorischer Betrieb abhaengig von Versorgungsspannung - mapped xLowVoltAssRed_UnderVoltageAssistFactorGen_XAU16" 0x6C32 bsw_uBatt_mu16 SSV__UWORD_S 0 U64V 3 0 33 FORMAT "%8.5" DEPOSIT ABSOLUTE SYMBOL_LINK "xLowVoltAssRed_UnderVoltageAssistFactorGen_XAU16" 2 /end AXIS_PTS
/begin AXIS_PTS UNT_FAC_FSOLL_START_XU16 "X-Achse fuer Unterstuetzungsfaktor Wiederstart abhaengig von Versorgungsspannung - mapped xLowVoltAssRed_UnderVoltageAssistFactorReStart_XAU16" 0x6C42 bsw_uBatt_mu16 SSV__UWORD_S 0 U64V 3 0 33 FORMAT "%8.5" DEPOSIT ABSOLUTE SYMBOL_LINK "xLowVoltAssRed_UnderVoltageAssistFactorReStart_XAU16" 2 /end AXIS_PTS
/begin AXIS_PTS UNT_FAC_FSOLL_XU16 "X-Achse fuer Unterstuetzungsfaktor abhaengig von Versorgungsspannung - mapped xLowVoltAssRed_UnderVoltageAssistFactor_XAU16" 0x6C52 bsw_uBatt_mu16 SSV__UWORD_S 0 U64V 4 0 33 FORMAT "%8.5" DEPOSIT ABSOLUTE SYMBOL_LINK "xLowVoltAssRed_UnderVoltageAssistFactor_XAU16" 2 /end AXIS_PTS
/begin AXIS_PTS UNT_FAC_ISOLL_GEN_XU16 "X-Achse fuer Stromfaktor im Generatorbetrieb in Abhaengigkeit der Versorgungsspannung" 0x6C66 bsw_uBatt_mu16 SSV__UWORD_S 0 ENC_M08_l 3 0 33 FORMAT "%8.5" DEPOSIT ABSOLUTE SYMBOL_LINK "xLowVoltAssRed_UnderVoltageCurrentFactorGen_XAU16" 2 /end AXIS_PTS
/begin AXIS_PTS UNT_FAC_ISOLL_GRAD_START_XU16 "X-Achse fuer Stromgradientfaktor Wiederstart abhaengig von Versorgungsspannung - mapped xLowVoltAssRed_UnderVoltageCurrentGradientFactorReStart_XAU16" 0x6C9A bsw_uBatt_mu16 SSV__UWORD_S 0 U64V 3 0 33 FORMAT "%8.5" DEPOSIT ABSOLUTE SYMBOL_LINK "xLowVoltAssRed_UnderVoltageCurrentGradientFactorReStart_XAU16" 2 /end AXIS_PTS
/begin AXIS_PTS UNT_FAC_ISOLL_GRAD_XU16 "X-Achse fuer Stromgradientfaktor abhaengig von Versorgungsspannung - mapped xLowVoltAssRed_UnderVoltageCurrentGradientFactor_XAU16" 0x6CAA bsw_uBatt_mu16 SSV__UWORD_S 0 U64V 4 0 33 FORMAT "%8.5" DEPOSIT ABSOLUTE SYMBOL_LINK "xLowVoltAssRed_UnderVoltageCurrentGradientFactor_XAU16" 2 /end AXIS_PTS
/begin AXIS_PTS UNT_FAC_ISOLL_START_XU16 "X-Achse fuer Stromfaktor Wiederstart abhaengig von Versorgungsspannung - xLowVoltAssRed_UnderVoltageCurrentFactorReStart_XAU16" 0x6C76 bsw_uBatt_mu16 SSV__UWORD_S 0 U64V_H 3 0 33 FORMAT "%8.5" DEPOSIT ABSOLUTE SYMBOL_LINK "xLowVoltAssRed_UnderVoltageCurrentFactorReStart_XAU16" 2 /end AXIS_PTS
/begin AXIS_PTS UNT_FAC_ISOLL_XU16 "X-Achse fuer Stromfaktor abhaengig von Versorgungsspannung - mapped xLowVoltAssRed_UnderVoltageCurrentFactor_XAU16" 0x6C86 bsw_uBatt_mu16 SSV__UWORD_S 0 U64V 4 0 33 FORMAT "%8.5" DEPOSIT ABSOLUTE SYMBOL_LINK "xLowVoltAssRed_UnderVoltageCurrentFactor_XAU16" 2 /end AXIS_PTS
/begin MEASUREMENT asc_fSoll_mi16 " mapped to kBbaAscInI_RackForce_xds16" SWORD FRACK 1 100 -32768 32767 FORMAT "%6.4" ECU_ADDRESS 0xFE9F880E SYMBOL_LINK "kBbaAscInI_RackForce_xds16" 0 /end MEASUREMENT
/begin MEASUREMENT asc_facReduzlku_mu16 "Autosar-Software-Interface actual assist reduction factor - mapped xBbaAscInI_AscAssistRedFactor_xdu16" UWORD RIGHTSH14NP 1 100 0 3.999939 FORMAT "%8.6" ECU_ADDRESS 0xFE9F8BAC SYMBOL_LINK "xBbaAscInI_AscAssistRedFactor_xdu16" 0 /end MEASUREMENT
/begin MEASUREMENT asc_facReduztrq_mu16 "Autosar-Software-Interface actual torsion bar torque reduction factor - mapped xBbaAscInI_AscToBaToRedFactor_xdu16" UWORD RIGHTSH14NP 1 100 0 3.999939 FORMAT "%8.6" ECU_ADDRESS 0xFE9F8BAE SYMBOL_LINK "xBbaAscInI_AscToBaToRedFactor_xdu16" 0 /end MEASUREMENT
/begin MEASUREMENT bas_WakeupCondition_mu8 "Wake up condition and current state of the wake up sources - mapped sHwlI_WakeUpCondition_gde" UBYTE ZU0 1 100 0 255 ECU_ADDRESS 0xFEEA37E0 SYMBOL_LINK "sHwlI_WakeUpCondition_gde" 0 /end MEASUREMENT
/begin MEASUREMENT bas_customercoding1_mu32 "Customer coding1  mapped -yeeVehCustomCod1_xdu32" ULONG ZU0 0 0 0 4294967295 ECU_ADDRESS 0xFE9F86C0 SYMBOL_LINK "yeeVehCustomCod1_xdu32" 0 /end MEASUREMENT
/begin MEASUREMENT bas_customercoding2_mu32 "Customer Coding2 - mapped yCustomerDataSupp_ActivatedAdaptations_xdu32" ULONG ZU0 0 0 0 4294967295 ECU_ADDRESS 0xFE9F8658 SYMBOL_LINK "yCustomerDataSupp_ActivatedAdaptations_xdu32" 0 /end MEASUREMENT
/begin MEASUREMENT bas_sacDsr2Kor_mu8 "Status Information of the DSR with regard to Moment intervention - mapped sDsrI_Dsr2Kor_xdu8" UBYTE ZU0 0 0 0 255 ECU_ADDRESS 0xFE9F8E67 SYMBOL_LINK "sDsrI_Dsr2Kor_xdu8" 0 /end MEASUREMENT
/begin MEASUREMENT bas_sacDsrEnable_mu8 "Freigabestatus DSR - mapped sBbaSacInI_DsrEnable_xdu8" UBYTE ZU0 0 0 0 255 ECU_ADDRESS 0xFE9F8E46 SYMBOL_LINK "sBbaSacInI_DsrEnable_xdu8" 0 /end MEASUREMENT
/begin MEASUREMENT bas_sacHca2Kor_mu8 "Status Information of the HCA with regard to Moment intervention - mapped sHcaI_Hca2Kor_xdu8" UBYTE ZU0 0 0 0 255 ECU_ADDRESS 0xFE9F8EEE SYMBOL_LINK "sHcaI_Hca2Kor_xdu8" 0 /end MEASUREMENT
/begin MEASUREMENT bas_sacHcaEnable_mu8 "Freigabestatus HCA - mapped sBbaSacInI_HcaEnable_xdu8" UBYTE ZU0 0 0 0 255 ECU_ADDRESS 0xFE9F8E4C SYMBOL_LINK "sBbaSacInI_HcaEnable_xdu8" 0 /end MEASUREMENT
/begin MEASUREMENT bas_sacPlaEnable_mu8 "Freigabestatus PWR = PLA + ARA - mapped sBbaSacInI_PwrEnable_xdu8" UBYTE ZU0 0 0 0 255 ECU_ADDRESS 0xFE9F8E4D SYMBOL_LINK "sBbaSacInI_PwrEnable_xdu8" 0 /end MEASUREMENT
/begin MEASUREMENT bas_sacTscEnable_mu8 "Freigabestatus TSC - mapped sBbaSacInI_TscEnableA_xdu8" UBYTE ZU0 0 0 0 255 ECU_ADDRESS 0xFE9F8E53 SYMBOL_LINK "sBbaSacInI_TscEnableA_xdu8" 0 /end MEASUREMENT
/begin MEASUREMENT bas_state4AscDsa_mu8 "Status von SAC an ASC DSA - mapped sBbaSacInI_State4AscDsa_xdu8" UBYTE ZU0 0 0 0 255 ECU_ADDRESS 0xFE9F8E50 SYMBOL_LINK "sBbaSacInI_State4AscDsa_xdu8" 0 /end MEASUREMENT
/begin MEASUREMENT bas_state4AscTsc_mu8 "Status von SAC an ASC TSC - mapped sBbaSacInI_State4AscTsc_xdu8" UBYTE ZU0 0 0 0 255 ECU_ADDRESS 0xFE9F8E51 SYMBOL_LINK "sBbaSacInI_State4AscTsc_xdu8" 0 /end MEASUREMENT
/begin MEASUREMENT basm_ChkHandsOnTrq_mu16 "mapped with mDthrCtrl_CheckHandsOnTorqLim_XDU16" UWORD TBTHIGH 0 0 0.5 12 FORMAT "%4.5" ECU_ADDRESS 0x80CE64 SYMBOL_LINK "mDthrCtrl_CheckHandsOnTorqLim_XDU16" 0 /end MEASUREMENT
/begin MEASUREMENT basm_LimMotTorq_mu32 "mapped with mHwlI_LimitedMotorTorque_gdf32" FLOAT32_IEEE TORQ_REAL 0 0 -12 12 ECU_ADDRESS 0xFEEA2F3C SYMBOL_LINK "mHwlI_LimitedMotorTorque_gdf32" 0 /end MEASUREMENT
/begin MEASUREMENT basm_MaxRotAngForCalib_mu16 "mapped with wRpSync_MaxRotorAngleForCalib_XDU16" UWORD SA 0 0 0 1000 FORMAT "%6.2" ECU_ADDRESS 0x80D3CC SYMBOL_LINK "wRpSync_MaxRotorAngleForCalib_XDU16" 0 /end MEASUREMENT
/begin MEASUREMENT basm_MaxVehicleSpeedGradient_mu8 "mapped with vVehSp_MaxVehicleSpeedGradient_XDU8" UBYTE VFZHIGH 0 0 0 3.984 ECU_ADDRESS 0x80CEF6 SYMBOL_LINK "vVehSp_MaxVehicleSpeedGradient_XDU8" 0 /end MEASUREMENT
/begin MEASUREMENT basm_MotTorqThreshold_mu16 "mapped with mDthrCtrl_MotTorqThresholdEsUds_XDU16" UWORD MMOT 0 0 0 6 ECU_ADDRESS 0x6192 SYMBOL_LINK "mDthrCtrl_MotTorqThresholdEsUds_XDU16" 0 /end MEASUREMENT
/begin MEASUREMENT basm_RackPosDiffMax_mu16 "mapped with lDthrCtrl_RackPosDiffMax_XDU16" UWORD RACKPOS128 0 0 0 100 ECU_ADDRESS 0x6156 SYMBOL_LINK "lDthrCtrl_RackPosDiffMax_XDU16" 0 /end MEASUREMENT
/begin MEASUREMENT basm_RotAngRange4CalibJob_mu16 "mapped wRpSync_RotAngRange4CalibJob_XDU16" UWORD ANGLE_1 0 0 0 16000 ECU_ADDRESS 0x6348 SYMBOL_LINK "wRpSync_RotAngRange4CalibJob_XDU16" 0 /end MEASUREMENT
/begin MEASUREMENT bsw_ILearnSeaLeft_mu16 " - mapped sEndStopI_LearnStatLeft_xdu8" UBYTE ZU0 0 0 0 2 ECU_ADDRESS 0xFE9F8E87 SYMBOL_LINK "sEndStopI_LearnStatLeft_xdu8" 0 /end MEASUREMENT
/begin MEASUREMENT bsw_ILearnSeaRight_mu16 " - mapped sEndStopI_LearnStatRight_xdu8" UBYTE ZU0 0 0 0 2 ECU_ADDRESS 0xFE9F8E88 SYMBOL_LINK "sEndStopI_LearnStatRight_xdu8" 0 /end MEASUREMENT
/begin MEASUREMENT bsw_fSollLimMtl_mi16 "limited motor torque by motortorquelimiter- mapped to mMotTorLimI_ValidatedMotorTorque_xds16" SWORD NM2N_GEARSIGN 0 0 -32844 32844 ECU_ADDRESS 0xFE9F894A SYMBOL_LINK "mMotTorLimI_ValidatedMotorTorque_xds16" 0 /end MEASUREMENT
/begin MEASUREMENT bsw_iBat_mi16 "HW LIB: Batterie Strom ohne Prozessor Strom - mapped iApplI_BatteryCurrent_xds16" SWORD SM_I 1 100 -150 150 ECU_ADDRESS 0xFEE9B09C SYMBOL_LINK "iApplI_BatteryCurrent_xds16" 0 /end MEASUREMENT
/begin MEASUREMENT bsw_iKlemme30_mi16 " - mapped iApplI_BatteryCurrent_xds16" SWORD SM_I 1 100 -150 150 ECU_ADDRESS 0xFEE9B09C SYMBOL_LINK "iApplI_BatteryCurrent_xds16" 0 /end MEASUREMENT
/begin MEASUREMENT bsw_levelAssist_mu8 "Moegliches Unterstuetzungsniveau 0% bis 100 % - mapped xWlcI_ReductionLevel_xdu16" UWORD RSH15 1 100 0 100 ECU_ADDRESS 0xFE9F8C82 SYMBOL_LINK "xWlcI_ReductionLevel_xdu16" 0 /end MEASUREMENT
/begin MEASUREMENT bsw_mskStatusbits01_mu32 "Autosar Statusbitleiste 1 - mapped yBbaAscOut_mskStatusbits01_xdu32" ULONG ZU0 1 100 0 4294967295 ECU_ADDRESS 0xFE9F8638 SYMBOL_LINK "yBbaAscOut_mskStatusbits01_xdu32" 0 /end MEASUREMENT
/begin MEASUREMENT bsw_mskStatusbits02_mu32 "Autosar Statusbitleiste 2 - mapped yBbaAscOut_mskStatusbits02_xdu32" ULONG ZU0 1 100 0 4294967295 ECU_ADDRESS 0xFE9F863C SYMBOL_LINK "yBbaAscOut_mskStatusbits02_xdu32" 0 /end MEASUREMENT
/begin MEASUREMENT bsw_nMotor_mi16 "Gefilterte Rotorgeschwindigkeit - mapped to nApplI_RotorSpeedFilt_xds16" SWORD VROT 1 100 -13000 13000 FORMAT "%6.4" ECU_ADDRESS 0xFE9F89FE SYMBOL_LINK "nApplI_RotorSpeedFilt_xds16" 0 /end MEASUREMENT
/begin MEASUREMENT bsw_nivUnterstuetzungReq_mu16 "This signal is responsible for Current steering assistance demanded by the steering system (quotient of actual engine set point torque / maximum possible engine set point torque. Unterstuetzungsleistung - mapped xWlcI_ReductionLevel_xdu16" UWORD RIGHTSH15NP 0 0 0 1 FORMAT "%8.6" ECU_ADDRESS 0xFE9F8C82 SYMBOL_LINK "xWlcI_ReductionLevel_xdu16" 0 /end MEASUREMENT
/begin MEASUREMENT bsw_phiRitzelInput_mi32 "realer (i-variaber korrigierter) Ritzelwinkel - mapped wRackPoI_PinionAngleReal_xds16" SWORD SA_10 1 100 -1000 1000 ECU_ADDRESS 0xFE9F8B46 SYMBOL_LINK "wRackPoI_PinionAngleReal_xds16" 0 /end MEASUREMENT
/begin MEASUREMENT bsw_phiRitzelMotor_mi16 "Motorlage aus Motorlagesensor - mapped wApplI_RelRotorPosition_xdu16" UWORD ROTPOS 1 100 0 512 ECU_ADDRESS 0xFEE9B0F0 SYMBOL_LINK "wApplI_RelRotorPosition_xdu16" 0 /end MEASUREMENT
/begin MEASUREMENT bsw_phiRitzel_mi32 "Absoluter Lenkwinkel bezogen auf die Zahnstangenposition - mapped wApplI_PinionAngle_xds16" SWORD SA_10 1 100 -1024 1024 ECU_ADDRESS 0xFE9F8B2C SYMBOL_LINK "wApplI_PinionAngle_xds16" 0 /end MEASUREMENT
/begin MEASUREMENT bsw_phvRitzel_mi16 "Lenkwinkelgeschwindigkeit - mapped vApplI_SteeringAngleSpeed_xds16" SWORD SAS_8 1 100 -1500 1500 ECU_ADDRESS 0xFE9F8AB8 SYMBOL_LINK "vApplI_SteeringAngleSpeed_xds16" 0 /end MEASUREMENT
/begin MEASUREMENT bsw_stCanWakeUp_mu8 "Weckereignis des CAN-Tranceivers" UBYTE bsw_stCanWakeUp_mu8.CONVERSIONV 1 100 0 1 FORMAT "%6.2" /begin VIRTUAL bas_WakeupCondition_mu8 /end VIRTUAL /end MEASUREMENT
/begin MEASUREMENT bsw_stFehlerULstg_mu8 "Das Signal darf nur auf 1 gemeldet werden, wenn ein Derating Fehler (egal, ob aufgrund Unterspannungs-, Temperatur-, Lieferantenabhaengiges Derating) aktiv ist und dazu ein FSP abgelegt ist. Mapped to sWlcI_FehlerULstg_xdb" UBYTE ZU0 0 0 0 255 ECU_ADDRESS 0xFE9F8F79 SYMBOL_LINK "sWlcI_FehlerULstg_xdb" 0 /end MEASUREMENT
/begin MEASUREMENT bsw_stFrgBusFehler_mu8 "Eine Information ueber die Freigabe der BUS-Netzwerkdiagnose gemaess Konzern LAH CAN. Mapped to sEpsInI_ReportErrors_gdu8" UBYTE ZU0 0 0 0 255 ECU_ADDRESS 0xFE9F8EC0 SYMBOL_LINK "sEpsInI_ReportErrors_gdu8" 0 /end MEASUREMENT
/begin MEASUREMENT bsw_stIndex_mu8 "Status Indexmarke aktuell erkannt - mapped zRpSync_IdxposLoopCounter_XDU8" UBYTE ANGLE_1 0 0 1 7 ECU_ADDRESS 0x80D3F6 SYMBOL_LINK "zRpSync_IdxposLoopCounter_XDU8" 0 /end MEASUREMENT
/begin MEASUREMENT bsw_stKl15_mu8 "Status IgnitionEnable - mapped sIgniI_IgnitionEnabled_xdu8" UBYTE ZU0 1 100 0 1 ECU_ADDRESS 0xFE9F8EF1 SYMBOL_LINK "sIgniI_IgnitionEnabled_xdu8" 0 /end MEASUREMENT
/begin MEASUREMENT bsw_stLwsQbit_mu8 "Lenkwinkel QBit - mapped sEpsOutI_LWI_QBit_Lenkradwinkel_xdb" UBYTE STATUS 1 100 0 1 FORMAT "%5.3" ECU_ADDRESS 0xFE9F8EC7 SYMBOL_LINK "sEpsOutI_LWI_QBit_Lenkradwinkel_xdb" 0 /end MEASUREMENT
/begin MEASUREMENT bsw_stLws_mu8 "Sensorstatus - mapped sEpsOutI_LWI_Sensorstatus_xdb" UBYTE STATUS 1 100 0 1 FORMAT "%5.3" ECU_ADDRESS 0xFE9F8EC8 SYMBOL_LINK "sEpsOutI_LWI_Sensorstatus_xdb" 0 /end MEASUREMENT
/begin MEASUREMENT bsw_stNMHighReceive_mu8 "Indication that an NM message has been received - mapped to fAssCtrl_NotReceivedNmMessage_xdb" UBYTE ZU0 0 0 0 1 ECU_ADDRESS 0xFE9F8D41 SYMBOL_LINK "fAssCtrl_NotReceivedNmMessage_xdb" 0 /end MEASUREMENT
/begin MEASUREMENT bsw_stPowerUpFinished_mu8 "Status PowerUp abgeschlossen. Z.B. Einschalttests/Ueberpruefung Abschaltpfade - mapped fAsmSuppI_PowerUpFinished_xdu8" UBYTE ZU0 1 100 0 1 ECU_ADDRESS 0xFE9F8D3A SYMBOL_LINK "fAsmSuppI_PowerUpFinished_xdu8" 0 /end MEASUREMENT
/begin MEASUREMENT bsw_stPwstgVoltage_mu8 "Status Endstufe (0 = Endstufe EIN, 1 = Endstufe AUS kurze Zeit, 2 = Endstufe AUS lange Zeit) - mapped sLowVoltAssRedI_OutStageState_xdu8" UBYTE STATUS 0 0 0 2 FORMAT "%5.3" ECU_ADDRESS 0xFE9F8EF9 SYMBOL_LINK "sLowVoltAssRedI_OutStageState_xdu8" 0 /end MEASUREMENT
/begin MEASUREMENT bsw_tZahnstange_mi16 "HW LIB: Gefilterte Temperatur Endstufe (DBC) - mapped cApplI_OutstageTempFilt_xdu8" UBYTE TMPOUTS 1 100 -70 184 ECU_ADDRESS 0xFEE9B105 SYMBOL_LINK "cApplI_OutstageTempFilt_xdu8" 0 /end MEASUREMENT
/begin MEASUREMENT bsw_tempEcu_mi16 "HW LIB: Gefilterte Temperatur Intern (Leiterplatte) - mapped cApplI_InternTempFilt_xdu8" UBYTE TMPOUTS 1 100 -70 184 ECU_ADDRESS 0xFEE9B104 SYMBOL_LINK "cApplI_InternTempFilt_xdu8" 0 /end MEASUREMENT
/begin MEASUREMENT bsw_trqIst_mi16 "Begrenztes Motormoment durch Momentenkoordinator - mapped mApplI_LimitedMotorTorque_xds16" SWORD MMOT 1 100 -8 8 FORMAT "%8.6" ECU_ADDRESS 0xFEE9B0A6 SYMBOL_LINK "mApplI_LimitedMotorTorque_xds16" 0 /end MEASUREMENT
/begin MEASUREMENT bsw_trqSensorKomp_mi16 "Drehstabmoment mit Bandfilter, PT1 gefiltert und Traegheitskompensiert - mapped mSigCondI_CondTorsionBarTorque_xds16" SWORD TBTHIGH 1 100 -25 25 ECU_ADDRESS 0xFE9F89BE SYMBOL_LINK "mSigCondI_CondTorsionBarTorque_xds16" 0 /end MEASUREMENT
/begin MEASUREMENT bsw_trqSensorLku_mi16 "Aufsummiertes Handmomentsignal welches als Grundlage der Berechnung der LKU Kraft dient - mapped matTorsionBarTorque_xds16" SWORD TBTHIGH 1 100 -25 25 ECU_ADDRESS 0xFE9F88C8 SYMBOL_LINK "matTorsionBarTorque_xds16" 0 /end MEASUREMENT
/begin MEASUREMENT bsw_trqSensor_mi16 "HW LIB: Drehstabmoment - mapped mApplI_TorsionBarTorque_xds16" SWORD TBTHIGH 1 100 -25 25 ECU_ADDRESS 0xFEE9B0AC SYMBOL_LINK "mApplI_TorsionBarTorque_xds16" 0 /end MEASUREMENT
/begin MEASUREMENT bsw_trqSoll_mi16 "Angefordertes Motormoment - mapped mApplI_RequestedMotorTorque_xds16" SWORD MMOT 1 100 -12 12 FORMAT "%8.5" ECU_ADDRESS 0xFEE9B0A8 SYMBOL_LINK "mApplI_RequestedMotorTorque_xds16" 0 /end MEASUREMENT
/begin MEASUREMENT bsw_uBatt_mu16 "SupplyVoltage - mapped to uApplI_SupplyVoltage_xdu16" UWORD U64V 1 100 0 33 ECU_ADDRESS 0xFEE9B0E8 SYMBOL_LINK "uApplI_SupplyVoltage_xdu16" 0 /end MEASUREMENT
/begin MEASUREMENT bsw_vZst_mi16 "Zahnstangengeschwindigkeit [mm/s] - mapped vApplI_RackSpeed_xds16" SWORD RACKSPEED128 1 100 -250 250 FORMAT "%8.4" ECU_ADDRESS 0xFE9F8AB6 SYMBOL_LINK "vApplI_RackSpeed_xds16" 0 /end MEASUREMENT
/begin MEASUREMENT bsw_xInertiaPostion_mi32 "Aktuelle Zahnstangenposition im lieferantenspezifischen Koordinatensystem [mm] - mapped lRackPoI_RackPositionRef_xds16" SWORD RACKPOS128 0 0 -200 200 FORMAT "%8.4" ECU_ADDRESS 0xFE9F8888 SYMBOL_LINK "lRackPoI_RackPositionRef_xds16" 0 /end MEASUREMENT
/begin MEASUREMENT bsw_xZstGerKorr_mi32 "Zahnstangenweg Offsetkorrigiert um Lernwert Geradeauslaufkorrektur [mm] - mapped lApplI_RackPositionLtCorr_xds16" SWORD RACKPOS128 0 0 -200 200 FORMAT "%8.4" ECU_ADDRESS 0xFE9F8822 SYMBOL_LINK "lApplI_RackPositionLtCorr_xds16" 0 /end MEASUREMENT
/begin MEASUREMENT bsw_xZst_mi32 "Zahnstangenposition [mm] - mapped lApplI_RackPosition_xds16" SWORD RACKPOS128 0 0 -200 200 FORMAT "%8.4" ECU_ADDRESS 0xFE9F8824 SYMBOL_LINK "lApplI_RackPosition_xds16" 0 /end MEASUREMENT
/begin MEASUREMENT can_AwvQfkSendestatus_mu8 "Zykluszeit AWV_03 BUS Botschaft, 0: Reduzierte aktiv, 1: Schnelle aktiv - mapped sEpsInI_AWV_03_FastCycleTime_gdu8" UBYTE ZU0 0 0 0 1 FORMAT "%5.3" ECU_ADDRESS 0xFE9F8E9B SYMBOL_LINK "sEpsInI_AWV_03_FastCycleTime_gdu8" 0 /end MEASUREMENT
/begin MEASUREMENT can_DsrQfkSendestatus_mu8 "Zykluszeit DSR_01 BUS Botschaft, 0: Reduzierte aktiv, 1: Schnelle aktiv - mapped sEpsInI_DSR_01_FastCycleTime_gdu8" UBYTE ZU0 0 0 0 1 FORMAT "%5.3" ECU_ADDRESS 0xFE9F8E9F SYMBOL_LINK "sEpsInI_DSR_01_FastCycleTime_gdu8" 0 /end MEASUREMENT
/begin MEASUREMENT can_HcaQfkSendestatus_mu8 "Zykluszeit HCA_01 BUS Botschaft, 0: Reduzierte aktiv, 1: Schnelle aktiv - mapped sEpsInI_HCA_03_FastCycleTime_gdu8" UBYTE ZU0 0 0 0 1 FORMAT "%5.3" ECU_ADDRESS 0xFE9F8EA4 SYMBOL_LINK "sEpsInI_HCA_03_FastCycleTime_gdu8" 0 /end MEASUREMENT
/begin MEASUREMENT can_MaQfkSendestatus_mu8 "Zykluszeit MA_01 BUS Botschaft, 0: Reduzierte aktiv, 1: Schnelle aktiv - mapped sEpsInI_MA_01_FastCycleTime_gdu8" UBYTE ZU0 0 0 0 1 FORMAT "%5.3" ECU_ADDRESS 0xFE9F8EA7 SYMBOL_LINK "sEpsInI_MA_01_FastCycleTime_gdu8" 0 /end MEASUREMENT
/begin MEASUREMENT can_PlaQfkSendestatus_mu8 "Zykluszeit PLA_01 BUS Botschaft, 0: Reduzierte aktiv, 1: Schnelle aktiv - mapped sEpsInI_PLA_05_FastCycleTime_gdu8" UBYTE ZU0 0 0 0 1 FORMAT "%5.3" ECU_ADDRESS 0xFE9F8EB9 SYMBOL_LINK "sEpsInI_PLA_05_FastCycleTime_gdu8" 0 /end MEASUREMENT
/begin MEASUREMENT can_StEidGlobal_mu8 "State of sending developement messages - mapped sDevMsg_ActivationState_xdu8" UBYTE ZU0 1 100 0 2 FORMAT "%5.3" ECU_ADDRESS 0xFE9F8E63 SYMBOL_LINK "sDevMsg_ActivationState_xdu8" 0 /end MEASUREMENT
/begin MEASUREMENT can_asmMasterzeit_mu8 "AssSysMon_Masterzeit - mapped zEpsInI_AssSysMon_Masterzeit_xdu8" UBYTE ZEITASM_COM 1 100 0 255 FORMAT "%6.3" ECU_ADDRESS 0xFE9F9027 SYMBOL_LINK "zEpsInI_AssSysMon_Masterzeit_xdu8" 0 /end MEASUREMENT
/begin MEASUREMENT can_beschlLaengs_mi16 "Laengsbeschleunigung - mapped aApplI_LongitudeAcceleration_xds16" SWORD AFZ 1 100 -63 63 ECU_ADDRESS 0xFE9F87DC SYMBOL_LINK "aApplI_LongitudeAcceleration_xds16" 0 /end MEASUREMENT
/begin MEASUREMENT can_beschlQuer_mi16 "Querbeschleunigung - mapped aApplI_LateralAcceleration_xds16" SWORD AFZ 1 100 -63 63 ECU_ADDRESS 0xFE9F87DA SYMBOL_LINK "aApplI_LateralAcceleration_xds16" 0 /end MEASUREMENT
/begin MEASUREMENT can_cntFas01_mu8 "PLA_05 Botschaftszaehler - mapped sEpsInI_PLA_05_MsgCnt_xdu8" UBYTE ZU0 1 100 0 255 ECU_ADDRESS 0xFE9F8EBA SYMBOL_LINK "sEpsInI_PLA_05_MsgCnt_xdu8" 0 /end MEASUREMENT
/begin MEASUREMENT can_cntFas02_mu8 "AWV_03 Botschaftszaehler - mapped sEpsInI_AWV_03_MsgCnt_xdu8" UBYTE ZU0 1 100 0 255 ECU_ADDRESS 0xFE9F8E9C SYMBOL_LINK "sEpsInI_AWV_03_MsgCnt_xdu8" 0 /end MEASUREMENT
/begin MEASUREMENT can_cntFas03_mu8 "HCA_03 Botschaftszaehler - mapped sEpsInI_HCA_03_MsgCnt_xdu8" UBYTE ZU0 1 100 0 255 ECU_ADDRESS 0xFE9F8EA5 SYMBOL_LINK "sEpsInI_HCA_03_MsgCnt_xdu8" 0 /end MEASUREMENT
/begin MEASUREMENT can_cntFas04_mu8 "DSR_01 Botschaftszaehler - mapped sEpsInI_DSR_01_MsgCnt_xdu8" UBYTE ZU0 1 100 0 255 ECU_ADDRESS 0xFE9F8EA0 SYMBOL_LINK "sEpsInI_DSR_01_MsgCnt_xdu8" 0 /end MEASUREMENT
/begin MEASUREMENT can_cntFas05_mu8 "MA_01 Botschaftszaehler - mapped sEpsInI_MA_01_MsgCnt_xdu8" UBYTE ZU0 0 0 0 255 FORMAT "%5.2" ECU_ADDRESS 0xFE9F8EA8 SYMBOL_LINK "sEpsInI_MA_01_MsgCnt_xdu8" 0 /end MEASUREMENT
/begin MEASUREMENT can_facMotMom_mu8 "MO_Faktor_Momente_02 - mapped yEpsInI_MO_Faktor_Momente_02_xdu8" UBYTE ZU0 0 0 1 3 FORMAT "%5.3" ECU_ADDRESS 0xFE9F8FD8 SYMBOL_LINK "yEpsInI_MO_Faktor_Momente_02_xdu8" 0 /end MEASUREMENT
/begin MEASUREMENT can_facSignal1Fas01_mu16 "PLA_QFK_Signal1 - mapped yEpsInI_PLA_QFK_Signal1_xdu16" UWORD RIGHTSH6NP 0 0 0 65534 FORMAT "%6.2" ECU_ADDRESS 0xFE9F8CAC SYMBOL_LINK "yEpsInI_PLA_QFK_Signal1_xdu16" 0 /end MEASUREMENT
/begin MEASUREMENT can_facSignal2Fas01_mu16 "PLA_QFK_Signal2 - mapped yEpsInI_PLA_QFK_Signal2_xdu16" UWORD RIGHTSH6NP 1 100 0 65534 FORMAT "%6.2" ECU_ADDRESS 0xFE9F8CAE SYMBOL_LINK "yEpsInI_PLA_QFK_Signal2_xdu16" 0 /end MEASUREMENT
/begin MEASUREMENT can_facSpuerbFas01_mu16 "PLA_QFK_Spuerb - mapped yEpsInI_PLA_QFK_Spuerb_xdu8" UBYTE SPUERB 1 100 0 100 FORMAT "%5.1" ECU_ADDRESS 0xFE9F8FDF SYMBOL_LINK "yEpsInI_PLA_QFK_Spuerb_xdu8" 0 /end MEASUREMENT
/begin MEASUREMENT can_facStgTqSsty_mu8 "Factor for steering torque sensitivity - mapped xEpsInI_AisFacStgTqSsty_xdu8" UBYTE SPUERB 1 100 0 100 FORMAT "%6.2" ECU_ADDRESS 0xFE9F8F97 SYMBOL_LINK "xEpsInI_AisFacStgTqSsty_xdu8" 0 /end MEASUREMENT
/begin MEASUREMENT can_gierrate_mi16 "Gierrate - mapped vApplI_YawVelocity_xds16" SWORD VGIER 1 100 -511 511 ECU_ADDRESS 0xFE9F8ABA SYMBOL_LINK "vApplI_YawVelocity_xds16" 0 /end MEASUREMENT
/begin MEASUREMENT can_gradUeb_mi8 "EspDegreeOfSteerDiff - mapped xApplI_EspDegreeOfSteerDiff_xds16" SWORD RIGHTSH10NP_MULT100 1 100 -100 100 FORMAT "%8.6" ECU_ADDRESS 0xFE9F8B8E SYMBOL_LINK "xApplI_EspDegreeOfSteerDiff_xds16" 0 /end MEASUREMENT
/begin MEASUREMENT can_idxStgVibPatReq_mu8 "Requested steering vibration pattern index - mapped sEpsInI_AisIdxStgVibPatReq_xdu8" UBYTE ZU0 1 100 0 15 ECU_ADDRESS 0xFE9F8E94 SYMBOL_LINK "sEpsInI_AisIdxStgVibPatReq_xdu8" 0 /end MEASUREMENT
/begin MEASUREMENT can_krSollFas01_mi32 "PLA_QFK_KruemmSoll - mapped yEpsInI_PLA_QFK_KruemmSoll_xds32" SWORD KRUEMMSOLL 1 100 -0.2195389 0.2195389 FORMAT "%8.2" ECU_ADDRESS 0xFE9F86D8 SYMBOL_LINK "yEpsInI_PLA_QFK_KruemmSoll_xds32" 0 /end MEASUREMENT
/begin MEASUREMENT can_krSollFas02_mi32 "AWV_QFK_KruemmSoll - mapped yEpsInI_AWV_QFK_KruemmSoll_xds32" SWORD KRUEMMSOLL 1 100 -0.2195389 0.2195389 FORMAT "%8.2" ECU_ADDRESS 0xFE9F86C8 SYMBOL_LINK "yEpsInI_AWV_QFK_KruemmSoll_xds32" 0 /end MEASUREMENT
/begin MEASUREMENT can_krSollFas03_mi32 "HCA_QFK_KruemmSoll - mapped yEpsInI_HCA_QFK_KruemmSoll_xds32" SWORD KRUEMMSOLL 1 100 -0.2195389 0.2195389 FORMAT "%8.2" ECU_ADDRESS 0xFE9F86D0 SYMBOL_LINK "yEpsInI_HCA_QFK_KruemmSoll_xds32" 0 /end MEASUREMENT
/begin MEASUREMENT can_krSollFas04_mi32 "DSR_QFK_KruemmSoll - mapped yEpsInI_DSR_QFK_KruemmSoll_xds32" SWORD KRUEMMSOLL 1 100 -0.2195389 0.2195389 FORMAT "%8.2" ECU_ADDRESS 0xFE9F86CC SYMBOL_LINK "yEpsInI_DSR_QFK_KruemmSoll_xds32" 0 /end MEASUREMENT
/begin MEASUREMENT can_krSollFas05_mi32 "MA_QFK_KruemmSoll - mapped yEpsInI_MA_QFK_KruemmSoll_xds32" SWORD KRUEMMSOLL 1 100 -0.2195389 0.2195389 FORMAT "%8.2" ECU_ADDRESS 0xFE9F86D4 SYMBOL_LINK "yEpsInI_MA_QFK_KruemmSoll_xds32" 0 /end MEASUREMENT
/begin MEASUREMENT can_levelPedal_mu8 "MO_Fahrpedalrohwert_01 - mapped yEpsInI_MO_Fahrpedalrohwert_01_xdu8" UBYTE SPUERB 1 100 0 101.6 FORMAT "%6.2" ECU_ADDRESS 0xFE9F8FD7 SYMBOL_LINK "yEpsInI_MO_Fahrpedalrohwert_01_xdu8" 0 /end MEASUREMENT
/begin MEASUREMENT can_lh1Warnungen_mu8 "Das Signal kombiniert die Aufforderung an das Kombiinstrument zur Anzeige von Warn- und Fehlerlampen mit Ausgabe von Akustik und Fehler- und Hinweistexten - mapped to sWlcI_EcuWarningLights_xdu8" UBYTE ZU0 1 0 0 5 FORMAT "%.15" ECU_ADDRESS 0xFE9F8F77 SYMBOL_LINK "sWlcI_EcuWarningLights_xdu8" 0 /end MEASUREMENT
/begin MEASUREMENT can_moHybFahrbereit_mu8 "MO_HYB_Fahrbereitschaft - mapped sEpsInI_HybridDriveReady_xdu8" UBYTE ZU0 1 100 0 1 ECU_ADDRESS 0xFE9F8EA6 SYMBOL_LINK "sEpsInI_HybridDriveReady_xdu8" 0 /end MEASUREMENT
/begin MEASUREMENT can_pBrems_mi16 "ESP_Bremsdruck - mapped yEpsInI_ESP_Bremsdruck_xds16" SWORD RIGHTSH4NP 1 100 0 511 ECU_ADDRESS 0xFE9F8C9A SYMBOL_LINK "yEpsInI_ESP_Bremsdruck_xds16" 0 /end MEASUREMENT
/begin MEASUREMENT can_phiPla1_mi16 "PLASollwinkel - mapped wEpsInI_PlaDesiredAngle_xds16" SWORD SA_10 1 100 -8191 8191 ECU_ADDRESS 0xFE9F8B3A SYMBOL_LINK "wEpsInI_PlaDesiredAngle_xds16" 0 /end MEASUREMENT
/begin MEASUREMENT can_posnAisStgRackPosnFr_mi16 "Steering rack position front - mapped lEpsInI_AisStgRackPosnFr_xds16" UBYTE FACT_0039 1 100 0 15 FORMAT "%9.4" ECU_ADDRESS 0xFE9F8884 SYMBOL_LINK "lEpsInI_AisStgRackPosnFr_xds16" 0 /end MEASUREMENT
/begin MEASUREMENT can_rpmMotor_mu16 "Fahrzeug Motor Drehzahl - mapped nEpsInI_EngineSpeed_xdu16" UWORD VROT 1 100 0 16382 FORMAT "%3.0" ECU_ADDRESS 0xFE9F8A0A SYMBOL_LINK "nEpsInI_EngineSpeed_xdu16" 0 /end MEASUREMENT
/begin MEASUREMENT can_signalEid1_mu32 "CAN erste Entwicklungsbotschaft - mapped yDevMsgI_strDevMsgRx1_xdu32" ULONG ZU0 1 100 0 4294967295 ECU_ADDRESS 0xFE9F8668 SYMBOL_LINK "yDevMsgI_strDevMsgRx1_xdu32" 0 /end MEASUREMENT
/begin MEASUREMENT can_signalEid2_mu32 "CAN zweite Entwicklungsbotschaft - mapped yDevMsgI_strDevMsgRx2_xdu32" ULONG ZU0 1 100 0 4294967295 ECU_ADDRESS 0xFE9F866C SYMBOL_LINK "yDevMsgI_strDevMsgRx2_xdu32" 0 /end MEASUREMENT
/begin MEASUREMENT can_stAbsBrems_mu8 "ABS_Bremsung - mapped fEpsInI_ABS_Bremsung_xdb" UBYTE STATUS 0 0 0 1 FORMAT "%5.3" ECU_ADDRESS 0xFE9F8D70 SYMBOL_LINK "fEpsInI_ABS_Bremsung_xdb" 0 /end MEASUREMENT
/begin MEASUREMENT can_stAbsLamp_mu8 "ABS_Lampe - mapped fEpsInI_ABS_Lampe_xdb" UBYTE STATUS 0 0 0 1 FORMAT "%5.3" ECU_ADDRESS 0xFE9F8D71 SYMBOL_LINK "fEpsInI_ABS_Lampe_xdb" 0 /end MEASUREMENT
/begin MEASUREMENT can_stAirbagStellglied_mu8 "AB_Stellgliedtest - mapped fEpsInI_AB_Stellgliedtest_xdb" UWORD STATUS 1 100 0 1 FORMAT "%5.3" BIT_MASK 0x1 ECU_ADDRESS 0xFE9F8D72 SYMBOL_LINK "fEpsInI_AB_Stellgliedtest_xdb" 0 /end MEASUREMENT
/begin MEASUREMENT can_stAnfFas01_mu8 "PLA_QFK_AnfStat - mapped yEpsInI_PLA_QFK_AnfStat_xdu8" UBYTE ZU0 1 100 0 255 FORMAT "%5.1" ECU_ADDRESS 0xFE9F8FDC SYMBOL_LINK "yEpsInI_PLA_QFK_AnfStat_xdu8" 0 /end MEASUREMENT
/begin MEASUREMENT can_stAnfFas02_mu8 "AWV_QFK_AnfStat - mapped yEpsInI_AWV_QFK_AnfStat_xdu8" UBYTE ZU0 1 100 0 255 FORMAT "%5.1" ECU_ADDRESS 0xFE9F8FC5 SYMBOL_LINK "yEpsInI_AWV_QFK_AnfStat_xdu8" 0 /end MEASUREMENT
/begin MEASUREMENT can_stAnfFas03_mu8 "HCA_QFK_AnfStat - mapped yEpsInI_HCA_QFK_AnfStat_xdu8" UBYTE ZU0 1 100 0 255 FORMAT "%5.1" ECU_ADDRESS 0xFE9F8FCF SYMBOL_LINK "yEpsInI_HCA_QFK_AnfStat_xdu8" 0 /end MEASUREMENT
/begin MEASUREMENT can_stAnfFas04_mu8 "DSR_QFK_AnfStat - mapped yEpsInI_DSR_QFK_AnfStat_xdu8" UBYTE ZU0 1 100 0 255 FORMAT "%5.1" ECU_ADDRESS 0xFE9F8FCA SYMBOL_LINK "yEpsInI_DSR_QFK_AnfStat_xdu8" 0 /end MEASUREMENT
/begin MEASUREMENT can_stAnfFas05_mu8 "MA_QFK_AnfStat - mapped yEpsInI_MA_QFK_AnfStat_xdu8" UBYTE ZU0 1 100 0 255 FORMAT "%5.1" ECU_ADDRESS 0xFE9F8FD3 SYMBOL_LINK "yEpsInI_MA_QFK_AnfStat_xdu8" 0 /end MEASUREMENT
/begin MEASUREMENT can_stArt1Fas01_mu8 "PLA_QFK_Art1 - mapped yEpsInI_PLA_QFK_Art1_xdu8" UBYTE ZU0 1 100 0 255 FORMAT "%5.1" ECU_ADDRESS 0xFE9F8FDD SYMBOL_LINK "yEpsInI_PLA_QFK_Art1_xdu8" 0 /end MEASUREMENT
/begin MEASUREMENT can_stArt2Fas01_mu8 "PLA_QFK_Art2 - mapped yEpsInI_PLA_QFK_Art2_xdu8" UBYTE ZU0 1 100 0 255 FORMAT "%5.1" ECU_ADDRESS 0xFE9F8FDE SYMBOL_LINK "yEpsInI_PLA_QFK_Art2_xdu8" 0 /end MEASUREMENT
/begin MEASUREMENT can_stBattAb_mu8 "Batterie ab Bit vom CAN - mapped fEpsInI_BEM_Batt_Ab_xdu8" UBYTE ZU0 1 100 0 255 FORMAT "%5.1" ECU_ADDRESS 0xFE9F8D75 SYMBOL_LINK "fEpsInI_BEM_Batt_Ab_xdu8" 0 /end MEASUREMENT
/begin MEASUREMENT can_stBremsLichtSchalt_mu8 "MO_BLS - mapped sEpsInI_MO_BLS_xdb" UBYTE STATUS 0 0 0 1 FORMAT "%5.3" ECU_ADDRESS 0xFE9F8EAE SYMBOL_LINK "sEpsInI_MO_BLS_xdb" 0 /end MEASUREMENT
/begin MEASUREMENT can_stCanDiag_mu8 " mapped to sEpsInI_NM_State_xdu8" UWORD ZU0 0 0 0 1 ECU_ADDRESS 0xFE9F8EB5 SYMBOL_LINK "sEpsInI_NM_State_xdu8" 0 /end MEASUREMENT
/begin MEASUREMENT can_stDrivingcycle_mu8 "Vehicle_Driving_Cycle - mapped fEpsInI_Vehicle_Driving_Cycle_xdb" UBYTE STATUS 0 0 0 255 FORMAT "%5.3" ECU_ADDRESS 0xFE9F8D80 SYMBOL_LINK "fEpsInI_Vehicle_Driving_Cycle_xdb" 0 /end MEASUREMENT
/begin MEASUREMENT can_stESP14_mu8 "DSR Status - mapped sEpsInI_DsrState_xdu8" UBYTE ZU0 1 100 0 15 ECU_ADDRESS 0xFE9F8E9E SYMBOL_LINK "sEpsInI_DsrState_xdu8" 0 /end MEASUREMENT
/begin MEASUREMENT can_stErrFahrbereitschaft_mu8 "Status Fehler Signal Fahrbereitschaft (0 - kein Fehler, 1 - Fehler)" UBYTE can_stErrFahrbereitschaft_mu8.CONVERSIONV 1 0 0 255 FORMAT "%5.2" /begin VIRTUAL can_stSignale02_mu32 /end VIRTUAL /end MEASUREMENT
/begin MEASUREMENT can_stErrMoKl15Abschaltempfehlung_mu8 "MO_KL15_Abschaltempfehlung - mapped sEpsInI_MO_KL15_Err_Abschaltempfehlung_xdb" UBYTE STATUS 1 100 0 1 FORMAT "%5.3" BIT_MASK 0x1 ECU_ADDRESS 0xFE9F8EB2 SYMBOL_LINK "sEpsInI_MO_KL15_Err_Abschaltempfehlung_xdb" 0 /end MEASUREMENT
/begin MEASUREMENT can_stErrMoStStStatus_mu8 "Motorstartstoppstatus (0 - kein Fehler, 1 - Fehler) - mapped sEpsInI_Err_MoStStState_xdb" UBYTE ZU0 1 100 0 3 ECU_ADDRESS 0xFE9F8EA1 SYMBOL_LINK "sEpsInI_Err_MoStStState_xdb" 0 /end MEASUREMENT
/begin MEASUREMENT can_stErrRpmMotor_mu8 "Signalstatus Verbrennungsmotordrehzahl" UBYTE can_stErrRpmMotor_mu8.CONVERSIONV 1 100 0 255 FORMAT "%6.2" /begin VIRTUAL can_stSignale02_mu32 /end VIRTUAL /end MEASUREMENT
/begin MEASUREMENT can_stEspEingr_mu8 "ESP_Eingriff - mapped fEpsInI_ESP_Eingriff_xdb" UWORD STATUS 1 100 0 1 FORMAT "%5.3" BIT_MASK 0x1 ECU_ADDRESS 0xFE9F8D79 SYMBOL_LINK "fEpsInI_ESP_Eingriff_xdb" 0 /end MEASUREMENT
/begin MEASUREMENT can_stEspLamp_mu8 "ESP_Lampe - fEpsInI_ESP_Lampe_xdb" UBYTE STATUS 0 0 0 1 FORMAT "%5.3" ECU_ADDRESS 0xFE9F8D7A SYMBOL_LINK "fEpsInI_ESP_Lampe_xdb" 0 /end MEASUREMENT
/begin MEASUREMENT can_stEspOffLamp_mu8 "ESP_Off_Lampe - fEpsInI_ESP_Off_Lampe_xdb" UBYTE STATUS 0 0 0 1 FORMAT "%5.3" ECU_ADDRESS 0xFE9F8D7B SYMBOL_LINK "fEpsInI_ESP_Off_Lampe_xdb" 0 /end MEASUREMENT
/begin MEASUREMENT can_stFahrbereit_mu8 " mapped to sEpsInI_HybridDriveReady_xdu8" UWORD ZU0 1 100 0 1 ECU_ADDRESS 0xFE9F8EA6 SYMBOL_LINK "sEpsInI_HybridDriveReady_xdu8" 0 /end MEASUREMENT
/begin MEASUREMENT can_stFahrtrichtungHl_mu8 "FahrtrichtungserkennungRadhintenlinksvorwaerts(1)/rueckwaerts(-1) - mapped xEpsInI_WheelDrvDirRL_xds8" SBYTE ZU0 1 100 -1 1 FORMAT "%5.3" ECU_ADDRESS 0xFE9F8F9A SYMBOL_LINK "xEpsInI_WheelDrvDirRL_xds8" 0 /end MEASUREMENT
/begin MEASUREMENT can_stFahrtrichtungHr_mu8 "FahrtrichtungserkennungRadhintenrechtsvorwaerts(1)/rueckwaerts(-1) - mapped xEpsInI_WheelDrvDirRR_xds8" SBYTE ZU0 1 100 -1 1 FORMAT "%5.3" ECU_ADDRESS 0xFE9F8F9B SYMBOL_LINK "xEpsInI_WheelDrvDirRR_xds8" 0 /end MEASUREMENT
/begin MEASUREMENT can_stFahrtrichtungVl_mu8 "FahrtrichtungserkennungRadvornelinksvorwaerts(1)/rueckwaerts(-1) - mapped xEpsInI_WheelDrvDirFL_xds8" SBYTE ZU0 1 100 -1 1 FORMAT "%5.3" ECU_ADDRESS 0xFE9F8F98 SYMBOL_LINK "xEpsInI_WheelDrvDirFL_xds8" 0 /end MEASUREMENT
/begin MEASUREMENT can_stFahrtrichtungVr_mu8 "FahrtrichtungserkennungRadvornerechtsvorwaerts(1)/rueckwaerts(-1) - mapped xEpsInI_WheelDrvDirFR_xds8" SBYTE ZU0 1 100 -1 1 FORMAT "%5.3" ECU_ADDRESS 0xFE9F8F99 SYMBOL_LINK "xEpsInI_WheelDrvDirFR_xds8" 0 /end MEASUREMENT
/begin MEASUREMENT can_stHCA_mu8 "externerHCAStatus - mapped sEpsInI_HcaState_xdu8" UBYTE ZU0 1 100 0 15 ECU_ADDRESS 0xFE9F8EA3 SYMBOL_LINK "sEpsInI_HcaState_xdu8" 0 /end MEASUREMENT
/begin MEASUREMENT can_stKickDown_mu8 "MO_Kickdown - mapped sEpsInI_MO_Kickdown_xdb" UBYTE STATUS 0 0 0 1 FORMAT "%5.3" ECU_ADDRESS 0xFE9F8EB0 SYMBOL_LINK "sEpsInI_MO_Kickdown_xdb" 0 /end MEASUREMENT
/begin MEASUREMENT can_stKlemme75_mu8 "MotorKL75aktiv - mapped sEpsInI_MoKl75State_xdu8" UBYTE ZU0 1 100 0 1 ECU_ADDRESS 0xFE9F8EAA SYMBOL_LINK "sEpsInI_MoKl75State_xdu8" 0 /end MEASUREMENT
/begin MEASUREMENT can_stLaufleistung_mu32 "OdometerValue - mapped yeeOdometerValue_xdu32" ULONG ZU0 1 100 0 4294967294 ECU_ADDRESS 0xFE9F86B8 SYMBOL_LINK "yeeOdometerValue_xdu32" 0 /end MEASUREMENT
/begin MEASUREMENT can_stLimCtlFReq_mu8 "Status for EPS controller limitation in case of assisted lane change (asymmetric)  - mapped sEpsInI_AisStLimCtlFReq_xdu8" UBYTE ZEITASM_COM 1 100 0 255 FORMAT "%6.3" ECU_ADDRESS 0xFE9F8E97 SYMBOL_LINK "sEpsInI_AisStLimCtlFReq_xdu8" 0 /end MEASUREMENT
/begin MEASUREMENT can_stLvlStgRackPosnFr_mu8 "Level steering rack position front - mapped sEpsInI_AisLvlStgRackPosnFr_xdu8" UBYTE ZU0 1 100 0 15 ECU_ADDRESS 0xFE9F8E95 SYMBOL_LINK "sEpsInI_AisLvlStgRackPosnFr_xdu8" 0 /end MEASUREMENT
/begin MEASUREMENT can_stMoKl15Abschaltempfehlung_mu8 "Mapped to sEpsInI_MO_KL15_Abschaltempfehlung_xdb" UBYTE ZU0 0 0 0 1 FORMAT "%5.3" ECU_ADDRESS 0xFE9F8EB1 SYMBOL_LINK "sEpsInI_MO_KL15_Abschaltempfehlung_xdb" 0 /end MEASUREMENT
/begin MEASUREMENT can_stMoStStStatus_mu8 "Mapped to sEpsInI_MoStStState_xdu8" UBYTE ZU0 0 0 0 1 FORMAT "%5.3" ECU_ADDRESS 0xFE9F8EAD SYMBOL_LINK "sEpsInI_MoStStState_xdu8" 0 /end MEASUREMENT
/begin MEASUREMENT can_stMoStartStopMotorstopp_mu8 "Signal MO_StartStopp_Motorstopp from Fzg Bus - mapped to sEpsInI_MoStStEngineStop_xdu8" UBYTE ZU0 0 0 0 1 ECU_ADDRESS 0xFE9F8EAB SYMBOL_LINK "sEpsInI_MoStStEngineStop_xdu8" 0 /end MEASUREMENT
/begin MEASUREMENT can_stNVEMBordnetzdiagnose_mu8 "Defekte Versorgungsspannung bei >0 - mapped yEpsInI_NVEM_SupplyVoltageDefect_xdu8" UBYTE ZU0 0 0 0 7 FORMAT "%5.3" ECU_ADDRESS 0xFE9F8FDB SYMBOL_LINK "yEpsInI_NVEM_SupplyVoltageDefect_xdu8" 0 /end MEASUREMENT
/begin MEASUREMENT can_stNVEMVorgabeLeistungsstufe_mu8 "Ermittelte Leistungsstufe der Energiequelle - mapped yEpsInI_NVEM_SupplyPowerLevel_xdu8" UBYTE ZU0 1 100 0 255 FORMAT "%5.3" ECU_ADDRESS 0xFE9F8FDA SYMBOL_LINK "yEpsInI_NVEM_SupplyPowerLevel_xdu8" 0 /end MEASUREMENT
/begin MEASUREMENT can_stNetzwDiagFreigGueltig_mu8 "SI_NWDF_gueltig - mapped sEpsInI_SI_NWDF_gueltig_xdb" UBYTE STATUS 0 0 0 1 FORMAT "%5.3" ECU_ADDRESS 0xFE9F8EC2 SYMBOL_LINK "sEpsInI_SI_NWDF_gueltig_xdb" 0 /end MEASUREMENT
/begin MEASUREMENT can_stNetzwerkDiagFreigabe_mu8 "SI_NWDF - mapped sEpsInI_SI_NWDF_xdb" UBYTE STATUS 0 0 0 1 FORMAT "%5.3" ECU_ADDRESS 0xFE9F8EC3 SYMBOL_LINK "sEpsInI_SI_NWDF_xdb" 0 /end MEASUREMENT
/begin MEASUREMENT can_stOru_mu8 "ORU_Status - mapped" UBYTE ZU0 0 0 0 7 FORMAT "%5.3" ECU_ADDRESS 0xFE9F8EB7 SYMBOL_LINK "sEpsInI_ORU_Status_gdu8" 0 /end MEASUREMENT
/begin MEASUREMENT can_stPla1_mu8 "PLAinputStatus - mapped sEpsInI_PlaState_xdu8" UBYTE ZU0 1 100 0 15 ECU_ADDRESS 0xFE9F8EB8 SYMBOL_LINK "sEpsInI_PlaState_xdu8" 0 /end MEASUREMENT
/begin MEASUREMENT can_stRueckfahrlichtAnf_mu8 "Anforderung Rueckfahrlicht: 0 = Licht nicht gefordert, 1 = Licht gefordert - mapped fEpsInI_BCM_ReverseLightReq_xdu8" UBYTE ZU0 1 100 0 1 FORMAT "%5.3" ECU_ADDRESS 0xFE9F8D74 SYMBOL_LINK "fEpsInI_BCM_ReverseLightReq_xdu8" 0 /end MEASUREMENT
/begin MEASUREMENT can_stSetupStgRackPosnFr_mu8 "Setup steering rack position front  - mapped sEpsInI_AisSetupStgRackPosnFr_xdu8" UBYTE ZU0 1 100 0 255 FORMAT "%6.3" ECU_ADDRESS 0xFE9F8E96 SYMBOL_LINK "sEpsInI_AisSetupStgRackPosnFr_xdu8" 0 /end MEASUREMENT
/begin MEASUREMENT can_stSignale01_mu32 "Statusinformation der CAN Signale 1 - mapped yBbaAscOut_canStatusbits01_xdu32" ULONG ZU0 1 100 0 4294967295 ECU_ADDRESS 0xFE9F8630 SYMBOL_LINK "yBbaAscOut_canStatusbits01_xdu32" 0 /end MEASUREMENT
/begin MEASUREMENT can_stSignale02_mu32 "Statusinformation der CAN Signale 2 - mapped yBbaAscOut_canStatusbits02_xdu32" ULONG ZU0 1 100 0 4294967295 ECU_ADDRESS 0xFE9F8634 SYMBOL_LINK "yBbaAscOut_canStatusbits02_xdu32" 0 /end MEASUREMENT
/begin MEASUREMENT can_stStartStoppWiederstart_mu8 "Restart signal start / stop from the CAN  - mapped to sEpsInI_MoStStRestart_xdu8 " UBYTE ZU0 1 100 0 1 ECU_ADDRESS 0xFE9F8EAC SYMBOL_LINK "sEpsInI_MoStStRestart_xdu8" 0 /end MEASUREMENT
/begin MEASUREMENT can_stStgRackPosnFr_mu8 "Status steering rack position front - mapped sEpsInI_AisStStgRackPosnFr_xdu8" UBYTE ZU0 1 100 0 7 ECU_ADDRESS 0xFE9F8E98 SYMBOL_LINK "sEpsInI_AisStStgRackPosnFr_xdu8" 0 /end MEASUREMENT
/begin MEASUREMENT can_stSupDef_mu8 "Defekte Versorgungsspannung wenn" UBYTE can_stSupDef_mu8.CONVERSIONV 1 100 0 1 FORMAT "%5.3" BIT_MASK 0x1 /begin VIRTUAL can_stNVEMBordnetzdiagnose_mu8 /end VIRTUAL /end MEASUREMENT
/begin MEASUREMENT can_stSwKlemme15_mu8 "Status Klemme 15 - mapped sEpsInI_CommBusTml15_xdu8" UBYTE ZU0 1 100 0 1 ECU_ADDRESS 0xFE9F8E9D SYMBOL_LINK "sEpsInI_CommBusTml15_xdu8" 0 /end MEASUREMENT
/begin MEASUREMENT can_stTiIntpPosnCtlFr_mu8 "Interpolation time for position controller front - mapped tEpsInI_AisTiIntpPosnCtlFr_xdu8" UBYTE ZU0 1 100 0 255 FORMAT "%6.3" ECU_ADDRESS 0xFE9F8F82 SYMBOL_LINK "tEpsInI_AisTiIntpPosnCtlFr_xdu8" 0 /end MEASUREMENT
/begin MEASUREMENT can_stVSignalQualifier_mu8 "Qualifizierungssignal fuer das Fahrzeuggeschwindigkeitssignal - mapped sEpsInI_VehicleSpeedQualifier_xdu8" UBYTE ZU0 1 100 0 7 ECU_ADDRESS 0xFE9F8EC5 SYMBOL_LINK "sEpsInI_VehicleSpeedQualifier_xdu8" 0 /end MEASUREMENT
/begin MEASUREMENT can_stWarmupCycle_mu8 "Warm Up Cycle, 0: kein Warm Up Cycle erkannt, 1: Warm Up Cycle - mapped sEpsInI_OBD_Warm_Up_Cycle_xdu8" UBYTE ZU0 0 0 0 7 FORMAT "%5.3" ECU_ADDRESS 0xFE9F8EB6 SYMBOL_LINK "sEpsInI_OBD_Warm_Up_Cycle_xdu8" 0 /end MEASUREMENT
/begin MEASUREMENT can_strDevMsgRx1_mu32 "Eingang Variable CAN Botschaft Teil 1 - mapped yDevMsgI_signalEid1_xdu32" ULONG ZU0 1 100 0 4294967295 ECU_ADDRESS 0xFE9F8660 SYMBOL_LINK "yDevMsgI_signalEid1_xdu32" 0 /end MEASUREMENT
/begin MEASUREMENT can_strDevMsgRx2_mu32 "Eingang Variable CAN Botschaft Teil 2 - mapped yDevMsgI_signalEid2_xdu32" ULONG ZU0 1 100 0 4294967295 ECU_ADDRESS 0xFE9F8664 SYMBOL_LINK "yDevMsgI_signalEid2_xdu32" 0 /end MEASUREMENT
/begin MEASUREMENT can_strFahrzeugIdent_mu32 "Vehicle Identification Number - mapped yEpsInI_VIN_17_xdu8(MSB),yEpsInI_VIN_16_xdu8,yEpsInI_VIN_15_xdu8 and yEpsInI_VIN_14_xdu8(LSB)" ULONG can_strFahrzeugIdent_mu32.CONVERSIONV 1 100 0 4294967295 FORMAT "%6.2"
 /begin VIRTUAL eps_VIN_17_mu8 eps_VIN_16_mu8 eps_VIN_15_mu8 eps_VIN_14_mu8 /end VIRTUAL
/end MEASUREMENT
/begin MEASUREMENT can_tragMo_mi16 "MO_Mom_Traegheit_Summe - mapped yEpsInI_MO_Mom_Traegheit_Summe_xdu16" UWORD MOTOR11 1 100 0 511 FORMAT "%6.2" ECU_ADDRESS 0xFE9F8CAA SYMBOL_LINK "yEpsInI_MO_Mom_Traegheit_Summe_xdu16" 0 /end MEASUREMENT
/begin MEASUREMENT can_trqAllrad_mu8 "ALR_Ist_Proz - mapped yEpsInI_ALR_Ist_Proz_xdu8" UBYTE PEDAL 1 100 0 255 FORMAT "%3.1" ECU_ADDRESS 0xFE9F8FC0 SYMBOL_LINK "yEpsInI_ALR_Ist_Proz_xdu8" 0 /end MEASUREMENT
/begin MEASUREMENT can_trqESP14_mi16 "Angefordertes DSR Offset Moment - mapped mEpsInI_DsrDesiredTorque_xds16" SWORD TBTHIGH 1 100 -16 16 ECU_ADDRESS 0xFE9F890E SYMBOL_LINK "mEpsInI_DsrDesiredTorque_xds16" 0 /end MEASUREMENT
/begin MEASUREMENT can_trqHCAVib_mu8 "HDAWunschvibrationsamplitude - mapped mEpsInI_HdaAmplitude_xdu16" UWORD MMOT 1 100 0 16 FORMAT "%8.6" ECU_ADDRESS 0xFE9F8912 SYMBOL_LINK "mEpsInI_HdaAmplitude_xdu16" 0 /end MEASUREMENT
/begin MEASUREMENT can_trqMoIst_mi16 "MO_Mom_Ist_Summe - mapped yEpsInI_MO_Mom_Ist_Summe_xdu16" UWORD MOTOR11 1 100 -512 511.984375 FORMAT "%6.2" ECU_ADDRESS 0xFE9F8CA4 SYMBOL_LINK "yEpsInI_MO_Mom_Ist_Summe_xdu16" 0 /end MEASUREMENT
/begin MEASUREMENT can_trqMoSchub_mi16 "MO_Mom_Schub - mapped yEpsInI_MO_Mom_Schub_xdu16" UWORD MOTOR11 1 100 -512 511.984375 FORMAT "%6.2" ECU_ADDRESS 0xFE9F8CA6 SYMBOL_LINK "yEpsInI_MO_Mom_Schub_xdu16" 0 /end MEASUREMENT
/begin MEASUREMENT can_trqMoSollRoh_mi16 "MO_Mom_Soll_Roh - mapped yEpsInI_MO_Mom_Soll_Roh_xdu16" UWORD MOTOR11 1 100 -512 511.984375 FORMAT "%6.2" ECU_ADDRESS 0xFE9F8CA8 SYMBOL_LINK "yEpsInI_MO_Mom_Soll_Roh_xdu16" 0 /end MEASUREMENT
/begin MEASUREMENT can_trqOffsetHCA_mi16 "HCAWunschdrehstabmomentoffset - mapped mEpsInI_HcaDesiredTBTOffset_xds16" SWORD TBTHIGH 1 100 -16 16 ECU_ADDRESS 0xFE9F8910 SYMBOL_LINK "mEpsInI_HcaDesiredTBTOffset_xds16" 0 /end MEASUREMENT
/begin MEASUREMENT can_vRadHl_mu16 "Diverse Rad Geschwindigkeit hinten links - mapped vEpsInI_WheelSpeedRLDiv_xds16" SWORD VFZHIGH 1 100 0 491.4844 ECU_ADDRESS 0xFE9F8AD2 SYMBOL_LINK "vEpsInI_WheelSpeedRLDiv_xds16" 0 /end MEASUREMENT
/begin MEASUREMENT can_vRadHr_mu16 "Diverse Rad Geschwindigkeit hinten rechts - mapped vEpsInI_WheelSpeedRRDiv_xds16" SWORD VFZHIGH 1 100 0 491.4844 ECU_ADDRESS 0xFE9F8AD4 SYMBOL_LINK "vEpsInI_WheelSpeedRRDiv_xds16" 0 /end MEASUREMENT
/begin MEASUREMENT can_vRadVl_mu16 "Diverse Rad Geschwindigkeit vorne links - mapped vEpsInI_WheelSpeedFLDiv_xds16" SWORD VFZHIGH 1 100 0 491.4844 ECU_ADDRESS 0xFE9F8ACE SYMBOL_LINK "vEpsInI_WheelSpeedFLDiv_xds16" 0 /end MEASUREMENT
/begin MEASUREMENT can_vRadVr_mu16 "Diverse Rad Geschwindigkeit vorne rechts - mapped vEpsInI_WheelSpeedFRDiv_xds16" SWORD VFZHIGH 1 100 0 491.4844 ECU_ADDRESS 0xFE9F8AD0 SYMBOL_LINK "vEpsInI_WheelSpeedFRDiv_xds16" 0 /end MEASUREMENT
/begin MEASUREMENT can_vSignal_mu16 "Fahrzeug Geschwindigkeit Rohwert - mapped vEpsInI_VehicleSpeedRaw_OEM_xdu16" UWORD VFZHIGH_OEM 1 100 0 655.35 FORMAT "%10.7" ECU_ADDRESS 0xFE9F8ACA SYMBOL_LINK "vEpsInI_VehicleSpeedRaw_OEM_xdu16" 0 /end MEASUREMENT
/begin MEASUREMENT can_vaqIst_mu8 "QUER_Ist_Proz - mapped yEpsInI_QUER_Ist_Proz_xdu8" UBYTE PEDAL 1 100 0 255 FORMAT "%3.1" ECU_ADDRESS 0xFE9F8FE0 SYMBOL_LINK "yEpsInI_QUER_Ist_Proz_xdu8" 0 /end MEASUREMENT
/begin MEASUREMENT can_zielFahrprEps_mu8 "Sport-Umschaltung - mapped yEpsInI_CharismaSelected_xdu8" UBYTE ZU0 1 100 0 15 ECU_ADDRESS 0xFE9F8FC9 SYMBOL_LINK "yEpsInI_CharismaSelected_xdu8" 0 /end MEASUREMENT
/begin MEASUREMENT cha_facAuto_mu16 "Faktor auf Fahrprogramm AUTO - mapped xCharHdlI_FactAuto_xdu16" UWORD RIGHTSH14NP 1 100 0 1 FORMAT "%8.6" ECU_ADDRESS 0xFE9F8BC0 SYMBOL_LINK "xCharHdlI_FactAuto_xdu16" 0 /end MEASUREMENT
/begin MEASUREMENT cha_facDyn_mu16 "Faktor auf Fahrprogramm DYNAMIC - mapped xCharHdlI_FactDyn_xdu16" UWORD RIGHTSH14NP 1 100 0 1 FORMAT "%8.6" ECU_ADDRESS 0xFE9F8BC2 SYMBOL_LINK "xCharHdlI_FactDyn_xdu16" 0 /end MEASUREMENT
/begin MEASUREMENT cha_facEvent_mu16 "Faktor Event - mapped xCharHdlI_FactEvent_xdu16" UWORD RIGHTSH14NP 1 100 0 1 FORMAT "%8.6" ECU_ADDRESS 0xFE9F8BC4 SYMBOL_LINK "xCharHdlI_FactEvent_xdu16" 0 /end MEASUREMENT
/begin MEASUREMENT cha_facKom_mu16 "Faktor auf Fahrprogramm KOMFORT - mapped xCharHdlI_FactKom_xdu16" UWORD RIGHTSH14NP 1 100 0 1 FORMAT "%8.6" ECU_ADDRESS 0xFE9F8BC6 SYMBOL_LINK "xCharHdlI_FactKom_xdu16" 0 /end MEASUREMENT
/begin MEASUREMENT cha_istFprg_mu8 "Ist-Fahrprogramm fuer CAN-Ausgabe - mapped yCharHdl_OemSigActualDriveProg_xdu8" UBYTE ZU0 1 100 0 3 ECU_ADDRESS 0xFE9F8FB3 SYMBOL_LINK "yCharHdl_OemSigActualDriveProg_xdu8" 0 /end MEASUREMENT
/begin MEASUREMENT cha_sollFprg_mu8 "Ausgabe Fahrprogramm das ueber Anpassung ausgewaehlt wurde - mapped yCharHdl_OemSigTargetDriveProg_xdu8" UBYTE ZU0 1 100 1 3 ECU_ADDRESS 0xFE9F8FBA SYMBOL_LINK "yCharHdl_OemSigTargetDriveProg_xdu8" 0 /end MEASUREMENT
/begin MEASUREMENT cha_stIstPrg_mu8 "Charisma Fahrprogramm - Characteristic Handling Check - mapped yCharHdlI_DriveProg_xdu8" UBYTE ZU0 1 100 0 3 ECU_ADDRESS 0xFE9F8FAF SYMBOL_LINK "yCharHdlI_DriveProg_xdu8" 0 /end MEASUREMENT
/begin MEASUREMENT cha_stKompati_mu8 "Kompatibilitaet des Characteristic Handling - mapped yCharHdl_OemSigCompatibility_xdu8" UBYTE ZU0 1 100 0 1 ECU_ADDRESS 0xFE9F8FB6 SYMBOL_LINK "yCharHdl_OemSigCompatibility_xdu8" 0 /end MEASUREMENT
/begin MEASUREMENT cha_stNewState_mu8 "Ausgabe der neu ausgewaehlten Charakteristik - mapped yCharHdl_OemSigNewCharacteristic_xdu8" UBYTE ZU0 1 100 1 3 ECU_ADDRESS 0xFE9F8FB7 SYMBOL_LINK "yCharHdl_OemSigNewCharacteristic_xdu8" 0 /end MEASUREMENT
/begin MEASUREMENT cha_stOldState_mu8 "Ausgabe der aktuell ausgewaehlten Charakteristik - mapped yCharHdl_OemSigActCharacteristic_xdu8" UBYTE ZU0 1 100 1 3 ECU_ADDRESS 0xFE9F8FB2 SYMBOL_LINK "yCharHdl_OemSigActCharacteristic_xdu8" 0 /end MEASUREMENT
/begin MEASUREMENT cha_stRais_mu8 "Codierte Ausgabe des Ueberhoehungsfaktors - mapped yCharHdl_OemSigRais_xdu8" UBYTE ZU0 1 100 0 3 ECU_ADDRESS 0xFE9F8FB8 SYMBOL_LINK "yCharHdl_OemSigRais_xdu8" 0 /end MEASUREMENT
/begin MEASUREMENT cha_stRampDown_mu8 "Ausgabe der Richtung in die gerampt wird - mapped yCharHdl_OemSigRampDown_xdu8" UBYTE ZU0 1 100 0 2 ECU_ADDRESS 0xFE9F8FB9 SYMBOL_LINK "yCharHdl_OemSigRampDown_xdu8" 0 /end MEASUREMENT
/begin MEASUREMENT cha_stSystem_mu8 "Systemstatus Characteristic Handling Check - mapped sCharHdlI_SystemState_xdu8" UBYTE ZU0 1 100 0 2 ECU_ADDRESS 0xFE9F8E59 SYMBOL_LINK "sCharHdlI_SystemState_xdu8" 0 /end MEASUREMENT
/begin MEASUREMENT cha_stTransRun_mu8 "Ausgabe Ueberblenden aktiv - mapped yCharHdl_OemSigTransRun_xdu8" UBYTE ZU0 1 100 0 1 ECU_ADDRESS 0xFE9F8FBB SYMBOL_LINK "yCharHdl_OemSigTransRun_xdu8" 0 /end MEASUREMENT
/begin MEASUREMENT cha_stUmschalt_mu8 "Umschaltstatus - mapped sCharHdl_OemSigStateOfRamp_xdu8" UBYTE ZU0 1 100 0 2 ECU_ADDRESS 0xFE9F8E5A SYMBOL_LINK "sCharHdl_OemSigStateOfRamp_xdu8" 0 /end MEASUREMENT
/begin MEASUREMENT dia_facDiaLku_mu8 "This signal is responsible for controlling steering assistance percentage from 0% to 100 % - mapped to xtcTargetTorqueRedLevel_xau16" UWORD RSH15 1 100 0 100 ECU_ADDRESS 0xFE9F94CC SYMBOL_LINK "xtcTargetTorqueRedLevel_xau16" 12 /end MEASUREMENT
/begin MEASUREMENT dia_mskAnpassung01_mu32 "Currently activated adaptations in the software" ULONG NO_COMPU_METHOD 0 0 0 4294967295 ECU_ADDRESS 0xFE9F8658 SYMBOL_LINK "yCustomerDataSupp_ActivatedAdaptations_xdu32" 0 /end MEASUREMENT
/begin MEASUREMENT dia_mskCodierung01_mu32 "Activated coding values which will be available from next KL15 cycle. If write DID 0600 was not used during this KL15 cycle, these coding values are currently used by the software" ULONG NO_COMPU_METHOD 0 0 0 4294967295 ECU_ADDRESS 0xFE9F86C0 SYMBOL_LINK "yeeVehCustomCod1_xdu32" 0 /end MEASUREMENT
/begin MEASUREMENT dia_mskRoutinen01_mu32 "" UBYTE dia_mskRoutinen01_mu32.Calculation 0 0 0 4294967295
 /begin VIRTUAL rou_stSta_Basic_mu8 rou_stSta_Init_mu8 rou_stSta_mechM_mu8 rou_stSta_Zero_mu8 rou_stSta_SWEA_mu8 rou_stSta_DelVal_mu8 rou_stSta_DelCal_mu8 rou_stSta_DelSWEA_mu8 rou_stSta_DelFac_mu8 /end VIRTUAL
/end MEASUREMENT
/begin MEASUREMENT dia_stAbs_mu8 "Zeigt an  das nur ABS verbaut oder nicht verbaut ist. - mapped sEpsInI_Abs_Status_xdu8" UBYTE ZU0 1 100 0 1 FORMAT "%5.3" ECU_ADDRESS 0xFE9F8E93 SYMBOL_LINK "sEpsInI_Abs_Status_xdu8" 0 /end MEASUREMENT
/begin MEASUREMENT dia_stAnzeige_mu8 "Codierkanal, der eine einfarbige (nur gelb) oder eine zweifarbige (gelb und rot) Ansteuerung der Lampen im Kombi steuert - mapped to sWlcI_EcuWarnLightCodingChannel_xdu8" UBYTE NO_COMPU_METHOD 1 0 0 1 FORMAT "%.15" ECU_ADDRESS 0xFE9F8F78 SYMBOL_LINK "sWlcI_EcuWarnLightCodingChannel_xdu8" 0 /end MEASUREMENT
/begin MEASUREMENT dia_stAufpruefen_mu8 "Zeigt an  ob die SiLa beim Aufstarten geprueft wird" UBYTE dia_stAufpruefen_mu8.CONVERSIONV 1 100 0 255 FORMAT "%13.2" /begin VIRTUAL bas_customercoding1_mu32 /end VIRTUAL /end MEASUREMENT
/begin MEASUREMENT dia_stCommControl_mu8 "Communication Control aktiv - mapped fNlccI_CommControl_xdb" UBYTE ZU0 1 100 0 255 ECU_ADDRESS 0xFE9F8D9C SYMBOL_LINK "fNlccI_CommControl_xdb" 0 /end MEASUREMENT
/begin MEASUREMENT dia_stDiaConditionValid_mu8 "0x0513-Activation_update_programming_without_rest_bus_simulation" UBYTE dia_stDiaConditionValid_mu8.Calculation 0 0 0 255 /begin VIRTUAL dia_mskAnpassung01_mu32 /end VIRTUAL /end MEASUREMENT
/begin MEASUREMENT dia_stDiagCommAktiv_mu8 "Diagnosesitzung aktiv - mapped fNlccI_DiagSession_xdb" UBYTE ZU0 1 100 0 255 ECU_ADDRESS 0xFE9F8D9D SYMBOL_LINK "fNlccI_DiagSession_xdb" 0 /end MEASUREMENT
/begin MEASUREMENT dia_stDiagCondValid_mu8 "detects the boundary condition which is not fullfilled whenever a diagnostic entry occured - mapped fShutPermI_ShutdownPermissionCond_xdu8" UBYTE ZU0 1 100 0 4 ECU_ADDRESS 0xFE9F869C SYMBOL_LINK "yDiagSrv_PreConMngr_DiagCondValid_xdu8" 0 /end MEASUREMENT
/begin MEASUREMENT dia_stEModeAktiv_mu8 "Indicates whether the vehicle is a hybrid vehicle or not a hybrid vehicle. - 5th bit of customer code copy 1" UBYTE dia_stEModeAktiv_mu8.CONVERSIONV 0 0 0 255 FORMAT "%6.2" /begin VIRTUAL bas_customercoding1_mu32 /end VIRTUAL /end MEASUREMENT
/begin MEASUREMENT dia_stEafLern_mu8 "Status des zu verwendenden Endstops (nicht/tlw/fertig gelernt) - mapped sEndStop_EndstopState_xdu8" UBYTE ZU0 1 100 0 1 ECU_ADDRESS 0xFE9F8E8F SYMBOL_LINK "sEndStop_EndstopState_xdu8" 0 /end MEASUREMENT
/begin MEASUREMENT dia_stEafOn_mu8 "SW switch to enable/disable software endstop" UBYTE dia_stEafOn_mu8.CONVERSIONV 0 0 0 1 FORMAT "%6.2" /begin VIRTUAL bas_customercoding2_mu32 /end VIRTUAL /end MEASUREMENT
/begin MEASUREMENT dia_stEntwickCanId_mu8 "0x0902-Activation of Development Messages" UBYTE dia_stEntwickCanId_mu8.Calculation 0 0 0 255 /begin VIRTUAL dia_mskAnpassung01_mu32 /end VIRTUAL /end MEASUREMENT
/begin MEASUREMENT dia_stFpaModus_mu8 "Ausgabe Umschaltmodus - mapped yCharHdl_OemSigCharMode_xdu8" UBYTE ZU0 0 0 0 1 FORMAT "%5.3" ECU_ADDRESS 0xFE9F8FB5 SYMBOL_LINK "yCharHdl_OemSigCharMode_xdu8" 0 /end MEASUREMENT
/begin MEASUREMENT dia_stFrgAktLuStartStop_mu8 "Codierinformation Aktivierung Lenkunterstuetzung aktiv bei Motor Aus ueber StartStopp (0 - deaktiv, 1 - aktiv) - mapped to 19th bit of yeeVehCustomCod1Copy_xdu32 - mapped sCustomerDataSuppI_stAktLuMotStopp_xdu8" UBYTE ZU0 0 0 0 1 FORMAT "%5.3" ECU_ADDRESS 0xFE9F8E5E SYMBOL_LINK "sCustomerDataSuppI_stAktLuMotStopp_xdu8" 0 /end MEASUREMENT
/begin MEASUREMENT dia_stFrgCha_mu8 "Ausgabe Charisma eincodiert - mapped yCharHdl_OemSigCharEnc_xdu8" UBYTE ZU0 0 0 0 1 FORMAT "%5.3" ECU_ADDRESS 0xFE9F8FB4 SYMBOL_LINK "yCharHdl_OemSigCharEnc_xdu8" 0 /end MEASUREMENT
/begin MEASUREMENT dia_stGERLearnAlgo_mu8 "0x2BCA-Straight_running_algorithm" UBYTE dia_stGERLearnAlgo_mu8.Calculation 0 0 0 255 /begin VIRTUAL dia_mskAnpassung01_mu32 /end VIRTUAL /end MEASUREMENT
/begin MEASUREMENT dia_stLkuOn_mu8 "0x0930-Activation_of_steering_assist_without_engine_running" UBYTE dia_stLkuOn_mu8.Calculation 0 0 0 255 /begin VIRTUAL dia_mskAnpassung01_mu32 /end VIRTUAL /end MEASUREMENT
/begin MEASUREMENT dia_stNotlaufCAN_mu8 "Status Versorgungsspannung - mapped uEpsOut_Notlauf_xdu8" UBYTE ZU0 1 100 0 255 FORMAT "%5.3" ECU_ADDRESS 0xFE9F8F93 SYMBOL_LINK "uEpsOut_Notlauf_xdu8" 0 /end MEASUREMENT
/begin MEASUREMENT dia_stQfkAwv_mu8 "0x0C55-Qfk_awv_function" UBYTE dia_stQfkAwv_mu8.Calculation 0 0 0 255 /begin VIRTUAL dia_mskAnpassung01_mu32 /end VIRTUAL /end MEASUREMENT
/begin MEASUREMENT dia_stQfkDsr_mu8 "0x0C57-Qfk_dsr_function" UBYTE dia_stQfkDsr_mu8.Calculation 0 0 0 255 /begin VIRTUAL dia_mskAnpassung01_mu32 /end VIRTUAL /end MEASUREMENT
/begin MEASUREMENT dia_stQfkHca_mu8 "0x0C56-Qfk_hca_function" UBYTE dia_stQfkHca_mu8.Calculation 0 0 0 255 /begin VIRTUAL dia_mskAnpassung01_mu32 /end VIRTUAL /end MEASUREMENT
/begin MEASUREMENT dia_stQfkMa_mu8 "0x031C-Qfk_rhp_function" UBYTE dia_stQfkMa_mu8.Calculation 0 0 0 255 /begin VIRTUAL dia_mskAnpassung01_mu32 /end VIRTUAL /end MEASUREMENT
/begin MEASUREMENT dia_stQfkPla_mu8 "0x0C54-Qfk_pla_function" UBYTE dia_stQfkPla_mu8.Calculation 0 0 0 255 /begin VIRTUAL dia_mskAnpassung01_mu32 /end VIRTUAL /end MEASUREMENT
/begin MEASUREMENT dia_stReasonSpeed_mu8 "Status of Vehicle - mapped sApplI_VehicleRunning_xdu8 and sApplI_VehicleSpeedState_xdu8" UBYTE dia_stReasonSpeed_mu8.CONVERSIONV 0 0 0 1 FORMAT "%6.2" /begin VIRTUAL VehicleRunning_State VehicleSpeed_State /end VIRTUAL /end MEASUREMENT
/begin MEASUREMENT dia_stStartStopRamp_mu8 "Mapped to sCustomerDataSuppI_stStartStopRamp_xdu8" UBYTE ZU0 0 0 0 1 FORMAT "%5.3" ECU_ADDRESS 0xFE9F8E62 SYMBOL_LINK "sCustomerDataSuppI_stStartStopRamp_xdu8" 0 /end MEASUREMENT
/begin MEASUREMENT dia_stSysFehler_mu8 "Schwerwiegender Systemfehler mit Resultat Deaktivierung Lenkunterstuetzung - checked with sApplI_EcuState_xdu8 against tEcuState_Error " UBYTE dia_stSysFehler_mu8.CONVERSIONV 0 0 0 1 FORMAT "%6.2" /begin VIRTUAL ApplI_EcuState_error /end VIRTUAL /end MEASUREMENT
/begin MEASUREMENT dia_stTSCLearnAlgo_mu8 "Adaptation state of TorqueSteerAlgo" UBYTE dia_stTSCLearnAlgo_mu8.Conversion 0 0 0 1 FORMAT "%6.2" /begin VIRTUAL dia_mskAnpassung01_mu32 /end VIRTUAL /end MEASUREMENT
/begin MEASUREMENT dia_stTscAktiv_mu8 "TSC coding status (0-inactive, 1-active)" UBYTE dia_stTscAktiv_mu8.Conversion 0 0 0 1 FORMAT "%6.2" /begin VIRTUAL dia_mskCodierung01_mu32 /end VIRTUAL /end MEASUREMENT
/begin MEASUREMENT dia_stUeberwachungRaddreh_mu8 "SW switch to enable/disable monitoring wheelspeeds" UBYTE dia_stUeberwachungRaddreh_mu8.CONVERSIONV 0 0 0 255 FORMAT "%6.2" /begin VIRTUAL bas_customercoding2_mu32 /end VIRTUAL /end MEASUREMENT
/begin MEASUREMENT dia_stVINResetFactorySettings_mu8 "Factory reset settings - mapped fVehIdI_VINResetFactorySettings_xdu8" UBYTE ZU0 0 0 0 1 ECU_ADDRESS 0xFE9F8DFF SYMBOL_LINK "fVehIdI_VINResetFactorySettings_xdu8" 0 /end MEASUREMENT
/begin MEASUREMENT dia_stXcpSchnittstelle_mu8 "0x031D-Calibration_protocol_xcp" UBYTE dia_stXcpSchnittstelle_mu8.Calculation 0 0 0 255 /begin VIRTUAL dia_mskAnpassung01_mu32 /end VIRTUAL /end MEASUREMENT
/begin MEASUREMENT dia_stZielFahrprEPS_mu8 "0x1920-Steering_support_characteristic_line" ULONG STEERING_CHAR_STATE_NUM 1 100 0 4294967295 BIT_MASK 0x1f ECU_ADDRESS 0xFE9F8658 SYMBOL_LINK "yCustomerDataSupp_ActivatedAdaptations_xdu32" 0 /end MEASUREMENT
/begin MEASUREMENT eaf_fDyn_mi16 "Endanschlag Daempfung fuer Ueberpruefung - mapped mEndStopI_Damping4Check_xds16" SWORD NM2N 1 100 -30000 30000 FORMAT "%8.6" ECU_ADDRESS 0xFE9F88FC SYMBOL_LINK "mEndStopI_Damping4Check_xds16" 0 /end MEASUREMENT
/begin MEASUREMENT eaf_fSoll_mi16 "Endanschlagsmoment - mapped mEndStopI_MotorTorque_xds16" SWORD NM2N 1 100 -30000 30000 FORMAT "%8.5" ECU_ADDRESS 0xFE9F88FE SYMBOL_LINK "mEndStopI_MotorTorque_xds16" 0 /end MEASUREMENT
/begin MEASUREMENT eaf_fStat_mi16 "Endanschlag Federmoment fuer Ueberpruefung - mapped mEndStopI_SpringTorque4Check_xds16" SWORD NM2N 1 100 -30000 30000 FORMAT "%8.5" ECU_ADDRESS 0xFE9F8900 SYMBOL_LINK "mEndStopI_SpringTorque4Check_xds16" 0 /end MEASUREMENT
/begin MEASUREMENT eaf_phiEASoll_mi32 "Position Softwareendschlang inkl. Offset Lenkwinkelkorrektur, dynamischen-, mechanischen-Endanschlag und Hubreduzierung" SWORD MM2HUB 1 100 -1024 1024 FORMAT "%8.4" ECU_ADDRESS 0xFE9F8864 SYMBOL_LINK "lEndStopI_RackPosMaxOem_xds16" 0 /end MEASUREMENT
/begin MEASUREMENT eaf_phiOffsetDynEa_mi32 "Fahrzeuggeschwindigkeitsabhaengiger Offset - mapped lEndStop_VehicleSpeedDepOffset_xdu16" UWORD MM2HUB 1 100 0 1024 ECU_ADDRESS 0xFE9F8882 SYMBOL_LINK "lEndStop_VehicleSpeedDepOffset_xdu16" 0 /end MEASUREMENT
/begin MEASUREMENT eaf_vFzgHystFilt_mi16 "AbsVehicleSpeedFilt nach Hysterese und Filter fuer SWEA - mapped vEndStop_VehSpeedHystFilt_xdu16" UWORD VFZHIGH 1 100 0 500 ECU_ADDRESS 0xFE9F8AC6 SYMBOL_LINK "vEndStop_VehSpeedHystFilt_xdu16" 0 /end MEASUREMENT
/begin MEASUREMENT eaf_vFzgHyst_mi16 "AbsVehicleSpeedFilt nach Hysterese fuer SWEA - mapped vEndStop_VehSpeedHyst_xdu16" UWORD VFZHIGH 1 100 0 500 ECU_ADDRESS 0xFE9F8AC8 SYMBOL_LINK "vEndStop_VehSpeedHyst_xdu16" 0 /end MEASUREMENT
/begin MEASUREMENT eps_VIN_14_mu8 "VIN_14 - mapped yEpsInI_VIN_14_xdu8" UBYTE ZU0 1 100 0 255 ECU_ADDRESS 0xFE9F8FE5 SYMBOL_LINK "yEpsInI_VIN_14_xdu8" 0 /end MEASUREMENT
/begin MEASUREMENT eps_VIN_15_mu8 "VIN_15 - mapped yEpsInI_VIN_15_xdu8" UBYTE ZU0 1 100 0 255 ECU_ADDRESS 0xFE9F8FE6 SYMBOL_LINK "yEpsInI_VIN_15_xdu8" 0 /end MEASUREMENT
/begin MEASUREMENT eps_VIN_16_mu8 "VIN_16 - mapped yEpsInI_VIN_16_xdu8" UBYTE ZU0 1 100 0 255 ECU_ADDRESS 0xFE9F8FE7 SYMBOL_LINK "yEpsInI_VIN_16_xdu8" 0 /end MEASUREMENT
/begin MEASUREMENT eps_VIN_17_mu8 "VIN_17 - mapped yEpsInI_VIN_17_xdu8" UBYTE ZU0 1 100 0 255 ECU_ADDRESS 0xFE9F8FE8 SYMBOL_LINK "yEpsInI_VIN_17_xdu8" 0 /end MEASUREMENT
/begin MEASUREMENT eps_nMotorCond_mu16 "Fahrzeug Motor Drehzahl - mapped nAssCtrl_nMotorCond_xdu16" UWORD VROT 1 100 0 16382 FORMAT "%3.0" ECU_ADDRESS 0xFE9F8A00 SYMBOL_LINK "nAssCtrl_nMotorCond_xdu16" 0 /end MEASUREMENT
/begin MEASUREMENT eps_nivAssistRampeRoh_mu16 "Faktor zur Begrenzung des Motormoments - mapped xApplI_TotalMotTorLim_xdu16" UWORD RIGHTSH15NP 1 100 0 1 FORMAT "%6.4" ECU_ADDRESS 0xFEE9B0F6 SYMBOL_LINK "xApplI_TotalMotTorLim_xdu16" 0 /end MEASUREMENT
/begin MEASUREMENT eps_nivAssistRampe_mu16 "Minimale Rampensteigung fuer die Lenkunterstuetzungn - mapped xAssCtrl_AssistRampMin_xdu16" UWORD RIGHTSH15NP 1 100 0 100 ECU_ADDRESS 0xFE9F8B9E SYMBOL_LINK "xAssCtrl_AssistRampMin_xdu16" 0 /end MEASUREMENT
/begin MEASUREMENT eps_stAktLuMotStopp_mu8 "Mapped to sCustomerDataSuppI_stAktLuMotStopp_xdu8" UBYTE ZU0 0 0 0 1 FORMAT "%5.3" ECU_ADDRESS 0xFE9F8E5E SYMBOL_LINK "sCustomerDataSuppI_stAktLuMotStopp_xdu8" 0 /end MEASUREMENT
/begin MEASUREMENT eps_stAktLuStartStop_mu8 "Fuer EPS-Zustaende aufbereitete Information des StartStop zur Anforderung Lenkunterstuetzung bei Motor AUS - mapped sAssCtrlI_AktLuStartStop_xdu8" UBYTE ZU0 1 100 0 1 ECU_ADDRESS 0xFE9F8E27 SYMBOL_LINK "sAssCtrlI_AktLuStartStop_xdu8" 0 /end MEASUREMENT
/begin MEASUREMENT eps_stAusschaltAssist_mu8 "Status Summe aller OEM ausramp Bedingungen - mapped sAssCtrlI_AusschaltAssist_xdu8" UBYTE ZU0 1 100 0 1 ECU_ADDRESS 0xFE9F8E29 SYMBOL_LINK "sAssCtrlI_AusschaltAssist_xdu8" 0 /end MEASUREMENT
/begin MEASUREMENT eps_stCANFktMsgTransmitSM_mu8 "Aktivierung(1)/Deaktivierung(0) der CAN Kommunikation ueber Zustand der ECU und Communication Control via Diagnoseinterface - mapped to fAssCtrl_CANFktMsgTransmitSM_xdb" UBYTE ZU0 0 0 0 1 ECU_ADDRESS 0xFE9F8D3B SYMBOL_LINK "fAssCtrl_CANFktMsgTransmitSM_xdb" 0 /end MEASUREMENT
/begin MEASUREMENT eps_stCANFktMsgTransmit_mu8 "Aktivierung(1)/Deaktivierung(0) der CAN Kommunikation ueber Zustand der ECU und Communication Control via Diagnoseinterface - mapped to fAssCtrl_CANFktMsgTransmit_xdb" UBYTE ZU0 0 0 0 1 ECU_ADDRESS 0xFE9F8D3C SYMBOL_LINK "fAssCtrl_CANFktMsgTransmit_xdb" 0 /end MEASUREMENT
/begin MEASUREMENT eps_stEinschaltAssist_mu8 "Status Summe aller OEM einramp Bedingungen - mapped sAssCtrlI_EinschaltAssist_xdu8" UBYTE ZU0 1 100 0 1 ECU_ADDRESS 0xFE9F8E2A SYMBOL_LINK "sAssCtrlI_EinschaltAssist_xdu8" 0 /end MEASUREMENT
/begin MEASUREMENT eps_stErrFahrbereitschaft_mu8 " - mapped sAssCtrl_stErrFahrbereitschaft_xdu8" UBYTE ZU0 0 0 0 1 FORMAT "%5.3" ECU_ADDRESS 0xFE9F8E36 SYMBOL_LINK "sAssCtrl_stErrFahrbereitschaft_xdu8" 0 /end MEASUREMENT
/begin MEASUREMENT eps_stErrRpmMotor_mu8 " - mapped sAssCtrl_stErrRpmMotor_xdu8" UBYTE ZU0 0 0 0 1 FORMAT "%5.3" ECU_ADDRESS 0xFE9F8E37 SYMBOL_LINK "sAssCtrl_stErrRpmMotor_xdu8" 0 /end MEASUREMENT
/begin MEASUREMENT eps_stErrStartStoppMStopp_mu8 " - mapped sAssCtrl_stErrStartStoppMStopp_xdu8" UBYTE ZU0 0 0 0 1 FORMAT "%5.3" ECU_ADDRESS 0xFE9F8E38 SYMBOL_LINK "sAssCtrl_stErrStartStoppMStopp_xdu8" 0 /end MEASUREMENT
/begin MEASUREMENT eps_stErrorMode_mu8 "Signal for the internal control of the vehicle speed overrun in the event of vehicle speed failure with active steering assistance. - mapped to sAssCtrl_stVFzgNotlaufAktiv_xdb" UBYTE ZU0 0 0 0 1 ECU_ADDRESS 0xFE9F8E3B SYMBOL_LINK "sAssCtrl_stVFzgNotlaufAktiv_xdb" 0 /end MEASUREMENT
/begin MEASUREMENT eps_stFahrbereitschaftCond_mu8 "NM Signal Fahrbereit - mapped sAssCtrlI_NMaktivFahrbereit_xdu8" UBYTE ZU0 1 100 0 1 ECU_ADDRESS 0xFE9F8E2C SYMBOL_LINK "sAssCtrlI_NMaktivFahrbereit_xdu8" 0 /end MEASUREMENT
/begin MEASUREMENT eps_stFzgTypElektro_mu8 "Mapped to sCustomerDataSuppI_stFzgTypElektro_xdu8" UBYTE ZU0 0 0 0 1 FORMAT "%5.3" ECU_ADDRESS 0xFE9F8E60 SYMBOL_LINK "sCustomerDataSuppI_stFzgTypElektro_xdu8" 0 /end MEASUREMENT
/begin MEASUREMENT eps_stFzgTypVerbrenner_mu8 "Mapped to sCustomerDataSuppI_stFzgTypVerbrenner_xdu8" UBYTE ZU0 0 0 0 1 FORMAT "%5.3" ECU_ADDRESS 0xFE9F8E61 SYMBOL_LINK "sCustomerDataSuppI_stFzgTypVerbrenner_xdu8" 0 /end MEASUREMENT
/begin MEASUREMENT eps_stLuOhneMotor_mu8 "Mapped sCustomerDataSuppI_stAssistON_noengine_xdu8" UBYTE ZU0 0 0 0 1 FORMAT "%5.3" ECU_ADDRESS 0xFE9F8E5F SYMBOL_LINK "sCustomerDataSuppI_stAssistON_noengine_xdu8" 0 /end MEASUREMENT
/begin MEASUREMENT eps_stMoKl15AbschaltempfCond_mu8 "Mapped to sEpsInI_MOKL15OffCond_xdb" UBYTE ZU0 0 0 0 1 FORMAT "%5.3" ECU_ADDRESS 0xFE9F8EA9 SYMBOL_LINK "sEpsInI_MOKL15OffCond_xdb" 0 /end MEASUREMENT
/begin MEASUREMENT eps_stMoStStStatusCond_mu8 "Mapped to sEpsInI_MO_KL15_Abschaltempfehlung_xdb" UBYTE ZU0 0 0 0 1 FORMAT "%5.3" ECU_ADDRESS 0xFE9F8EB1 SYMBOL_LINK "sEpsInI_MO_KL15_Abschaltempfehlung_xdb" 0 /end MEASUREMENT
/begin MEASUREMENT eps_stMoStartStopMotorstoppCond_mu8 "Mapped to sAssCtrlI_stMotorstoppCond_xdu8" UBYTE ZU0 0 0 0 1 FORMAT "%5.3" ECU_ADDRESS 0xFE9F8E2E SYMBOL_LINK "sAssCtrlI_stMotorstoppCond_xdu8" 0 /end MEASUREMENT
/begin MEASUREMENT eps_stMomentFrg_mu8 "EPS-Zustaendev internal control of torque release (deactivated, ramp in, full support, ramp out) mapped to sAssCtrl_eps_stMomentFrg_xdu8" UBYTE ZU0 0 0 0 3 ECU_ADDRESS 0xFE9F8E2F SYMBOL_LINK "sAssCtrl_eps_stMomentFrg_xdu8" 0 /end MEASUREMENT
/begin MEASUREMENT eps_stMotorstoppCond_mu8 "Fuer EPS-Zustaende aufbereitete Information zur MotorStopp Anforderung ueber Bus - mapped sAssCtrlI_stMotorstoppCond_xdu8" UBYTE ZU0 1 100 0 1 ECU_ADDRESS 0xFE9F8E2E SYMBOL_LINK "sAssCtrlI_stMotorstoppCond_xdu8" 0 /end MEASUREMENT
/begin MEASUREMENT eps_stNMHighTransmit_mu8 "mapped to sEpsInI_NM_State_xdu8" UBYTE ZU0 0 0 0 1 ECU_ADDRESS 0xFE9F8EB5 SYMBOL_LINK "sEpsInI_NM_State_xdu8" 0 /end MEASUREMENT
/begin MEASUREMENT eps_stSMMain_mu8 " Kundenspezifischer Ecu State  - mapped sCsrI_CustomerEcuState_xdu8" UBYTE ZU0 1 100 0 255 ECU_ADDRESS 0xFE9F8E5D SYMBOL_LINK "sCsrI_CustomerEcuState_xdu8" 0 /end MEASUREMENT
/begin MEASUREMENT eps_stTimerCutoffWait_mu8 "Status Timer Wartezeit in CutOff mapped to sAssCtrl_IsS29CutOffWaitActive_xdb" UBYTE ZU0 0 0 0 1 ECU_ADDRESS 0xFE9F8E31 SYMBOL_LINK "sAssCtrl_IsS29CutOffWaitActive_xdb" 0 /end MEASUREMENT
/begin MEASUREMENT eps_stTimerNMHighTAktiv_mu8 "State of the timer TimerNMHighTAktiv - mapped to fAssCtrl_NMHighTActive_Expired_xdb" UBYTE ZU0 0 0 0 1 ECU_ADDRESS 0xFE9F8D3D SYMBOL_LINK "fAssCtrl_NMHighTActive_Expired_xdb" 0 /end MEASUREMENT
/begin MEASUREMENT eps_stTimerNMHighTTimeout_mu8 "State of the timer TimerNMHighTTimeout - mapped to fAssCtrl_NMHighTTimeout_Expired_xdb" UBYTE ZU0 0 0 0 1 ECU_ADDRESS 0xFE9F8D3F SYMBOL_LINK "fAssCtrl_NMHighTTimeout_Expired_xdb" 0 /end MEASUREMENT
/begin MEASUREMENT eps_stTimerNMHighTWaitBusSleep_mu8 "State of timer TimerNMHighTWaitBusSleep - mapped to fAssCtrl_NMHighTWaitBusSleep_Expired_xdb" UBYTE ZU0 0 0 0 1 ECU_ADDRESS 0xFE9F8D40 SYMBOL_LINK "fAssCtrl_NMHighTWaitBusSleep_Expired_xdb" 0 /end MEASUREMENT
/begin MEASUREMENT eps_stTimerVLowTOut_mu8 "Flag zur Anzeige des Ablaufs des Niederspannungstimers - mapped to fAssCtrl_TimerLowVolt_xdb" UBYTE ZU0 0 0 0 1 ECU_ADDRESS 0xFE9F8D92 SYMBOL_LINK "fLowVoltAssRedI_OutStageOff_xdb" 0 /end MEASUREMENT
/begin MEASUREMENT eps_stVFzgAssOff_mu8 "Flagge zur Anzeige des Status der Fahrzeugassistenz basierend auf der Geschwindigkeit - mapped to fAssCtrl_VehicleAssistanceOff_xdb" UBYTE ZU0 0 0 0 1 ECU_ADDRESS 0xFE9F8D48 SYMBOL_LINK "fAssCtrl_VehicleAssistanceOff_xdb" 0 /end MEASUREMENT
/begin MEASUREMENT eps_stVFzgNotlaufAktiv_mu8 "Fahrgeschwindigkeitsnotlauf Ueberwachung Lenkbewegung aktiv - mapped to sAssCtrl_stVFzgNotlaufAktiv_xdb" UBYTE ZU0 0 0 0 1 ECU_ADDRESS 0xFE9F8E3B SYMBOL_LINK "sAssCtrl_stVFzgNotlaufAktiv_xdb" 0 /end MEASUREMENT
/begin MEASUREMENT eps_tTimerVLowTOut_mu8 "Timer fur Timeout Zeit S25 IdelUnterspannung - mapped to tAssCtrl_UnderVoltageTimer_xdu16" UWORD ZU0 0 0 0 1000 ECU_ADDRESS 0xFE9F8A6E SYMBOL_LINK "tAssCtrl_UnderVoltageTimer_xdu16" 0 /end MEASUREMENT
/begin MEASUREMENT ess_lh1Lenkerpos_mu8 "Position des Lenkers - mapped uEpsOut_LenkerPosition_xdu8" UBYTE ZU0 1 100 0 2 FORMAT "%5.3" ECU_ADDRESS 0xFE9F8F92 SYMBOL_LINK "uEpsOut_LenkerPosition_xdu8" 0 /end MEASUREMENT
/begin MEASUREMENT fga_mskStVFzg_mu8 "Statusinformationen zum Fahrzeuggeschwindigkeitssignal - mapped sVehSpI_VehicleSpeedStatusMask_xdu8" UBYTE ZU0 1 100 0 255 ECU_ADDRESS 0xFE9F8F76 SYMBOL_LINK "sVehSpI_VehicleSpeedStatusMask_xdu8" 0 /end MEASUREMENT
/begin MEASUREMENT fga_vFzgMaxAbgesichert_mu16 "Maximum Safety Speed - mapped to vVehSpI_AbsMaxSafeVehSpd_xdu16" UWORD VFZHIGH 0 0 0 511 ECU_ADDRESS 0xFE9F8B06 SYMBOL_LINK "vVehSpI_AbsMaxSafeVehSpd_xdu16" 0 /end MEASUREMENT
/begin MEASUREMENT fga_vFzgMinAbgesichert_mu16 "Minimum Safety Speed - mapped to vVehSpI_AbsMinSafeVehSpd_xdu16" UWORD VFZHIGH 0 0 0 511 ECU_ADDRESS 0xFE9F8B0A SYMBOL_LINK "vVehSpI_AbsMinSafeVehSpd_xdu16" 0 /end MEASUREMENT
/begin MEASUREMENT fga_vFzgRohW_mu16 "Raw vehicle speed - mapped vVehSpI_VehicleSpeedRaw_xdu16" UWORD VFZHIGH 1 100 0 511 ECU_ADDRESS 0xFE9F8B10 SYMBOL_LINK "vVehSpI_VehicleSpeedRaw_xdu16" 0 /end MEASUREMENT
/begin MEASUREMENT fga_vFzg_mu16 "Abs. Fahrzeuggeschwindigkeit: aufbereitet - mapped vApplI_AbsVehicleSpeedFilt_xdu16" UWORD VFZHIGH 1 100 0 511 ECU_ADDRESS 0xFE9F8AB4 SYMBOL_LINK "vApplI_AbsVehicleSpeedFilt_xdu16" 0 /end MEASUREMENT
/begin MEASUREMENT fga_vRadHl_mu16 "Rad Geschwindigkeit hinten links - mapped vVehSpI_WheelSpeedRL_xdu16" UWORD VFZHIGH 1 100 0 491 ECU_ADDRESS 0xFE9F8B18 SYMBOL_LINK "vVehSpI_WheelSpeedRL_xdu16" 0 /end MEASUREMENT
/begin MEASUREMENT fga_vRadHr_mu16 "Rad Geschwindigkeit hinten rechts - mapped vVehSpI_WheelSpeedRR_xdu16" UWORD VFZHIGH 1 100 0 491 ECU_ADDRESS 0xFE9F8B1A SYMBOL_LINK "vVehSpI_WheelSpeedRR_xdu16" 0 /end MEASUREMENT
/begin MEASUREMENT fga_vRadVl_mu16 "Rad Geschwindigkeit vorne links - mapped vVehSpI_WheelSpeedFL_xdu16" UWORD VFZHIGH 1 100 0 491 ECU_ADDRESS 0xFE9F8B14 SYMBOL_LINK "vVehSpI_WheelSpeedFL_xdu16" 0 /end MEASUREMENT
/begin MEASUREMENT fga_vRadVr_mu16 "Rad Geschwindigkeit vorne rechts - mapped vVehSpI_WheelSpeedFR_xdu16" UWORD VFZHIGH 1 100 0 491 ECU_ADDRESS 0xFE9F8B16 SYMBOL_LINK "vVehSpI_WheelSpeedFR_xdu16" 0 /end MEASUREMENT
/begin MEASUREMENT iSigProcI_IsdIsr_gdf32 "current - direct axis" FLOAT32_IEEE CURR_REAL 1 100 -1250 1250 ECU_ADDRESS 0xFEBF67E8 /end MEASUREMENT
/begin MEASUREMENT iSigProcI_IsqIsr_gdf32 "current - quadrature axis" FLOAT32_IEEE CURR_REAL 1 100 -1250 1250 ECU_ADDRESS 0xFEBF67F0 /end MEASUREMENT
/begin MEASUREMENT kom_fSollVib_mi16 "Sollkraft der Vibration bei Fehler Bordnetz" SWORD NM2N 1 100 -11000 11000 FORMAT "%8.6" ECU_ADDRESS 0xFE9F88D0 SYMBOL_LINK "mBatWrnVibI_MotorTorqueOffset_xds16" 0 /end MEASUREMENT
/begin MEASUREMENT lku_fSoll_mi16 "Unterstuetzungsmoment - mapped matAssistantTorque_xds16" SWORD NM2N_GEARSIGN 1 100 -32844 32844 FORMAT "%8.5" ECU_ADDRESS 0xFE9F88BC SYMBOL_LINK "matAssistantTorque_xds16" 0 /end MEASUREMENT
/begin MEASUREMENT mHwlI_LimitedMotorTorque_gdf32 "Limited motor torque HwLib" FLOAT32_IEEE TORQ_REAL 1 100 -12 12 ECU_ADDRESS 0xFEEA2F3C /end MEASUREMENT
/begin MEASUREMENT rou_iCalibOffset_mi32 "Abstand zwischen kalibrierter Mitte und lieferantenspezifischen Inertialsystem - mapped wRpSyncI_AccRotAngOffsetCalibNVR_xds16" SWORD ROTPOS2RACKPOS 1 100 -350 350 ECU_ADDRESS 0xFE9F8B5C SYMBOL_LINK "wRpSyncI_AccRotAngOffsetCalibNVR_xds16" 0 /end MEASUREMENT
/begin MEASUREMENT rou_iInertiaDistance_mi32 "Abstand zwischen mechnischer Mitte und lieferantenspezifischen Inertialsystem - lEndStopI_CenterOffset_xds16" SWORD RACKPOS128 1 100 -10 10 FORMAT "%8.4" ECU_ADDRESS 0xFE9F8858 SYMBOL_LINK "lEndStopI_CenterOffset_xds16" 0 /end MEASUREMENT
/begin MEASUREMENT rou_iMaxSteerRange_mu16 "Learned total mechanical length of the steering system in mm" FLOAT32_IEEE rou_iMaxSteerRange_mu16.Conversion 0 0 0 255 /begin VIRTUAL lEndStopI_RackPosMax_xds16 lEndStopI_RackPosMin_xds16 /end VIRTUAL /end MEASUREMENT
/begin MEASUREMENT rou_iOffsetMechCalibCenterPoint_mi16 "Abstand zwischen mechnischer Mitte und lieferantenspezifischen Inertialsystem" FLOAT32_IEEE VIRTUAL_SUBTRACT 1 100 -100 100 /begin VIRTUAL rou_iInertiaDistance_mi32 rou_iCalibOffset_mi32 /end VIRTUAL /end MEASUREMENT
/begin MEASUREMENT rou_stCouDynUni_Basic_mu8 "Dynamic block counter for RID 0416. - mapped yRoutOutWrap_0416_DynBlockCtr_xdu8" UBYTE ZU0 1 100 2 255 FORMAT "%6.4" ECU_ADDRESS 0xFE9F9016 SYMBOL_LINK "yRoutOutWrap_0416_DynBlockCtr_xdu8" 0 /end MEASUREMENT
/begin MEASUREMENT rou_stCouDynUni_DelCal_mu8 "Dynamic block counter for RID 0366. - mapped yRoutOutWrap_0366_DynBlockCtr_xdu8" UBYTE ZU0 1 100 2 255 FORMAT "%6.4" ECU_ADDRESS 0xFE9F9012 SYMBOL_LINK "yRoutOutWrap_0366_DynBlockCtr_xdu8" 0 /end MEASUREMENT
/begin MEASUREMENT rou_stCouDynUni_DelFac_mu8 "Dynamic block counter for RID 03E7. - mapped yRoutOutWrap_03E7_DynBlockCtr_xdu8" UBYTE ZU0 1 100 2 255 FORMAT "%6.4" ECU_ADDRESS 0xFE9F9014 SYMBOL_LINK "yRoutOutWrap_03E7_DynBlockCtr_xdu8" 0 /end MEASUREMENT
/begin MEASUREMENT rou_stCouDynUni_DelSWEA_mu8 "Dynamic block counter for RID 0468. - mapped yRoutOutWrap_0468_DynBlockCtr_xdu8" UBYTE ZU0 1 100 2 255 FORMAT "%6.4" ECU_ADDRESS 0xFE9F9018 SYMBOL_LINK "yRoutOutWrap_0468_DynBlockCtr_xdu8" 0 /end MEASUREMENT
/begin MEASUREMENT rou_stCouDynUni_DelVal_mu8 "Dynamic block counter for RID 0317. - mapped yRoutOutWrap_0317_DynBlockCtr_xdu8" UBYTE ZU0 1 100 2 255 FORMAT "%6.4" ECU_ADDRESS 0xFE9F9010 SYMBOL_LINK "yRoutOutWrap_0317_DynBlockCtr_xdu8" 0 /end MEASUREMENT
/begin MEASUREMENT rou_stCouDynUni_Init_mu8 "Dynamic block counter for RID 0213. - mapped yRoutOutWrap_0213_DynBlockCtr_xdu8" UBYTE ZU0 1 100 2 255 FORMAT "%6.4" ECU_ADDRESS 0xFE9F9008 SYMBOL_LINK "yRoutOutWrap_0213_DynBlockCtr_xdu8" 0 /end MEASUREMENT
/begin MEASUREMENT rou_stCouDynUni_MigrationRout_mu8 "Dynamic block counter for RID 0301. - mapped yRoutOutWrap_0301_DynBlockCtr_xdu8" UBYTE ZU0 1 100 2 255 FORMAT "%6.4" ECU_ADDRESS 0xFE9F900E SYMBOL_LINK "yRoutOutWrap_0301_DynBlockCtr_xdu8" 0 /end MEASUREMENT
/begin MEASUREMENT rou_stCouDynUni_SWEA_mu8 "Dynamic block counter for RID 0562. - mapped yRoutOutWrap_0562_DynBlockCtr_xdu8" UBYTE ZU0 1 100 2 255 FORMAT "%6.4" ECU_ADDRESS 0xFE9F901A SYMBOL_LINK "yRoutOutWrap_0562_DynBlockCtr_xdu8" 0 /end MEASUREMENT
/begin MEASUREMENT rou_stCouDynUni_SpecialRout_mu8 "Dynamic block counter for RID 0300. - mapped yRoutOutWrap_0300_DynBlockCtr_xdu8" UBYTE ZU0 1 100 2 255 FORMAT "%6.4" ECU_ADDRESS 0xFE9F900C SYMBOL_LINK "yRoutOutWrap_0300_DynBlockCtr_xdu8" 0 /end MEASUREMENT
/begin MEASUREMENT rou_stCouDynUni_Zero_mu8 "Dynamic block counter for RID 0212. - mapped yRoutOutWrap_0212_DynBlockCtr_xdu8" UBYTE ZU0 1 100 2 255 FORMAT "%6.4" ECU_ADDRESS 0xFE9F9006 SYMBOL_LINK "yRoutOutWrap_0212_DynBlockCtr_xdu8" 0 /end MEASUREMENT
/begin MEASUREMENT rou_stCouDynUni_mechM_mu8 "Dynamic block counter for RID 0215. - mapped yRoutOutWrap_0215_DynBlockCtr_xdu8" UBYTE ZU0 1 100 2 255 FORMAT "%6.4" ECU_ADDRESS 0xFE9F900A SYMBOL_LINK "yRoutOutWrap_0215_DynBlockCtr_xdu8" 0 /end MEASUREMENT
/begin MEASUREMENT rou_stErrMigrationRou_mu32 "Precondition error for RID 0301. - mapped yRoutOutWrap_0301_Error_xdu32" ULONG ZU0 1 100 0 4294967295 ECU_ADDRESS 0xFE9F8718 SYMBOL_LINK "yRoutOutWrap_0301_Error_xdu32" 0 /end MEASUREMENT
/begin MEASUREMENT rou_stErrSpecialRou_mu32 "Precondition error for RID 0300. - mapped yRoutOutWrap_0300_Error_xdu32" ULONG ZU0 1 100 0 4294967295 ECU_ADDRESS 0xFE9F8714 SYMBOL_LINK "yRoutOutWrap_0300_Error_xdu32" 0 /end MEASUREMENT
/begin MEASUREMENT rou_stErr_Basic_mu32 "Precondition error for RID 0416. - mapped yRoutOutWrap_0416_Error_xdu32" ULONG ZU0 1 100 0 4294967295 ECU_ADDRESS 0xFE9F8728 SYMBOL_LINK "yRoutOutWrap_0416_Error_xdu32" 0 /end MEASUREMENT
/begin MEASUREMENT rou_stErr_DelCal_mu32 "Precondition error for RID 0366. - mapped yRoutOutWrap_0366_Error_xdu32" ULONG ZU0 1 100 0 4294967295 ECU_ADDRESS 0xFE9F8720 SYMBOL_LINK "yRoutOutWrap_0366_Error_xdu32" 0 /end MEASUREMENT
/begin MEASUREMENT rou_stErr_DelFac_mu32 "Precondition error for RID 03E7. - mapped yRoutOutWrap_03E7_Error_xdu32" ULONG ZU0 1 100 0 4294967295 ECU_ADDRESS 0xFE9F8724 SYMBOL_LINK "yRoutOutWrap_03E7_Error_xdu32" 0 /end MEASUREMENT
/begin MEASUREMENT rou_stErr_DelSWEA_mu32 "Precondition error for RID 0468. - mapped yRoutOutWrap_0468_Error_xdu32" ULONG ZU0 1 100 0 4294967295 ECU_ADDRESS 0xFE9F872C SYMBOL_LINK "yRoutOutWrap_0468_Error_xdu32" 0 /end MEASUREMENT
/begin MEASUREMENT rou_stErr_DelVal_mu32 "Precondition error for RID 0317. - mapped yRoutOutWrap_0317_Error_xdu32" ULONG ZU0 1 100 0 4294967295 ECU_ADDRESS 0xFE9F871C SYMBOL_LINK "yRoutOutWrap_0317_Error_xdu32" 0 /end MEASUREMENT
/begin MEASUREMENT rou_stErr_Init_mu32 "Precondition error for RID 0213. - mapped yRoutOutWrap_0213_Error_xdu32" ULONG ZU0 1 100 0 4294967295 ECU_ADDRESS 0xFE9F870C SYMBOL_LINK "yRoutOutWrap_0213_Error_xdu32" 0 /end MEASUREMENT
/begin MEASUREMENT rou_stErr_SWEA_mu32 "Precondition error for RID 0562. - mapped yRoutOutWrap_0562_Error_xdu32" ULONG ZU0 1 100 0 4294967295 ECU_ADDRESS 0xFE9F8730 SYMBOL_LINK "yRoutOutWrap_0562_Error_xdu32" 0 /end MEASUREMENT
/begin MEASUREMENT rou_stErr_Zero_mu32 "Precondition error for RID 0212. - mapped yRoutOutWrap_0212_Error_xdu32" ULONG ZU0 1 100 0 4294967295 ECU_ADDRESS 0xFE9F8708 SYMBOL_LINK "yRoutOutWrap_0212_Error_xdu32" 0 /end MEASUREMENT
/begin MEASUREMENT rou_stErr_mechM_mu32 "Precondition error for RID 0215. - mapped yRoutOutWrap_0215_Error_xdu32" ULONG ZU0 1 100 0 4294967295 ECU_ADDRESS 0xFE9F8710 SYMBOL_LINK "yRoutOutWrap_0215_Error_xdu32" 0 /end MEASUREMENT
/begin MEASUREMENT rou_stLkuOn_mu8 "Status, indicating whether active power steering is required for execution." UBYTE ZU0 0 0 0 1 FORMAT "%5.3" ECU_ADDRESS 0xFE9F8FBC SYMBOL_LINK "yDiagSrvCtrlI_RequestedAssistState_xdb" 0 /end MEASUREMENT
/begin MEASUREMENT rou_stOperationValidity_mu8 "State of SA offset, init and SW endstops" UBYTE rou_stOperationValidity_mu8.Conversion 0 0 0 255 FORMAT "%6.2" /begin VIRTUAL Rou_Calib Rou_Init Rou_SWEA /end VIRTUAL /end MEASUREMENT
/begin MEASUREMENT rou_stPreCondFulfill_mu16 "Bitmaske bzgl. fuer welche Routine alle notwendigen Vorbedingungen erfuellt sind - mapped yRoutOutWrap_RoutinePrecondFulfilled_xdu16" UWORD ZU0 1 100 0 65535 FORMAT "%6.4" ECU_ADDRESS 0xFE9F8CD4 SYMBOL_LINK "yRoutOutWrap_RoutinePrecondFulfilled_xdu16" 0 /end MEASUREMENT
/begin MEASUREMENT rou_stPreCond_mu32 "Bitmaske der Vorbedingungen - mapped yRoutOutWrap_RoutinePreconditions_xdu32" ULONG ZU0 1 100 0 4294967295 ECU_ADDRESS 0xFE9F8734 SYMBOL_LINK "yRoutOutWrap_RoutinePreconditions_xdu32" 0 /end MEASUREMENT
/begin MEASUREMENT rou_stResMigrationRou_mu16 "RoutineResult for RID 0301. - mapped yRoutOutWrap_0301_Result_xdu16" UWORD ROU_RESULT 1 100 0 65535 FORMAT "%6.4" ECU_ADDRESS 0xFE9F8CC6 SYMBOL_LINK "yRoutOutWrap_0301_Result_xdu16" 0 /end MEASUREMENT
/begin MEASUREMENT rou_stResSpecialRou_mu16 "RoutineResult for RID 0300. - mapped yRoutOutWrap_0300_Result_xdu16" UWORD ROU_RESULT 1 100 0 65535 FORMAT "%6.4" ECU_ADDRESS 0xFE9F8CC4 SYMBOL_LINK "yRoutOutWrap_0300_Result_xdu16" 0 /end MEASUREMENT
/begin MEASUREMENT rou_stRes_Basic_mu16 "RoutineResult for RID 0416. - mapped yRoutOutWrap_0416_Result_xdu16" UWORD ROU_RESULT 1 100 0 65535 FORMAT "%6.4" ECU_ADDRESS 0xFE9F8CCE SYMBOL_LINK "yRoutOutWrap_0416_Result_xdu16" 0 /end MEASUREMENT
/begin MEASUREMENT rou_stRes_DelCal_mu16 "RoutineResult for RID 0366. - mapped yRoutOutWrap_0366_Result_xdu16" UWORD ROU_RESULT 1 100 0 65535 FORMAT "%6.4" ECU_ADDRESS 0xFE9F8CCA SYMBOL_LINK "yRoutOutWrap_0366_Result_xdu16" 0 /end MEASUREMENT
/begin MEASUREMENT rou_stRes_DelFac_mu16 "RoutineResult for RID 03E7. - mapped yRoutOutWrap_03E7_Result_xdu16" UWORD ROU_RESULT 1 100 0 65535 FORMAT "%6.4" ECU_ADDRESS 0xFE9F8CCC SYMBOL_LINK "yRoutOutWrap_03E7_Result_xdu16" 0 /end MEASUREMENT
/begin MEASUREMENT rou_stRes_DelSWEA_mu16 "RoutineResult for RID 0468. - mapped yRoutOutWrap_0468_Result_xdu16" UWORD ROU_RESULT 1 100 0 65535 FORMAT "%6.4" ECU_ADDRESS 0xFE9F8CD0 SYMBOL_LINK "yRoutOutWrap_0468_Result_xdu16" 0 /end MEASUREMENT
/begin MEASUREMENT rou_stRes_DelVal_mu16 "RoutineResult for RID 0317. - mapped yRoutOutWrap_0317_Result_xdu16" UWORD ROU_RESULT 1 100 0 65535 FORMAT "%6.4" ECU_ADDRESS 0xFE9F8CC8 SYMBOL_LINK "yRoutOutWrap_0317_Result_xdu16" 0 /end MEASUREMENT
/begin MEASUREMENT rou_stRes_Init_mu16 "RoutineResult for RID 0213. - mapped yRoutOutWrap_0213_Result_xdu16" UWORD ROU_RESULT 1 100 0 65535 FORMAT "%6.4" ECU_ADDRESS 0xFE9F8CC0 SYMBOL_LINK "yRoutOutWrap_0213_Result_xdu16" 0 /end MEASUREMENT
/begin MEASUREMENT rou_stRes_SWEA_mu16 "RoutineResult for RID 0562. - mapped yRoutOutWrap_0562_Result_xdu16" UWORD ROU_RESULT 1 100 0 65535 FORMAT "%6.4" ECU_ADDRESS 0xFE9F8CD2 SYMBOL_LINK "yRoutOutWrap_0562_Result_xdu16" 0 /end MEASUREMENT
/begin MEASUREMENT rou_stRes_Zero_mu16 "RoutineResult for RID 0212. - mapped yRoutOutWrap_0212_Result_xdu16" UWORD ROU_RESULT 1 100 0 65535 FORMAT "%6.4" ECU_ADDRESS 0xFE9F8CBE SYMBOL_LINK "yRoutOutWrap_0212_Result_xdu16" 0 /end MEASUREMENT
/begin MEASUREMENT rou_stRes_mechM_mu16 "RoutineResult for RID 0215. - mapped yRoutOutWrap_0215_Result_xdu16" UWORD ROU_RESULT 1 100 0 65535 FORMAT "%6.4" ECU_ADDRESS 0xFE9F8CC2 SYMBOL_LINK "yRoutOutWrap_0215_Result_xdu16" 0 /end MEASUREMENT
/begin MEASUREMENT rou_stStaMigrationRou_mu8 "RoutineStatus for RID 0301. - mapped yRoutOutWrap_0301_Status_xdu8" UBYTE ROU_STATUS 1 100 0 255 FORMAT "%6.2" ECU_ADDRESS 0xFE9F900F SYMBOL_LINK "yRoutOutWrap_0301_Status_xdu8" 0 /end MEASUREMENT
/begin MEASUREMENT rou_stStaSpecialRou_mu8 "RoutineStatus for RID 0300. - mapped yRoutOutWrap_0300_Status_xdu8" UBYTE ROU_STATUS 1 100 0 255 FORMAT "%6.2" ECU_ADDRESS 0xFE9F900D SYMBOL_LINK "yRoutOutWrap_0300_Status_xdu8" 0 /end MEASUREMENT
/begin MEASUREMENT rou_stSta_Basic_mu8 "RoutineStatus for RID 0416. - mapped yRoutOutWrap_0416_Status_xdu8" UBYTE ROU_STATUS 1 100 0 255 FORMAT "%6.2" ECU_ADDRESS 0xFE9F9017 SYMBOL_LINK "yRoutOutWrap_0416_Status_xdu8" 0 /end MEASUREMENT
/begin MEASUREMENT rou_stSta_DelCal_mu8 "RoutineStatus for RID 0366. - mapped yRoutOutWrap_0366_Status_xdu8" UBYTE ROU_STATUS 1 100 0 255 FORMAT "%6.2" ECU_ADDRESS 0xFE9F9013 SYMBOL_LINK "yRoutOutWrap_0366_Status_xdu8" 0 /end MEASUREMENT
/begin MEASUREMENT rou_stSta_DelFac_mu8 "RoutineStatus for RID 03E7. - mapped yRoutOutWrap_03E7_Status_xdu8" UBYTE ROU_STATUS 1 100 0 255 FORMAT "%6.2" ECU_ADDRESS 0xFE9F9015 SYMBOL_LINK "yRoutOutWrap_03E7_Status_xdu8" 0 /end MEASUREMENT
/begin MEASUREMENT rou_stSta_DelSWEA_mu8 "RoutineStatus for RID 0468. - mapped yRoutOutWrap_0468_Status_xdu8" UBYTE ROU_STATUS 1 100 0 255 FORMAT "%6.2" ECU_ADDRESS 0xFE9F9019 SYMBOL_LINK "yRoutOutWrap_0468_Status_xdu8" 0 /end MEASUREMENT
/begin MEASUREMENT rou_stSta_DelVal_mu8 "RoutineStatus for RID 0317. - mapped yRoutOutWrap_0317_Status_xdu8" UBYTE ROU_STATUS 1 100 0 255 FORMAT "%6.2" ECU_ADDRESS 0xFE9F9011 SYMBOL_LINK "yRoutOutWrap_0317_Status_xdu8" 0 /end MEASUREMENT
/begin MEASUREMENT rou_stSta_Init_mu8 "RoutineStatus for RID 0213. - mapped yRoutOutWrap_0213_Status_xdu8" UBYTE ROU_STATUS 1 100 0 255 FORMAT "%6.2" ECU_ADDRESS 0xFE9F9009 SYMBOL_LINK "yRoutOutWrap_0213_Status_xdu8" 0 /end MEASUREMENT
/begin MEASUREMENT rou_stSta_SWEA_mu8 "RoutineStatus for RID 0562. - mapped yRoutOutWrap_0562_Status_xdu8" UBYTE ROU_STATUS 1 100 0 255 FORMAT "%6.2" ECU_ADDRESS 0xFE9F901B SYMBOL_LINK "yRoutOutWrap_0562_Status_xdu8" 0 /end MEASUREMENT
/begin MEASUREMENT rou_stSta_Zero_mu8 "RoutineStatus for RID 0212. - mapped yRoutOutWrap_0212_Status_xdu8" UBYTE ROU_STATUS 1 100 0 255 FORMAT "%6.2" ECU_ADDRESS 0xFE9F9007 SYMBOL_LINK "yRoutOutWrap_0212_Status_xdu8" 0 /end MEASUREMENT
/begin MEASUREMENT rou_stSta_mechM_mu8 "RoutineStatus for RID 0215. - mapped yRoutOutWrap_0215_Status_xdu8" UBYTE ROU_STATUS 1 100 0 255 FORMAT "%6.2" ECU_ADDRESS 0xFE9F900B SYMBOL_LINK "yRoutOutWrap_0215_Status_xdu8" 0 /end MEASUREMENT
/begin MEASUREMENT sac_can_strDevMsgTx1_mu32 "Ausgang variable CAN-Botschaft 1. Teil - mapped yBbSacInI_DevMsgTx1_xdu32" ULONG ZU0 1 100 0 4294967295 ECU_ADDRESS 0xFE9F8650 SYMBOL_LINK "yBbSacInI_DevMsgTx1_xdu32" 0 /end MEASUREMENT
/begin MEASUREMENT sac_can_strDevMsgTx2_mu32 "Ausgang variable CAN-Botschaft 2. Teil - mapped yBbSacInI_DevMsgTx2_xdu32" ULONG ZU0 1 100 0 4294967295 ECU_ADDRESS 0xFE9F8654 SYMBOL_LINK "yBbSacInI_DevMsgTx2_xdu32" 0 /end MEASUREMENT
/begin MEASUREMENT sac_qap_stFas01_mu8 "Status FAS01 / PLA im QFK - mapped sBbaSacInI_Fas01StateStateQfkPla_xdu8" UBYTE ZU0 1 100 0 255 ECU_ADDRESS 0xFE9F8E47 SYMBOL_LINK "sBbaSacInI_Fas01StateStateQfkPla_xdu8" 0 /end MEASUREMENT
/begin MEASUREMENT sac_qap_stFas02_mu8 "Status FAS02 / AWV im QFK - mapped sBbaSacInI_Fas02StateStateQfkAwv_xdu8" UBYTE ZU0 1 100 0 255 ECU_ADDRESS 0xFE9F8E48 SYMBOL_LINK "sBbaSacInI_Fas02StateStateQfkAwv_xdu8" 0 /end MEASUREMENT
/begin MEASUREMENT sac_qap_stFas03_mu8 "Status FAS03 / HCA im QFK - mapped sBbaSacInI_Fas03StateStateQfkHca_xdu8" UBYTE ZU0 1 100 0 255 ECU_ADDRESS 0xFE9F8E49 SYMBOL_LINK "sBbaSacInI_Fas03StateStateQfkHca_xdu8" 0 /end MEASUREMENT
/begin MEASUREMENT sac_qap_stFas04_mu8 "Status FAS04 / DSR im QFK - mapped sBbaSacInI_Fas04StateStateQfkDsr_xdu8" UBYTE ZU0 1 100 0 255 ECU_ADDRESS 0xFE9F8E4A SYMBOL_LINK "sBbaSacInI_Fas04StateStateQfkDsr_xdu8" 0 /end MEASUREMENT
/begin MEASUREMENT sac_qap_stFas05_mu8 "Status FAS05 im QFK - mapped sBbaSacInI_Fas05StateStateQfkFas05_xdu8" UBYTE ZU0 1 100 0 255 ECU_ADDRESS 0xFE9F8E4B SYMBOL_LINK "sBbaSacInI_Fas05StateStateQfkFas05_xdu8" 0 /end MEASUREMENT
/begin MEASUREMENT sac_qap_stPrioToTnDsaTsc_mu16 "Freigabestatus DSA + TSC - mapped sBbaSacInI_State4AscDsa_xdu8(LSB) and sBbaSacInI_State4AscTsc_xdu8(MSB)" UWORD sac_qap_stPrioToTnDsaTsc_mu16.CONVERSIONV 0 0 0 65535 FORMAT "%6.2" /begin VIRTUAL bas_state4AscTsc_mu8 bas_state4AscDsa_mu8 /end VIRTUAL /end MEASUREMENT
/begin MEASUREMENT sac_qap_stQFKZyklZ_mu8 "Zykluszeit QFK_01 BUS Botschaft, 0: langsamer Zyklus, 1: Schneller Zyklus - mapped sBbaSacInI_QFK_01_CycleTime_xdu8" UBYTE ZU0 0 0 0 1 FORMAT "%5.3" ECU_ADDRESS 0xFE9F8E4F SYMBOL_LINK "sBbaSacInI_QFK_01_CycleTime_xdu8" 0 /end MEASUREMENT
/begin MEASUREMENT sac_qap_stQFK_mu8 "Gesamtstatus QFK - mapped sBbaSacInI_StateQfk_xdu8" UBYTE ZU0 1 100 0 255 ECU_ADDRESS 0xFE9F8E52 SYMBOL_LINK "sBbaSacInI_StateQfk_xdu8" 0 /end MEASUREMENT
/begin MEASUREMENT sac_qhm_fSollNUel_mi16 "Zahnstangenkraft - nicht ueberlenkbar - mapped kBbaSacInI_RackForceNotOversteerable_xds16" SWORD FRACK 1 100 -32768 32767 ECU_ADDRESS 0xFE9F8812 SYMBOL_LINK "kBbaSacInI_RackForceNotOversteerable_xds16" 0 /end MEASUREMENT
/begin MEASUREMENT sac_qhm_fSoll_mi16 "Motormoment Haptikmodul - mapped kBbaSacInI_QhmRackForce_xds16" SWORD FRACK 1 100 -32768 32767 ECU_ADDRESS 0xFE9F8810 SYMBOL_LINK "kBbaSacInI_QhmRackForce_xds16" 0 /end MEASUREMENT
/begin MEASUREMENT sac_qhm_mskStatus_mu8 "Status QFK Begrenzer 0=nicht begrenzt, 1=begrenzt - mapped sBbaSacInI_QfkLimiterActive_xdu8" UBYTE ZU0 1 100 0 255 ECU_ADDRESS 0xFE9F8E4E SYMBOL_LINK "sBbaSacInI_QfkLimiterActive_xdu8" 0 /end MEASUREMENT
/begin MEASUREMENT sac_qhm_nivIstKraft_mi16 "sac_qhm_nivIstKraft_mi16 - mapped xBbaSacInI_ActualRackForce_xds16" SWORD DIV1PRZ 1 100 -32768 32767 FORMAT "%8.2" ECU_ADDRESS 0xFE9F8BB2 SYMBOL_LINK "xBbaSacInI_ActualRackForce_xds16" 0 /end MEASUREMENT
/begin MEASUREMENT sac_qpr_fSollVib_mi16 "Vibrationskraft - mapped kBbaSacInI_VibrationRackForce_xds16" SWORD FRACK 1 100 -32768 32767 ECU_ADDRESS 0xFE9F8814 SYMBOL_LINK "kBbaSacInI_VibrationRackForce_xds16" 0 /end MEASUREMENT
/begin MEASUREMENT sac_qua_krIst_mi16 "Ist-Kruemmung QFK - mapped xBbaSacInI_ActualCurvature_xds16" SWORD CURVATURE17 1 100 -0.25 0.2499924 ECU_ADDRESS 0xFE9F8BB0 SYMBOL_LINK "xBbaSacInI_ActualCurvature_xds16" 0 /end MEASUREMENT
/begin MEASUREMENT sac_qua_stGierSoll_mu8 "Status QFK Giermomentenanfoderung an die Bremse - mapped sBbaSacInI_YawTorqueRequestState_xdu8" UBYTE ZU0 1 100 0 255 ECU_ADDRESS 0xFE9F8E54 SYMBOL_LINK "sBbaSacInI_YawTorqueRequestState_xdu8" 0 /end MEASUREMENT
/begin MEASUREMENT sac_qua_trqGierSoll_mi16 "Giermomentenanforderung an die Bremse - mapped mBbaSacInI_YawTorqueRequest_xds16" SWORD TRQ2 1 100 -16384 16383.5 FORMAT "%8.2" ECU_ADDRESS 0xFE9F88D8 SYMBOL_LINK "mBbaSacInI_YawTorqueRequest_xds16" 0 /end MEASUREMENT
/begin MEASUREMENT sac_qua_vFzgLvHigh_mu16 "max. Fahrzeuggeschwindigkeit aus SAC - mapped vBbaSacInI_MaxVehicleSpeed_xdu16" UWORD VFZHIGH 1 100 0 1023.984 FORMAT "%8.3" ECU_ADDRESS 0xFE9F8ABE SYMBOL_LINK "vBbaSacInI_MaxVehicleSpeed_xdu16" 0 /end MEASUREMENT
/begin MEASUREMENT sac_stSAC_mu32 "Status SAC - mapped sBbaSacInI_SacState_xdu32" ULONG ZU0 1 100 0 4294967295 FORMAT "%13.2" ECU_ADDRESS 0xFE9F851C SYMBOL_LINK "sBbaSacInI_SacState_xdu32" 0 /end MEASUREMENT
/begin MEASUREMENT sai_facCtlVal_mi8 "Describes the currently requested control variable of the rack position controller including direction specification.  - mapped hSmtActrRPCI_EpsCtlValQFK_xds8" UBYTE ZU0 1 100 0 100 FORMAT "%6.3" ECU_ADDRESS 0xFE9F8E01 SYMBOL_LINK "hSmtActrRPCI_EpsCtlValQFK_xds8" 0 /end MEASUREMENT
/begin MEASUREMENT sai_stDynLim_mu8 " - mapped sSmtActrRPCI_EpsDynLimQFK_xdb" UBYTE STATUS 1 100 0 100 FORMAT "%6.3" ECU_ADDRESS 0xFE9F8F61 SYMBOL_LINK "sSmtActrRPCI_EpsDynLimQFK_xdb" 0 /end MEASUREMENT
/begin MEASUREMENT sai_stSel_mu8 " - mapped sSmtActrRPCI_EpsSelQFK_xdu8" UBYTE ZU0 1 100 0 255 FORMAT "%6.3" ECU_ADDRESS 0xFE9F8F63 SYMBOL_LINK "sSmtActrRPCI_EpsSelQFK_xdu8" 0 /end MEASUREMENT
/begin MEASUREMENT sai_stVib_mu8 " - mapped sSmtActrVibI_EPSVibrSt_xdu8 " UBYTE ZU0 1 100 0 255 FORMAT "%6.3" ECU_ADDRESS 0xFE9F8F6B SYMBOL_LINK "sSmtActrVibI_EPSVibrSt_xdu8" 0 /end MEASUREMENT
/begin MEASUREMENT sai_st_mu8 " - mapped sSmtActrRPCI_EpsStQFK_xdu8 " UBYTE ZU0 1 100 0 255 FORMAT "%6.3" ECU_ADDRESS 0xFE9F8F65 SYMBOL_LINK "sSmtActrRPCI_EpsStQFK_xdu8" 0 /end MEASUREMENT
/begin MEASUREMENT tMoCoCo_IsrUsTimeStamp_gdu16 "us timestamp when MOC ISR Data Take over is done used for measurement only" UWORD T_US 1 100 0 65535 ECU_ADDRESS 0xFEBF8C10 /end MEASUREMENT
/begin MEASUREMENT tMoCoCo_Task2IsrTimeDiff_gds32 "Timediff in us between DataTake over in ISR and 1msEnd is finished" SLONG T_US 1 100 -65535 65535 ECU_ADDRESS 0xFEBF8C0C /end MEASUREMENT
/begin MEASUREMENT tMoCoCo_TaskUsTimeStamp_gdu16 "us timestamp when MOC in 1ms end is finished used for measurement only" UWORD T_US 1 100 0 65535 ECU_ADDRESS 0xFEBF8C12 /end MEASUREMENT
/begin MEASUREMENT uSvoI_OutputStageVoltageFilt_gdf32 "Filtered DC-Link / output stage voltage" FLOAT32_IEEE VOLT_REAL 1 100 0 1000 ECU_ADDRESS 0xFEBF7940 /end MEASUREMENT
/begin MEASUREMENT uSvoI_OutputStageVoltage_gdf32 "DC-Link / Output stage voltage" FLOAT32_IEEE VOLT_REAL 1 100 0 1000 ECU_ADDRESS 0xFEBF7938 /end MEASUREMENT
/begin MEASUREMENT unt_Wiederstart_erweitert_mu8 "Aktueller Status des erweiterten Wiederstarts (2 = obsolet), 1 = Okay, 0 = noAsssist in Start/Stop - mapped sLowVoltAssRedI_RestartExpanded_xdu8" UBYTE ZU0 0 0 0 3 ECU_ADDRESS 0xFE9F8EFA SYMBOL_LINK "sLowVoltAssRedI_RestartExpanded_xdu8" 0 /end MEASUREMENT
/begin MEASUREMENT unt_diag_aktiv_mu8 "Motor laeuft stabil (Immer wahr fuer MEB) - mapped fEngRnI_EngineRunningStable_xdb" UBYTE STATUS 1 100 0 1 FORMAT "%5.3" BIT_MASK 0x1 ECU_ADDRESS 0xFE9F8D6E SYMBOL_LINK "fEngRnI_EngineRunningStable_xdb" 0 /end MEASUREMENT
/begin MEASUREMENT unt_facFsollBegr_mu16 "Reduktionsfaktor auf maximalen Strom - mapped xLowVoltAssRedI_CurrentFactor_xdu16" UWORD RED_FACT 1 1 0 1 FORMAT "%8.4" ECU_ADDRESS 0xFE9F8C12 SYMBOL_LINK "xLowVoltAssRedI_CurrentFactor_xdu16" 0 /end MEASUREMENT
/begin MEASUREMENT unt_facGradientBegr_mu16 "Reduktionsfaktor auf maximalen Stromgradient - mapped xLowVoltAssRed_CurrentGradientFactor_xdu16" UWORD RED_FACT 1 1 0 1 FORMAT "%8.4" ECU_ADDRESS 0xFE9F8C26 SYMBOL_LINK "xLowVoltAssRed_CurrentGradientFactor_xdu16" 0 /end MEASUREMENT
/begin MEASUREMENT unt_facLku_mu16 "Faktorreduktion (angefordertes Motormoment) - mapped xLowVoltAssRed_AssistFactor_xdu16" UWORD RED_FACT 1 1 0 1 FORMAT "%8.4" ECU_ADDRESS 0xFE9F8C24 SYMBOL_LINK "xLowVoltAssRed_AssistFactor_xdu16" 0 /end MEASUREMENT
/begin MEASUREMENT unt_i_rueck_mu8 "Betriebszustand des Motors, nur MEB (0 = Motorischer Betrieb, 1 = Generatorischer Betrieb) - mapped fLowVoltAssRed_GeneratorMode_xdu8" UBYTE ZU0 0 0 0 1 FORMAT "%5.3" ECU_ADDRESS 0xFE9F8D96 SYMBOL_LINK "fLowVoltAssRed_GeneratorMode_xdu8" 0 /end MEASUREMENT
/begin MEASUREMENT wMcDiag_IntegAngleCompare_gdf32 "RotPos error integral in (degree)" FLOAT32_IEEE NO_UNIT 1 100 -2880 2880 ECU_ADDRESS 0xFEBF6390 /end MEASUREMENT
/begin MEASUREMENT xHwlI_TorqueRedLevels_gau16 "Array of all torque factor reduction channels" UWORD PERCENT_INT 1 100 0 100 ECU_ADDRESS 0xFEEA2F50 MATRIX_DIM 10 1 1 /end MEASUREMENT
/begin MEASUREMENT yHwlI_IndexSensSignal_gdu8 "Signal of index sensor" UBYTE NO_UNIT 1 100 0 1 ECU_ADDRESS 0xFEEA2F0E /end MEASUREMENT
/begin MEASUREMENT yHwlI_RackType_gdu8 "Rack Type" UBYTE NO_UNIT 1 100 0 255 ECU_ADDRESS 0xFEEA373A /end MEASUREMENT
/*********** End of merged MEASUREMENT blocks ***********/ /*********** Start of merged COMPU_METHOD blocks ***********/
/begin COMPU_METHOD AFZ "" RAT_FUNC "%6.5" "m/s^2" COEFFS 0 1024 0 0 0 1 /end COMPU_METHOD
/begin COMPU_METHOD ANGLE_1 "" RAT_FUNC "%6.2" "Â°" COEFFS 0 1 0 0 0 1 /end COMPU_METHOD
/begin COMPU_METHOD CURR_REAL "current in A for float values" RAT_FUNC "%4.5" "A" COEFFS 0 1.0 0.0 0 0 1 /end COMPU_METHOD
/begin COMPU_METHOD CURVATURE17 "" RAT_FUNC "%8.7" "1/m" COEFFS 0 131072 0 0 0 1 /end COMPU_METHOD
/begin COMPU_METHOD DIV1PRZ "" RAT_FUNC "%6.2" "%" COEFFS 0 1 0 0 0 1 /end COMPU_METHOD
/begin COMPU_METHOD ENC_M08_l "" RAT_FUNC "%9.8" "Void" COEFFS 0 256 0 0 0 1 /end COMPU_METHOD
/begin COMPU_METHOD FACT_0039 "" RAT_FUNC "%6.4" "mm" COEFFS 0 256.410256410256 -2 0 0 1 /end COMPU_METHOD
/begin COMPU_METHOD FRACK "" RAT_FUNC "%6.2" "N" COEFFS 0 1 0 0 0 1 /end COMPU_METHOD
/begin COMPU_METHOD KRUEMMSOLL "" RAT_FUNC "%8.7" "" COEFFS 0 149254 0 0 0 1 /end COMPU_METHOD
/begin COMPU_METHOD MM2HUB "MM2HUB" FORM "%6.5" "Grad" /begin FORMULA "X1 * 360 / 7424" FORMULA_INV "X1 * 7424 / 360" /end FORMULA /end COMPU_METHOD
/begin COMPU_METHOD MMOT "" RAT_FUNC "%6.5" "Nm" COEFFS 0 1024 0 0 0 1 /end COMPU_METHOD
/begin COMPU_METHOD MOTOR11 "" RAT_FUNC "%6.1" "" COEFFS 0 1 509 0 0 1 /end COMPU_METHOD
/begin COMPU_METHOD NM2N "Nm to N " FORM "%6.5" "N" /begin FORMULA "X1 * 2737 / 1024" FORMULA_INV "X1 * 1024 / 2737" /end FORMULA /end COMPU_METHOD
/begin COMPU_METHOD NM2N_GEARSIGN "Nm to N - gearsign removed" FORM "%6.5" "N" /begin FORMULA "X1 * 2737 / 1024" FORMULA_INV "X1 * 1024 / 2737" /end FORMULA /end COMPU_METHOD
/begin COMPU_METHOD NO_UNIT "no physical assignment" RAT_FUNC "%4.5" "-" COEFFS 0 1.0 0.0 0 0 1 /end COMPU_METHOD
/begin COMPU_METHOD PEDAL "" RAT_FUNC "%6.3" "%" COEFFS 0 2.5 0 0 0 1 /end COMPU_METHOD
/begin COMPU_METHOD PERCENT_INT "percentage in %  for integer values" RAT_FUNC "%4.5" "%" COEFFS 0 327.68 0.0 0 0 1 /end COMPU_METHOD
/begin COMPU_METHOD RACKPOS128 "" RAT_FUNC "%6.4" "mm" COEFFS 0 128 0 0 0 1 /end COMPU_METHOD
/begin COMPU_METHOD RACKSPEED128 "" RAT_FUNC "%6.4" "mm/s" COEFFS 0 128 0 0 0 1 /end COMPU_METHOD
/begin COMPU_METHOD RED_FACT "" RAT_FUNC "%6.4" "-" COEFFS 0 32768 0 0 0 1 /end COMPU_METHOD
/begin COMPU_METHOD RIGHTSH10NP_MULT100 "" RAT_FUNC "%6.3" "" COEFFS 0 10.24 0 0 0 1 /end COMPU_METHOD
/begin COMPU_METHOD RIGHTSH14NP "" RAT_FUNC "%7.6" "" COEFFS 0 16384 0 0 0 1 /end COMPU_METHOD
/begin COMPU_METHOD RIGHTSH15NP "" RAT_FUNC "%7.6" "" COEFFS 0 32768 0 0 0 1 /end COMPU_METHOD
/begin COMPU_METHOD RIGHTSH4NP "" RAT_FUNC "%6.4" "" COEFFS 0 16 0 0 0 1 /end COMPU_METHOD
/begin COMPU_METHOD RIGHTSH6NP "" RAT_FUNC "%6.4" "" COEFFS 0 64 0 0 0 1 /end COMPU_METHOD
/begin COMPU_METHOD ROTPOS "" RAT_FUNC "%6.3" "Â°" COEFFS 0 11.3777777777778 0 0 0 1 /end COMPU_METHOD
/begin COMPU_METHOD ROTPOS2RACKPOS "" RAT_FUNC "%8.4" "mm" COEFFS 0 154.8387096774193548387 0 0 0 1 /end COMPU_METHOD
/begin COMPU_METHOD ROU_RESULT "" TAB_VERB "%6.3" "Result" COMPU_TAB_REF ROU_RESULT /end COMPU_METHOD
/begin COMPU_METHOD ROU_STATUS "" TAB_VERB "%6.3" "Status" COMPU_TAB_REF ROU_STATUS /end COMPU_METHOD
/begin COMPU_METHOD RSH15 "" RAT_FUNC "%6.4" "%" COEFFS 0 327.68 0 0 0 1 /end COMPU_METHOD
/begin COMPU_METHOD SA "" RAT_FUNC "%6.4" "Â°" COEFFS 0 22.857 0 0 0 1 /end COMPU_METHOD
/begin COMPU_METHOD SAS_8 "" RAT_FUNC "%6.3" "Â°/s" COEFFS 0 8 0 0 0 1 /end COMPU_METHOD
/begin COMPU_METHOD SA_10 "" RAT_FUNC "%6.3" "Â°" COEFFS 0 10 0 0 0 1 /end COMPU_METHOD
/begin COMPU_METHOD SM_I "" RAT_FUNC "%6.4" "A" COEFFS 0 16 0 0 0 1 /end COMPU_METHOD
/begin COMPU_METHOD SPUERB "" RAT_FUNC "%6.3" "%" COEFFS 0 2.5 0 0 0 1 /end COMPU_METHOD
/begin COMPU_METHOD STATUS "" RAT_FUNC "%6.2" "Status" COEFFS 0 1 0 0 0 1 /end COMPU_METHOD
/begin COMPU_METHOD STEERING_CHAR_STATE_NUM "" TAB_NOINTP "%6.3" "" COMPU_TAB_REF STEERING_CHAR_STATE_NUM /end COMPU_METHOD
/begin COMPU_METHOD TBTHIGH "" RAT_FUNC "%6.5" "Nm" COEFFS 0 1024 0 0 0 1 /end COMPU_METHOD
/begin COMPU_METHOD TMPOUTS "" RAT_FUNC "%6.2" "Â°C" COEFFS 0 1 70 0 0 1 /end COMPU_METHOD
/begin COMPU_METHOD TORQ_REAL "torque in Nm  for float values" RAT_FUNC "%4.5" "Nm" COEFFS 0 1.0 0.0 0 0 1 /end COMPU_METHOD
/begin COMPU_METHOD TRQ2 "" RAT_FUNC "%6.3" "Nm" COEFFS 0 2 0 0 0 1 /end COMPU_METHOD
/begin COMPU_METHOD T_US "time in Âµs for integer values" RAT_FUNC "%4.5" "Âµs" COEFFS 0 1.0 0.0 0 0 1 /end COMPU_METHOD
/begin COMPU_METHOD U64V "" RAT_FUNC "%6.4" "V" COEFFS 0 64 0 0 0 1 /end COMPU_METHOD
/begin COMPU_METHOD U64V_H "" RAT_FUNC "%6.4" "V" COEFFS 0 256 0 0 0 1 /end COMPU_METHOD
/begin COMPU_METHOD VFZHIGH "" RAT_FUNC "%6.4" "km/h" COEFFS 0 64 0 0 0 1 /end COMPU_METHOD
/begin COMPU_METHOD VFZHIGH_OEM "" RAT_FUNC "%6.4" "km/h" COEFFS 0 128 0 0 0 1 /end COMPU_METHOD
/begin COMPU_METHOD VGIER "" RAT_FUNC "%6.4" "Â°/s" COEFFS 0 200 0 0 0 1 /end COMPU_METHOD
/begin COMPU_METHOD VIRTUAL_SUBTRACT "Subtraction of two measurements" FORM "%8.4" "mm" /begin FORMULA "((X1-X2))" /end FORMULA /end COMPU_METHOD
/begin COMPU_METHOD VOLT_REAL "voltage in V for float values" RAT_FUNC "%4.5" "V" COEFFS 0 1.0 0.0 0 0 1 /end COMPU_METHOD
/begin COMPU_METHOD VROT "" RAT_FUNC "%3.1" "1/min" COEFFS 0 1 0 0 0 1 /end COMPU_METHOD
/begin COMPU_METHOD ZEITASM_COM "" RAT_FUNC "%6.4" "s" COEFFS 0 25 0 0 0 1 /end COMPU_METHOD
/begin COMPU_METHOD ZU0 "" RAT_FUNC "%6.2" "" COEFFS 0 1 0 0 0 1 /end COMPU_METHOD
/begin COMPU_METHOD bsw_stCanWakeUp_mu8.CONVERSIONV "@@@@RuleName created by CANape" FORM "%3.1" "" /begin FORMULA "((X1&(1<<1))==(1<<1))" /end FORMULA /end COMPU_METHOD
/begin COMPU_METHOD can_stErrFahrbereitschaft_mu8.CONVERSIONV "@@@@RuleName created by CANape" FORM "%3.1" "" /begin FORMULA "((X1&(1<<19))==(1<<19))" /end FORMULA /end COMPU_METHOD
/begin COMPU_METHOD can_stErrRpmMotor_mu8.CONVERSIONV "@@@@RuleName created by CANape" FORM "%3.1" "" /begin FORMULA "((X1&(1<<12))==(1<<12))" /end FORMULA /end COMPU_METHOD
/begin COMPU_METHOD can_stSupDef_mu8.CONVERSIONV "@@@@RuleName created by CANape" FORM "%3.1" "" /begin FORMULA "((X1==0x02)||(X1==0x03))" /end FORMULA /end COMPU_METHOD
/begin COMPU_METHOD can_strFahrzeugIdent_mu32.CONVERSIONV "@@@@RuleName created by CANape" FORM "%3.1" "" /begin FORMULA "(X1<<24)|(X2<<16)|(X3<<8)|X4" /end FORMULA /end COMPU_METHOD
/begin COMPU_METHOD dia_mskRoutinen01_mu32.Calculation "" FORM "%6.3" ""
 /begin FORMULA "(BOOL(hex(X1) == 1)) | (BOOL(hex(X2) == 1)<<1) | (BOOL(hex(X3) == 1)<<2) | (BOOL(hex(X4) == 1)<<3) | (BOOL(hex(X5) == 1)<<4) | (BOOL(hex(X6) == 1)<<5) | (BOOL(hex(X7) == 1)<<6) | (BOOL(hex(X8) == 1)<<7) | (BOOL(hex(X9) == 1)<<8)" /end FORMULA
/end COMPU_METHOD
/begin COMPU_METHOD dia_stAufpruefen_mu8.CONVERSIONV "@@@@RuleName created by CANape" FORM "%3.1" "" /begin FORMULA "((X1&(1<<13))==(1<<13))" /end FORMULA /end COMPU_METHOD
/begin COMPU_METHOD dia_stDiaConditionValid_mu8.Calculation "" FORM "%6.3" "" /begin FORMULA "((X1&(1<<16))!=0)" /end FORMULA /end COMPU_METHOD
/begin COMPU_METHOD dia_stEModeAktiv_mu8.CONVERSIONV "@@@@RuleName created by CANape" FORM "%3.1" "" /begin FORMULA "((X1&(1<<5))==(1<<5))" /end FORMULA /end COMPU_METHOD
/begin COMPU_METHOD dia_stEafOn_mu8.CONVERSIONV "@@@@RuleName created by CANape" FORM "%3.1" "" /begin FORMULA "((X1&(1<<14))==(1<<14))" /end FORMULA /end COMPU_METHOD
/begin COMPU_METHOD dia_stEntwickCanId_mu8.Calculation "" FORM "%6.3" "" /begin FORMULA "((X1&(1<<13))!=0)" /end FORMULA /end COMPU_METHOD
/begin COMPU_METHOD dia_stGERLearnAlgo_mu8.Calculation "" FORM "%6.3" "" /begin FORMULA "((X1&(1<<21))!=0)" /end FORMULA /end COMPU_METHOD
/begin COMPU_METHOD dia_stLkuOn_mu8.Calculation "" FORM "%6.3" "" /begin FORMULA "((X1&(1<<5))!=0)" /end FORMULA /end COMPU_METHOD
/begin COMPU_METHOD dia_stQfkAwv_mu8.Calculation "" FORM "%6.3" "" /begin FORMULA "((X1&(1<<23))!=0)" /end FORMULA /end COMPU_METHOD
/begin COMPU_METHOD dia_stQfkDsr_mu8.Calculation "" FORM "%6.3" "" /begin FORMULA "((X1&(1<<25))!=0)" /end FORMULA /end COMPU_METHOD
/begin COMPU_METHOD dia_stQfkHca_mu8.Calculation "" FORM "%6.3" "" /begin FORMULA "((X1&(1<<24))!=0)" /end FORMULA /end COMPU_METHOD
/begin COMPU_METHOD dia_stQfkMa_mu8.Calculation "" FORM "%6.3" "" /begin FORMULA "((X1&(1<<27))!=0)" /end FORMULA /end COMPU_METHOD
/begin COMPU_METHOD dia_stQfkPla_mu8.Calculation "" FORM "%6.3" "" /begin FORMULA "((X1&(1<<22))!=0)" /end FORMULA /end COMPU_METHOD
/begin COMPU_METHOD dia_stReasonSpeed_mu8.CONVERSIONV "@@@@RuleName created by CANape" FORM "%3.1" "" /begin FORMULA "((X1==1)&&(X2==1))" /end FORMULA /end COMPU_METHOD
/begin COMPU_METHOD dia_stSysFehler_mu8.CONVERSIONV "@@@@RuleName created by CANape" FORM "%3.1" "" /begin FORMULA "(X1==7)" /end FORMULA /end COMPU_METHOD
/begin COMPU_METHOD dia_stTSCLearnAlgo_mu8.Conversion "" FORM "%6.3" "" /begin FORMULA "((X1&(1<<20))==(1<<20))" /end FORMULA /end COMPU_METHOD
/begin COMPU_METHOD dia_stTscAktiv_mu8.Conversion "" FORM "%6.3" "" /begin FORMULA "((X1&(1<<3))==(1<<3))" /end FORMULA /end COMPU_METHOD
/begin COMPU_METHOD dia_stUeberwachungRaddreh_mu8.CONVERSIONV "@@@@RuleName created by CANape" FORM "%3.1" "" /begin FORMULA "((X1&(1<<18))==(1<<18))" /end FORMULA /end COMPU_METHOD
/begin COMPU_METHOD dia_stXcpSchnittstelle_mu8.Calculation "" FORM "%6.3" "" /begin FORMULA "((X1&(1<<12))!=0)" /end FORMULA /end COMPU_METHOD
/begin COMPU_METHOD rou_iMaxSteerRange_mu16.Conversion "" FORM "%8.4" "mm" /begin FORMULA "X1 - X2" /end FORMULA /end COMPU_METHOD
/begin COMPU_METHOD rou_stOperationValidity_mu8.Conversion "" FORM "%6.3" "" /begin FORMULA "X1 | (X2 << 1) | (X3 << 2)" /end FORMULA /end COMPU_METHOD
/begin COMPU_METHOD sac_qap_stPrioToTnDsaTsc_mu16.CONVERSIONV "@@@@RuleName created by CANape" FORM "%3.1" "" /begin FORMULA "(X1<<8)|X2" /end FORMULA /end COMPU_METHOD
/begin UNIT Eps_Repository_CommunicationBusAbstractionVW_EpsInput_CompuMethods_ESP_02_Gierrate_Unit "" "Unit_DegreOfArcPerSecon" EXTENDED_SI /end UNIT
/begin UNIT Eps_Repository_CommunicationBusAbstractionVW_EpsInput_CompuMethods_ESP_02_Laengsbeschl_Unit "" "Unit_MeterPerSeconSquar" EXTENDED_SI /end UNIT
/begin UNIT Eps_Repository_CommunicationBusAbstractionVW_EpsInput_CompuMethods_ESP_02_Querbeschleunigung_Unit "" "Unit_ForceOfGravi" EXTENDED_SI /end UNIT
/begin UNIT Eps_Repository_CommunicationBusAbstractionVW_EpsInput_CompuMethods_ESP_05_Bremsdruck_Unit "" "Unit_Bar" EXTENDED_SI /end UNIT
/begin UNIT Eps_Repository_CommunicationBusAbstractionVW_EpsInput_CompuMethods_ESP_14_Anf_Lenkmomoffset_DSR_Unit "" "Unit_NewtoMeter" EXTENDED_SI /end UNIT
/begin UNIT Eps_Repository_CommunicationBusAbstractionVW_EpsInput_CompuMethods_ESP_19_HL_Radgeschw_02_Unit "" "Unit_KiloMeterPerHour" EXTENDED_SI /end UNIT
/begin UNIT Eps_Repository_CommunicationBusAbstractionVW_EpsInput_CompuMethods_ESP_19_HR_Radgeschw_02_Unit "" "Unit_KiloMeterPerHour" EXTENDED_SI /end UNIT
/begin UNIT Eps_Repository_CommunicationBusAbstractionVW_EpsInput_CompuMethods_ESP_19_VL_Radgeschw_02_Unit "" "Unit_KiloMeterPerHour" EXTENDED_SI /end UNIT
/begin UNIT Eps_Repository_CommunicationBusAbstractionVW_EpsInput_CompuMethods_ESP_19_VR_Radgeschw_02_Unit "" "Unit_KiloMeterPerHour" EXTENDED_SI /end UNIT
/begin UNIT Eps_Repository_CommunicationBusAbstractionVW_EpsInput_CompuMethods_ESP_Bremsdruck_Unit "" "Unit_Bar" EXTENDED_SI /end UNIT
/begin UNIT Eps_Repository_CommunicationBusAbstractionVW_EpsInput_CompuMethods_ESP_Gierrate_Unit "" "Unit_DegreOfArcPerSecon" EXTENDED_SI /end UNIT
/begin UNIT Eps_Repository_CommunicationBusAbstractionVW_EpsInput_CompuMethods_ESP_HL_Radgeschw_02_Unit "" "Unit_KiloMeterPerHour" EXTENDED_SI /end UNIT
/begin UNIT Eps_Repository_CommunicationBusAbstractionVW_EpsInput_CompuMethods_ESP_HR_Radgeschw_02_Unit "" "Unit_KiloMeterPerHour" EXTENDED_SI /end UNIT
/begin UNIT Eps_Repository_CommunicationBusAbstractionVW_EpsInput_CompuMethods_ESP_Laengsbeschl_Unit "" "Unit_MeterPerSeconSquar" EXTENDED_SI /end UNIT
/begin UNIT Eps_Repository_CommunicationBusAbstractionVW_EpsInput_CompuMethods_ESP_Querbeschleunigung_Unit "" "Unit_ForceOfGravi" EXTENDED_SI /end UNIT
/begin UNIT Eps_Repository_CommunicationBusAbstractionVW_EpsInput_CompuMethods_ESP_VL_Radgeschw_02_Unit "" "Unit_KiloMeterPerHour" EXTENDED_SI /end UNIT
/begin UNIT Eps_Repository_CommunicationBusAbstractionVW_EpsInput_CompuMethods_ESP_VR_Radgeschw_02_Unit "" "Unit_KiloMeterPerHour" EXTENDED_SI /end UNIT
/begin UNIT Eps_Repository_CommunicationBusAbstractionVW_EpsInput_CompuMethods_ESP_v_Signal_Unit "" "Unit_KiloMeterPerHour" EXTENDED_SI /end UNIT
/begin UNIT Eps_Repository_CommunicationBusAbstractionVW_EpsInput_CompuMethods_HCA_01_LM_Offset_Unit "" "Unit_NewtoMeter" EXTENDED_SI /end UNIT
/begin UNIT Eps_Repository_CommunicationBusAbstractionVW_EpsInput_CompuMethods_HCA_01_Vib_Amp_Unit "" "Unit_NewtoMeter" EXTENDED_SI /end UNIT
/begin UNIT Eps_Repository_CommunicationBusAbstractionVW_EpsInput_CompuMethods_HCA_01_Vib_Freq_Unit "" "Unit_Hertz" EXTENDED_SI /end UNIT
/begin UNIT Eps_Repository_CommunicationBusAbstractionVW_EpsInput_CompuMethods_HCA_QFK_KrSoll_Unit "" "Unit_MeterInver" EXTENDED_SI /end UNIT
/begin UNIT Eps_Repository_CommunicationBusAbstractionVW_EpsInput_CompuMethods_HCA_QFK_KruemmSoll_Unit "" "Unit_MeterInver" EXTENDED_SI /end UNIT
/begin UNIT Eps_Repository_CommunicationBusAbstractionVW_EpsInput_CompuMethods_HCA_QFK_Spuerb_Unit "" "Unit_PerCent" EXTENDED_SI /end UNIT
/begin UNIT Eps_Repository_CommunicationBusAbstractionVW_EpsInput_CompuMethods_KBI_Kilometerstand_Unit "" "Unit_KiloMeter" EXTENDED_SI /end UNIT
/begin UNIT Eps_Repository_CommunicationBusAbstractionVW_EpsInput_CompuMethods_KBI_angez_Geschw_Unit "" "Unit_KiloMeterPerHour" EXTENDED_SI /end UNIT
/begin UNIT Eps_Repository_CommunicationBusAbstractionVW_EpsInput_CompuMethods_MA_QFK_KruemmSoll_Unit "" "Unit_MeterInver" EXTENDED_SI /end UNIT
/begin UNIT Eps_Repository_CommunicationBusAbstractionVW_EpsInput_CompuMethods_MA_QFK_Spuerb_Unit "" "Unit_PerCent" EXTENDED_SI /end UNIT
/begin UNIT Eps_Repository_CommunicationBusAbstractionVW_EpsInput_CompuMethods_MO_20_Fahrpedalrohwert_01_Unit "" "Unit_PerCent" EXTENDED_SI /end UNIT
/begin UNIT Eps_Repository_CommunicationBusAbstractionVW_EpsInput_CompuMethods_MO_50_Drehzahl_01_Unit "" "Unit_MinutInver" EXTENDED_SI /end UNIT
/begin UNIT Eps_Repository_CommunicationBusAbstractionVW_EpsInput_CompuMethods_MO_Drehzahl_01_Unit "" "Unit_MinutInver" EXTENDED_SI /end UNIT
/begin UNIT Eps_Repository_CommunicationBusAbstractionVW_EpsInput_CompuMethods_MO_Fahrpedalrohwert_01_Unit "" "Unit_PerCent" EXTENDED_SI /end UNIT
/begin UNIT Eps_Repository_CommunicationBusAbstractionVW_EpsInput_CompuMethods_MO_Faktor_Momente_02_Unit "" "Unit_NewtoMeter" EXTENDED_SI /end UNIT
/begin UNIT Eps_Repository_CommunicationBusAbstractionVW_EpsInput_CompuMethods_PLA_LW_Soll_Unit "" "Unit_DegreOfArc" EXTENDED_SI /end UNIT
/begin UNIT Eps_Repository_CommunicationBusAbstractionVW_EpsInput_CompuMethods_PLA_QFK_KrSoll_Unit "" "Unit_MeterInver" EXTENDED_SI /end UNIT
/begin UNIT Eps_Repository_CommunicationBusAbstractionVW_EpsInput_CompuMethods_PLA_QFK_KruemmSoll_Unit "" "Unit_MeterInver" EXTENDED_SI /end UNIT
/begin UNIT Eps_Repository_CommunicationBusAbstractionVW_EpsInput_CompuMethods_PLA_QFK_Spuerb_Unit "" "Unit_PerCent" EXTENDED_SI /end UNIT
/begin UNIT Eps_Repository_CommunicationBusAbstractionVW_EpsInput_CompuMethods_QUER_Ist_Proz_Unit "" "Unit_PerCent" EXTENDED_SI /end UNIT
/begin UNIT Eps_Repository_CommunicationBusAbstractionVW_EpsInput_CompuMethods_RHP_QFK_KrSoll_Unit "" "Unit_MeterInver" EXTENDED_SI /end UNIT
/begin UNIT Eps_Repository_CommunicationBusAbstractionVW_EpsInput_CompuMethods_RHP_QFK_KruemmSoll_Unit "" "Unit_MeterInver" EXTENDED_SI /end UNIT
/begin UNIT Eps_Repository_CommunicationBusAbstractionVW_EpsInput_CompuMethods_RHP_QFK_Spuerb_Unit "" "Unit_PerCent" EXTENDED_SI /end UNIT
/begin UNIT Eps_Repository_CommunicationBusAbstractionVW_EpsInput_CompuMethods_SC_Masterzeit_Offset_Unit "" "Unit_Secon" EXTENDED_SI /end UNIT
/begin UNIT Eps_Repository_CommunicationBusAbstractionVW_EpsInput_CompuMethods_UH_Jahr_Unit "" "Unit_Year" EXTENDED_SI /end UNIT
/begin UNIT Eps_Repository_CommunicationBusAbstractionVW_EpsInput_CompuMethods_UH_Minute_Unit "" "Unit_Minut" EXTENDED_SI /end UNIT
/begin UNIT Eps_Repository_CommunicationBusAbstractionVW_EpsInput_CompuMethods_UH_Monat_Unit "" "Unit_Month" EXTENDED_SI /end UNIT
/begin UNIT Eps_Repository_CommunicationBusAbstractionVW_EpsInput_CompuMethods_UH_Sekunde_Unit "" "Unit_Secon" EXTENDED_SI /end UNIT
/begin UNIT Eps_Repository_CommunicationBusAbstractionVW_EpsInput_CompuMethods_UH_Stunde_Unit "" "Unit_Hours" EXTENDED_SI /end UNIT
/begin UNIT Eps_Repository_CommunicationBusAbstractionVW_EpsInput_CompuMethods_UH_Tag_Unit "" "Unit_Day" EXTENDED_SI /end UNIT
/begin UNIT Eps_Repository_CommunicationBusAbstractionVW_EpsInput_ImplementationDataTypes_NoUnit "No Unit" "-" EXTENDED_SI SI_EXPONENTS 0 0 0 0 0 0 0 /end UNIT
/begin UNIT Eps_Repository_CommunicationBusAbstractionVW_EpsOutput_CompuMethods_EPS_ASM_Data_1_Unit "" "Unit_None" EXTENDED_SI /end UNIT
/begin UNIT Eps_Repository_CommunicationBusAbstractionVW_EpsOutput_CompuMethods_EPS_ASM_Data_2_Unit "" "Unit_None" EXTENDED_SI /end UNIT
/begin UNIT Eps_Repository_CommunicationBusAbstractionVW_EpsOutput_CompuMethods_EPS_ASM_Data_3_Unit "" "Unit_None" EXTENDED_SI /end UNIT
/begin UNIT Eps_Repository_CommunicationBusAbstractionVW_EpsOutput_CompuMethods_EPS_ASM_Data_4_Unit "" "Unit_None" EXTENDED_SI /end UNIT
/begin UNIT Eps_Repository_CommunicationBusAbstractionVW_EpsOutput_CompuMethods_EPS_ASM_Data_5_Unit "" "Unit_None" EXTENDED_SI /end UNIT
/begin UNIT Eps_Repository_CommunicationBusAbstractionVW_EpsOutput_CompuMethods_EPS_ASM_Data_6_Unit "" "Unit_None" EXTENDED_SI /end UNIT
/begin UNIT Eps_Repository_CommunicationBusAbstractionVW_EpsOutput_CompuMethods_EPS_ASM_Ereignis_Unit "" "Unit_None" EXTENDED_SI /end UNIT
/begin UNIT Eps_Repository_CommunicationBusAbstractionVW_EpsOutput_CompuMethods_EPS_ASM_Zeitstempel_Unit "" "Unit_None" EXTENDED_SI /end UNIT
/begin UNIT Eps_Repository_CommunicationBusAbstractionVW_EpsOutput_CompuMethods_EPS_Berechneter_LW_Unit "" "Unit_DegreOfArc" EXTENDED_SI /end UNIT
/begin UNIT Eps_Repository_CommunicationBusAbstractionVW_EpsOutput_CompuMethods_EPS_CtlValQFK_Unit "" "Unit_PerCent" EXTENDED_SI /end UNIT
/begin UNIT Eps_Repository_CommunicationBusAbstractionVW_EpsOutput_CompuMethods_EPS_Drehzahlreserve_Unit "" "Unit_DegreOfArcPerSecon" EXTENDED_SI /end UNIT
/begin UNIT Eps_Repository_CommunicationBusAbstractionVW_EpsOutput_CompuMethods_EPS_IstKraft_Unit "" "Unit_Newto" EXTENDED_SI /end UNIT
/begin UNIT Eps_Repository_CommunicationBusAbstractionVW_EpsOutput_CompuMethods_EPS_Lastinfo_Unit "" "Unit_Amper" EXTENDED_SI /end UNIT
/begin UNIT Eps_Repository_CommunicationBusAbstractionVW_EpsOutput_CompuMethods_EPS_LdResv_Unit "" "Unit_PerCent" EXTENDED_SI /end UNIT
/begin UNIT Eps_Repository_CommunicationBusAbstractionVW_EpsOutput_CompuMethods_EPS_Lenkmoment_Unit "" "Unit_NewtoMeter" EXTENDED_SI /end UNIT
/begin UNIT Eps_Repository_CommunicationBusAbstractionVW_EpsOutput_CompuMethods_EPS_Unterstuetzungsleistung_Unit "" "Unit_PerCent" EXTENDED_SI /end UNIT
/begin UNIT Eps_Repository_CommunicationBusAbstractionVW_EpsOutput_CompuMethods_EPS_Versorgungsspannung_Unit "" "Unit_Volt" EXTENDED_SI /end UNIT
/begin UNIT Eps_Repository_CommunicationBusAbstractionVW_EpsOutput_CompuMethods_EPS_Zahnstangen_Grad_Unit "" "Unit_MeterPerSecon" EXTENDED_SI /end UNIT
/begin UNIT Eps_Repository_CommunicationBusAbstractionVW_EpsOutput_CompuMethods_EPS_Zahnstangen_Pos_02_Unit "" "Unit_MilliMeter" EXTENDED_SI /end UNIT
/begin UNIT Eps_Repository_CommunicationBusAbstractionVW_EpsOutput_CompuMethods_EPS_Zst_Offset_Geradeaus_Unit "" "Unit_MilliMeter" EXTENDED_SI /end UNIT
/begin UNIT Eps_Repository_CommunicationBusAbstractionVW_EpsOutput_CompuMethods_LWI_Lenkradw_Geschw_Unit "" "Unit_DegreOfArcPerSecon" EXTENDED_SI /end UNIT
/begin UNIT Eps_Repository_CommunicationBusAbstractionVW_EpsOutput_CompuMethods_LWI_Lenkradwinkel_Unit "" "Unit_DegreOfArc" EXTENDED_SI /end UNIT
/begin UNIT Eps_Repository_CommunicationBusAbstractionVW_EpsOutput_CompuMethods_NoUnit "No Unit" "-" EXTENDED_SI SI_EXPONENTS 0 0 0 0 0 0 0 /end UNIT
/begin UNIT Eps_Repository_CommunicationBusAbstractionVW_EpsOutput_CompuMethods_QFKS_Anf_Giermomoffset_Unit "" "Unit_NewtoMeter" EXTENDED_SI /end UNIT
/begin UNIT Eps_Repository_CommunicationBusAbstractionVW_EpsOutput_CompuMethods_QFKS_IstKraftNiveau_Unit "" "Unit_PerCent" EXTENDED_SI /end UNIT
/begin UNIT Eps_Repository_CommunicationBusAbstractionVW_EpsOutput_CompuMethods_QFKS_KruemmIst_Unit "" "Unit_MeterInver" EXTENDED_SI /end UNIT
/begin UNIT Eps_Repository_CommunicationBusAbstractionVW_EpsOutput_CompuMethods_QFKS_ZPosIst_Unit "" "Unit_MilliMeter" EXTENDED_SI /end UNIT
/begin UNIT Eps_Repository_CommunicationBusAbstractionVW_EpsOutput_CompuMethods_QFK_Anf_Giermomoffset_Unit "" "Unit_NewtoMeter" EXTENDED_SI /end UNIT
/begin UNIT Eps_Repository_CommunicationBusAbstractionVW_EpsOutput_CompuMethods_QFK_IstKraftErweitert_Unit "" "Unit_Newto" EXTENDED_SI /end UNIT
/begin UNIT Eps_Repository_CommunicationBusAbstractionVW_EpsOutput_CompuMethods_QFK_IstKraftNiveau_Unit "" "Unit_PerCent" EXTENDED_SI /end UNIT
/begin UNIT Eps_Repository_CommunicationBusAbstractionVW_EpsOutput_CompuMethods_QFK_IstKraft_Unit "" "Unit_Newto" EXTENDED_SI /end UNIT
/begin UNIT Eps_Repository_CommunicationBusAbstractionVW_EpsOutput_CompuMethods_QFK_KrIst_Unit "" "Unit_MeterInver" EXTENDED_SI /end UNIT
/begin UNIT Eps_Repository_CommunicationBusAbstractionVW_EpsOutput_CompuMethods_QFK_KruemmIst_Unit "" "Unit_MeterInver" EXTENDED_SI /end UNIT
/begin UNIT Eps_Repository_CommunicationBusAbstractionVW_EpsOutput_CompuMethods_QFK_SollKraft_Unit "" "Unit_Newto" EXTENDED_SI /end UNIT
/begin UNIT Eps_Repository_CommunicationBusAbstractionVW_EpsOutput_CompuMethods_QFK_ZPosIst_Unit "" "Unit_MilliMeter" EXTENDED_SI /end UNIT
/begin UNIT Eps_Repository_CommunicationBusAbstraction_EpsInputAbstraction_Units_U_deg "" "deg" EXTENDED_SI SI_EXPONENTS 0 0 0 0 0 0 0 /end UNIT
/begin UNIT Eps_Repository_CommunicationBusAbstraction_EpsInputAbstraction_Units_U_deg_s "" "deg_s" EXTENDED_SI SI_EXPONENTS 0 0 0 0 0 0 0 /end UNIT
/begin UNIT Eps_Repository_DiagServicesCustom_DiagSrv_Control_NvBlk_OBD_01_Unit_NoUnit "" "" EXTENDED_SI SI_EXPONENTS 0 0 0 0 0 0 0 /end UNIT
/begin UNIT Eps_Repository_ProductionServices_AZGSFDSecurity_CompuMethods_NoUnit "" "" EXTENDED_SI SI_EXPONENTS 0 0 0 0 0 0 0 /end UNIT
/begin UNIT Eps_Repository_ProductionServices_BootFlashHandler_Units_NoUnit "No Unit" "noUnit" EXTENDED_SI SI_EXPONENTS 0 0 0 0 0 0 0 /end UNIT
/begin UNIT Eps_Repository_ProductionServices_ProductionServices_L_Adapter_Units_KiloMtrPerHr "Kilo Meter" "km/h" EXTENDED_SI SI_EXPONENTS 1 0 -1 0 0 0 0 /end UNIT
/begin UNIT Eps_Repository_ProductionServices_ProductionUDS_Units_KiloMtrPerHr "Kilo Meter" "km/h" EXTENDED_SI SI_EXPONENTS 1 0 -1 0 0 0 0 /end UNIT
/begin UNIT Eps_Repository_ProductionServices_ProductionUDS_Units_NoUnit "No Unit" "noUnit" EXTENDED_SI SI_EXPONENTS 0 0 0 0 0 0 0 /end UNIT
/begin UNIT Eps_Repository_SecurityServices_SFD_Units_Km "Kilometer" "" EXTENDED_SI SI_EXPONENTS 1 0 0 0 0 0 0 /end UNIT
/begin UNIT Eps_Repository_ServoSlipDetection_ServoSlipVerifying_Unit_NoUnit "" "" EXTENDED_SI SI_EXPONENTS 0 0 0 0 0 0 0 /end UNIT
/begin UNIT Eps_Repository_SoftwareEndstop_EndStopSupp_Unit_NoUnit "" "" EXTENDED_SI SI_EXPONENTS 0 0 0 0 0 0 0 /end UNIT
/begin UNIT Eps_Repository_SoftwareMaintenance_SwCompatibilityCheck_Unit_NoUnit "" "" EXTENDED_SI SI_EXPONENTS 0 0 0 0 0 0 0 /end UNIT
/begin UNIT Eps_Repository_StateManagement_ApplicationStateMachineSupp_Unit_NoUnit "" "" EXTENDED_SI SI_EXPONENTS 0 0 0 0 0 0 0 /end UNIT
/begin UNIT FlashHandler_Units_NoUnit "No Unit" "noUnit" EXTENDED_SI SI_EXPONENTS 0 0 0 0 0 0 0 /end UNIT
/begin UNIT MQB_W37_ZPC_ASC_SAC_Void "" "Void" EXTENDED_SI SI_EXPONENTS 0 0 0 0 0 0 0 /end UNIT
/begin UNIT Mcan_Can_Units_NoUnit "No Unit" "noUnit" EXTENDED_SI SI_EXPONENTS 0 0 0 0 0 0 0 /end UNIT
/begin UNIT RB_RBA_Common_CentralElements_Units_NoUnit "No Unit" "noUnit" EXTENDED_SI SI_EXPONENTS 0 0 0 0 0 0 0 /end UNIT
/begin UNIT RB_RBA_rba_MemLib_Units_Mem_NoUnit "Mem No Unit / 1:1 / Identical" "Mem_NoUnit" EXTENDED_SI SI_EXPONENTS 0 0 0 0 0 0 0 /end UNIT
/begin UNIT Systems_MQB2020_MEB_E3_RWI_FCan1_DataTypes_AIS_FacStgTqSsty_Unit "" "Unit_PerCent" EXTENDED_SI /end UNIT
/begin UNIT Systems_MQB2020_MEB_E3_RWI_FCan1_DataTypes_AIS_StgRackPosnFr_Unit "" "Unit_MilliMeter" EXTENDED_SI /end UNIT
/begin UNIT Systems_MQB2020_MEB_E3_RWI_FCan1_DataTypes_AIS_TiIntpPosnCtlFr_Unit "" "Unit_MilliSecon" EXTENDED_SI /end UNIT
/begin UNIT Systems_MQB2020_MEB_E3_RWI_FCan1_DataTypes_ALR_Ist_Proz_Unit "" "Unit_PerCent" EXTENDED_SI /end UNIT
/begin UNIT Systems_MQB2020_MEB_E3_RWI_FCan1_DataTypes_ASM_Masterzeit_Unit "" "Unit_Secon" EXTENDED_SI /end UNIT
/begin UNIT Systems_MQB2020_MEB_E3_RWI_FCan1_DataTypes_AWV_AWA_Anf_Lenkmomoffset_Unit "" "Unit_NewtoMeter" EXTENDED_SI /end UNIT
/begin UNIT Systems_MQB2020_MEB_E3_RWI_FCan1_DataTypes_AWV_QFK_KrSoll_Unit "" "Unit_MeterInver" EXTENDED_SI /end UNIT
/begin UNIT Systems_MQB2020_MEB_E3_RWI_FCan1_DataTypes_AWV_QFK_KruemmSoll_Unit "" "Unit_MeterInver" EXTENDED_SI /end UNIT
/begin UNIT Systems_MQB2020_MEB_E3_RWI_FCan1_DataTypes_AWV_QFK_Spuerb_Unit "" "Unit_PerCent" EXTENDED_SI /end UNIT
/begin UNIT Systems_MQB2020_MEB_E3_RWI_FCan1_DataTypes_DSR_QFK_KrSoll_Unit "" "Unit_MeterInver" EXTENDED_SI /end UNIT
/begin UNIT Systems_MQB2020_MEB_E3_RWI_FCan1_DataTypes_DSR_QFK_KruemmSoll_Unit "" "Unit_MeterInver" EXTENDED_SI /end UNIT
/begin UNIT Systems_MQB2020_MEB_E3_RWI_FCan1_DataTypes_DSR_QFK_Spuerb_Unit "" "Unit_PerCent" EXTENDED_SI /end UNIT
/begin UNIT Systems_MQB2020_MEB_E3_RWI_FCan1_DataTypes_DTMP_01_QFK_ZPosSoll_Unit "" "Unit_Millimeter" EXTENDED_SI /end UNIT
/begin UNIT Systems_MQB2020_MEB_E3_RWI_FCan1_DataTypes_DTMP_01__QFK_ZPosSoll_Unit "" "Unit_Millimeter" EXTENDED_SI /end UNIT
/begin UNIT Systems_MQB2020_MEB_E3_RWI_FCan1_DataTypes_DTMS_01_QFK_ZPosSoll_Unit "" "Unit_Millimeter" EXTENDED_SI /end UNIT
/begin UNIT Systems_MQB2020_MEB_E3_RWI_FCan1_DataTypes_EID_Handmorm_TorqueState_Unit "" "Nm" EXTENDED_SI /end UNIT
/begin UNIT Systems_MQB2020_MEB_E3_RWI_FCan1_DataTypes_EID_Handmorm_TorsionBarTorque_2_Unit "" "Nm" EXTENDED_SI /end UNIT
/begin UNIT Systems_MQB2020_MEB_E3_RWI_FCan1_DataTypes_EID_Handmorm_TorsionBarTorque_Unit "" "Nm" EXTENDED_SI /end UNIT
/begin UNIT Systems_MQB2020_MEB_E3_RWI_FCan1_DataTypes_EID_LW_EndStop_RackPosMax_Unit "" "mm" EXTENDED_SI /end UNIT
/begin UNIT Systems_MQB2020_MEB_E3_RWI_FCan1_DataTypes_EID_LW_EndStop_RackPosMin_Unit "" "mm" EXTENDED_SI /end UNIT
/begin UNIT Systems_MQB2020_MEB_E3_RWI_FCan1_DataTypes_EID_LW_RackPosition_Unit "" "mm" EXTENDED_SI /end UNIT
/begin UNIT Systems_MQB2020_MEB_E3_RWI_FCan1_DataTypes_EID_LW_SteeringAngleSpeed_Unit "" "?/s" EXTENDED_SI /end UNIT
/begin UNIT Systems_MQB2020_MEB_E3_RWI_FCan1_DataTypes_EID_LW_SteeringAngleSpeed_korr_Unit "" "?/s" EXTENDED_SI /end UNIT
/begin UNIT Systems_MQB2020_MEB_E3_RWI_FCan1_DataTypes_EID_MotPos_RotorSpeedFilt_Unit "" "rpm" EXTENDED_SI /end UNIT
/begin UNIT Systems_MQB2020_MEB_E3_RWI_FCan1_DataTypes_EID_Motorm_HLCharCurveBuckleFact_Unit "" "NoUnit" EXTENDED_SI /end UNIT
/begin UNIT Systems_MQB2020_MEB_E3_RWI_FCan1_DataTypes_EID_Motorm_HLMaxTorqueGradient_Unit "" "Nm/ms" EXTENDED_SI /end UNIT
/begin UNIT Systems_MQB2020_MEB_E3_RWI_FCan1_DataTypes_EID_Motorm_LimMotTorFactor_Unit "" "NoUnit" EXTENDED_SI /end UNIT
/begin UNIT Systems_MQB2020_MEB_E3_RWI_FCan1_DataTypes_EID_Motorm_LimitedMotorTorque_Unit "" "Nm" EXTENDED_SI /end UNIT
/begin UNIT Systems_MQB2020_MEB_E3_RWI_FCan1_DataTypes_EID_Motorm_MotTorLimI_WID_Unit "" "NoUnit" EXTENDED_SI /end UNIT
/begin UNIT Systems_MQB2020_MEB_E3_RWI_FCan1_DataTypes_EID_Motorm_NominalMotorTorque_Unit "" "Nm" EXTENDED_SI /end UNIT
/begin UNIT Systems_MQB2020_MEB_E3_RWI_FCan1_DataTypes_EID_Motorm_RequestedMotorTorque_Unit "" "Nm" EXTENDED_SI /end UNIT
/begin UNIT Systems_MQB2020_MEB_E3_RWI_FCan1_DataTypes_EID_Strom_Bat_Current_Unit "" "A" EXTENDED_SI /end UNIT
/begin UNIT Systems_MQB2020_MEB_E3_RWI_FCan1_DataTypes_EID_Strom_PhaseCurrentUI_Unit "" "A" EXTENDED_SI /end UNIT
/begin UNIT Systems_MQB2020_MEB_E3_RWI_FCan1_DataTypes_EID_Strom_PhaseCurrentVI_Unit "" "A" EXTENDED_SI /end UNIT
/begin UNIT Systems_MQB2020_MEB_E3_RWI_FCan1_DataTypes_EID_Strom_PhaseCurrentWI_Unit "" "A" EXTENDED_SI /end UNIT
/begin UNIT Systems_MQB2020_MEB_E3_RWI_FCan1_DataTypes_EID_Temp_BoardTemp_Unit "" "?C" EXTENDED_SI /end UNIT
/begin UNIT Systems_MQB2020_MEB_E3_RWI_FCan1_DataTypes_EID_Temp_CoilTemp_Unit "" "?C" EXTENDED_SI /end UNIT
/begin UNIT Systems_MQB2020_MEB_E3_RWI_FCan1_DataTypes_EID_Temp_DcLinkCapDeltaTemp_Unit "" "?C" EXTENDED_SI /end UNIT
/begin UNIT Systems_MQB2020_MEB_E3_RWI_FCan1_DataTypes_EID_Temp_DcLinkCapTemp_Unit "" "?C" EXTENDED_SI /end UNIT
/begin UNIT Systems_MQB2020_MEB_E3_RWI_FCan1_DataTypes_EID_Temp_GroundPlateTemp_Unit "" "?C" EXTENDED_SI /end UNIT
/begin UNIT Systems_MQB2020_MEB_E3_RWI_FCan1_DataTypes_EID_Temp_Hwl_TorqueRedLevel_CU_Unit "" "%" EXTENDED_SI /end UNIT
/begin UNIT Systems_MQB2020_MEB_E3_RWI_FCan1_DataTypes_EID_Temp_Hwl_TorqueRedLevel_Cap_Unit "" "%" EXTENDED_SI /end UNIT
/begin UNIT Systems_MQB2020_MEB_E3_RWI_FCan1_DataTypes_EID_Temp_Hwl_TorqueRedLevel_Mot_Unit "" "%" EXTENDED_SI /end UNIT
/begin UNIT Systems_MQB2020_MEB_E3_RWI_FCan1_DataTypes_EID_Temp_Hwl_TorqueRedLevel_Outp_Unit "" "%" EXTENDED_SI /end UNIT
/begin UNIT Systems_MQB2020_MEB_E3_RWI_FCan1_DataTypes_EID_Temp_Hwl_TrqRedLevel_Board_Unit "" "%" EXTENDED_SI /end UNIT
/begin UNIT Systems_MQB2020_MEB_E3_RWI_FCan1_DataTypes_EID_Temp_Hwl_TrqRedLevel_FetTemp_Unit "" "%" EXTENDED_SI /end UNIT
/begin UNIT Systems_MQB2020_MEB_E3_RWI_FCan1_DataTypes_EID_Temp_Outstage_Unit "" "?C" EXTENDED_SI /end UNIT
/begin UNIT Systems_MQB2020_MEB_E3_RWI_FCan1_DataTypes_EID_Temp_TempCo_U_Unit "" "?C" EXTENDED_SI /end UNIT
/begin UNIT Systems_MQB2020_MEB_E3_RWI_FCan1_DataTypes_EID_Temp_TempCo_V_Unit "" "?C" EXTENDED_SI /end UNIT
/begin UNIT Systems_MQB2020_MEB_E3_RWI_FCan1_DataTypes_EID_Temp_TempCo_W_Unit "" "?C" EXTENDED_SI /end UNIT
/begin UNIT Systems_MQB2020_MEB_E3_RWI_FCan1_DataTypes_EID_Temp_TempHs_U_Unit "" "?C" EXTENDED_SI /end UNIT
/begin UNIT Systems_MQB2020_MEB_E3_RWI_FCan1_DataTypes_EID_Temp_TempHs_V_Unit "" "?C" EXTENDED_SI /end UNIT
/begin UNIT Systems_MQB2020_MEB_E3_RWI_FCan1_DataTypes_EID_Temp_TempHs_W_Unit "" "?C" EXTENDED_SI /end UNIT
/begin UNIT Systems_MQB2020_MEB_E3_RWI_FCan1_DataTypes_EID_Temp_TempLs_U_Unit "" "?C" EXTENDED_SI /end UNIT
/begin UNIT Systems_MQB2020_MEB_E3_RWI_FCan1_DataTypes_EID_Temp_TempLs_V_Unit "" "?C" EXTENDED_SI /end UNIT
/begin UNIT Systems_MQB2020_MEB_E3_RWI_FCan1_DataTypes_EID_Temp_TempLs_W_Unit "" "?C" EXTENDED_SI /end UNIT
/begin UNIT Systems_MQB2020_MEB_E3_RWI_FCan1_DataTypes_EID_Temp_TempRp_Unit "" "?C" EXTENDED_SI /end UNIT
/begin UNIT Systems_MQB2020_MEB_E3_RWI_FCan1_DataTypes_EID_Temp_UcTemp_Unit "" "?C" EXTENDED_SI /end UNIT
/begin UNIT Systems_MQB2020_MEB_E3_RWI_FCan1_DataTypes_EID_Testpl_BoardTemp_Unit "" "?C" EXTENDED_SI /end UNIT
/begin UNIT Systems_MQB2020_MEB_E3_RWI_FCan1_DataTypes_EID_Testpl_motor_torque_setpoint_Unit "" "Nm" EXTENDED_SI /end UNIT
/begin UNIT Systems_MQB2020_MEB_E3_RWI_FCan1_DataTypes_EID_Testpl_rotor_speed_Unit "" "rpm" EXTENDED_SI /end UNIT
/begin UNIT Systems_MQB2020_MEB_E3_RWI_FCan1_DataTypes_EID_Testpl_torsionbar_torque_Unit "" "Nm" EXTENDED_SI /end UNIT
/begin UNIT Systems_MQB2020_MEB_E3_RWI_FCan1_DataTypes_EID_Volt_Act_RedLevel_StateM_Unit "" "NoUnit" EXTENDED_SI /end UNIT
/begin UNIT Systems_MQB2020_MEB_E3_RWI_FCan1_DataTypes_EID_Volt_Act_RedLevel_Untersp_Unit "" "NoUnit" EXTENDED_SI /end UNIT
/begin UNIT Systems_MQB2020_MEB_E3_RWI_FCan1_DataTypes_EID_Volt_Hwl_RedLevel_Uebersp_Unit "" "%" EXTENDED_SI /end UNIT
/begin UNIT Systems_MQB2020_MEB_E3_RWI_FCan1_DataTypes_EID_Volt_Hwl_RedLevel_Untersp_Unit "" "%" EXTENDED_SI /end UNIT
/begin UNIT Systems_MQB2020_MEB_E3_RWI_FCan1_DataTypes_EID_Volt_SupplyVolt_SupplyVoltag_Unit "" "V" EXTENDED_SI /end UNIT
/begin UNIT Systems_MQB2020_MEB_E3_RWI_FCan1_DataTypes_EID_intFzGr_AbsVehicleSpeedFilt_Unit "" "km/h" EXTENDED_SI /end UNIT
/begin UNIT Systems_MQB2020_MEB_E3_RWI_FCan1_DataTypes_EID_intFzGr_EngineSpeed_Unit "" "rpm" EXTENDED_SI /end UNIT
/begin UNIT Systems_MQB2020_MEB_E3_RWI_FCan1_DataTypes_EPS_ASM_Data_1_Unit "" "Unit_None" EXTENDED_SI /end UNIT
/begin UNIT Systems_MQB2020_MEB_E3_RWI_FCan1_DataTypes_EPS_ASM_Data_2_Unit "" "Unit_None" EXTENDED_SI /end UNIT
/begin UNIT Systems_MQB2020_MEB_E3_RWI_FCan1_DataTypes_EPS_ASM_Data_3_Unit "" "Unit_None" EXTENDED_SI /end UNIT
/begin UNIT Systems_MQB2020_MEB_E3_RWI_FCan1_DataTypes_EPS_ASM_Data_4_Unit "" "Unit_None" EXTENDED_SI /end UNIT
/begin UNIT Systems_MQB2020_MEB_E3_RWI_FCan1_DataTypes_EPS_ASM_Data_5_Unit "" "Unit_None" EXTENDED_SI /end UNIT
/begin UNIT Systems_MQB2020_MEB_E3_RWI_FCan1_DataTypes_EPS_ASM_Data_6_Unit "" "Unit_None" EXTENDED_SI /end UNIT
/begin UNIT Systems_MQB2020_MEB_E3_RWI_FCan1_DataTypes_EPS_ASM_Ereignis_Unit "" "Unit_None" EXTENDED_SI /end UNIT
/begin UNIT Systems_MQB2020_MEB_E3_RWI_FCan1_DataTypes_EPS_ASM_Zeitstempel_Unit "" "Unit_None" EXTENDED_SI /end UNIT
/begin UNIT Systems_MQB2020_MEB_E3_RWI_FCan1_DataTypes_EPS_Berechneter_LW_Unit "" "Unit_DegreOfArc" EXTENDED_SI /end UNIT
/begin UNIT Systems_MQB2020_MEB_E3_RWI_FCan1_DataTypes_EPS_CtlValQFK_Unit "" "Unit_PerCent" EXTENDED_SI /end UNIT
/begin UNIT Systems_MQB2020_MEB_E3_RWI_FCan1_DataTypes_EPS_Drehzahlreserve_Unit "" "Unit_DegreOfArcPerSecon" EXTENDED_SI /end UNIT
/begin UNIT Systems_MQB2020_MEB_E3_RWI_FCan1_DataTypes_EPS_IstKraft_Unit "" "Unit_Newto" EXTENDED_SI /end UNIT
/begin UNIT Systems_MQB2020_MEB_E3_RWI_FCan1_DataTypes_EPS_Lastinfo_Unit "" "Unit_Amper" EXTENDED_SI /end UNIT
/begin UNIT Systems_MQB2020_MEB_E3_RWI_FCan1_DataTypes_EPS_LdResv_Unit "" "Unit_PerCent" EXTENDED_SI /end UNIT
/begin UNIT Systems_MQB2020_MEB_E3_RWI_FCan1_DataTypes_EPS_Lenkmoment_Unit "" "Unit_NewtoMeter" EXTENDED_SI /end UNIT
/begin UNIT Systems_MQB2020_MEB_E3_RWI_FCan1_DataTypes_EPS_Status_Lenkmoment_Unit "" "Nm" EXTENDED_SI /end UNIT
/begin UNIT Systems_MQB2020_MEB_E3_RWI_FCan1_DataTypes_EPS_Status_PhiRitzel_Unit "" "Â?" EXTENDED_SI /end UNIT
/begin UNIT Systems_MQB2020_MEB_E3_RWI_FCan1_DataTypes_EPS_Status_PhvRitzel_Unit "" "Â?" EXTENDED_SI /end UNIT
/begin UNIT Systems_MQB2020_MEB_E3_RWI_FCan1_DataTypes_EPS_Temp_ECU_Unit "" "Unit_DegreCelsi" EXTENDED_SI /end UNIT
/begin UNIT Systems_MQB2020_MEB_E3_RWI_FCan1_DataTypes_EPS_Unterstuetzungsleistung_Unit "" "Unit_PerCent" EXTENDED_SI /end UNIT
/begin UNIT Systems_MQB2020_MEB_E3_RWI_FCan1_DataTypes_EPS_Versorgungsspannung_Unit "" "Unit_Volt" EXTENDED_SI /end UNIT
/begin UNIT Systems_MQB2020_MEB_E3_RWI_FCan1_DataTypes_EPS_Zahnstangen_Grad_Unit "" "Unit_MeterPerSecon" EXTENDED_SI /end UNIT
/begin UNIT Systems_MQB2020_MEB_E3_RWI_FCan1_DataTypes_EPS_Zahnstangen_Pos_02_Unit "" "Unit_MilliMeter" EXTENDED_SI /end UNIT
/begin UNIT Systems_MQB2020_MEB_E3_RWI_FCan1_DataTypes_EPS_Zst_Offset_Geradeaus_Unit "" "Unit_MilliMeter" EXTENDED_SI /end UNIT
/begin UNIT Systems_MQB2020_MEB_E3_RWI_FCan1_DataTypes_ESC_Lenkuebersetzung_x_1_Unit "" "Unit_DegreOfArc" EXTENDED_SI /end UNIT
/begin UNIT Systems_MQB2020_MEB_E3_RWI_FCan1_DataTypes_ESC_Lenkuebersetzung_x_2_Unit "" "Unit_DegreOfArc" EXTENDED_SI /end UNIT
/begin UNIT Systems_MQB2020_MEB_E3_RWI_FCan1_DataTypes_ESC_Lenkuebersetzung_x_3_Unit "" "Unit_DegreOfArc" EXTENDED_SI /end UNIT
/begin UNIT Systems_MQB2020_MEB_E3_RWI_FCan1_DataTypes_ESC_Lenkuebersetzung_x_4_Unit "" "Unit_DegreOfArc" EXTENDED_SI /end UNIT
/begin UNIT Systems_MQB2020_MEB_E3_RWI_FCan1_DataTypes_ESC_Lenkuebersetzung_x_5_Unit "" "Unit_DegreOfArc" EXTENDED_SI /end UNIT
/begin UNIT Systems_MQB2020_MEB_E3_RWI_FCan1_DataTypes_ESC_Radstand_Unit "" "Unit_Meter" EXTENDED_SI /end UNIT
/begin UNIT Systems_MQB2020_MEB_E3_RWI_FCan1_DataTypes_ESP_02_Gierrate_Unit "" "Unit_DegreOfArcPerSecon" EXTENDED_SI /end UNIT
/begin UNIT Systems_MQB2020_MEB_E3_RWI_FCan1_DataTypes_ESP_02_Laengsbeschl_Unit "" "Unit_MeterPerSeconSquar" EXTENDED_SI /end UNIT
/begin UNIT Systems_MQB2020_MEB_E3_RWI_FCan1_DataTypes_ESP_02_Querbeschleunigung_Unit "" "Unit_ForceOfGravi" EXTENDED_SI /end UNIT
/begin UNIT Systems_MQB2020_MEB_E3_RWI_FCan1_DataTypes_ESP_05_Bremsdruck_Unit "" "Unit_Bar" EXTENDED_SI /end UNIT
/begin UNIT Systems_MQB2020_MEB_E3_RWI_FCan1_DataTypes_ESP_14_Anf_Lenkmomoffset_DSR_Unit "" "Unit_NewtoMeter" EXTENDED_SI /end UNIT
/begin UNIT Systems_MQB2020_MEB_E3_RWI_FCan1_DataTypes_ESP_19_HL_Radgeschw_02_Unit "" "Unit_KiloMeterPerHour" EXTENDED_SI /end UNIT
/begin UNIT Systems_MQB2020_MEB_E3_RWI_FCan1_DataTypes_ESP_19_HR_Radgeschw_02_Unit "" "Unit_KiloMeterPerHour" EXTENDED_SI /end UNIT
/begin UNIT Systems_MQB2020_MEB_E3_RWI_FCan1_DataTypes_ESP_19_VL_Radgeschw_02_Unit "" "Unit_KiloMeterPerHour" EXTENDED_SI /end UNIT
/begin UNIT Systems_MQB2020_MEB_E3_RWI_FCan1_DataTypes_ESP_19_VR_Radgeschw_02_Unit "" "Unit_KiloMeterPerHour" EXTENDED_SI /end UNIT
/begin UNIT Systems_MQB2020_MEB_E3_RWI_FCan1_DataTypes_ESP_Bremsdruck_Unit "" "Unit_Bar" EXTENDED_SI /end UNIT
/begin UNIT Systems_MQB2020_MEB_E3_RWI_FCan1_DataTypes_ESP_Gierrate_Unit "" "Unit_DegreOfArcPerSecon" EXTENDED_SI /end UNIT
/begin UNIT Systems_MQB2020_MEB_E3_RWI_FCan1_DataTypes_ESP_HL_Radgeschw_02_Unit "" "Unit_KiloMeterPerHour" EXTENDED_SI /end UNIT
/begin UNIT Systems_MQB2020_MEB_E3_RWI_FCan1_DataTypes_ESP_HR_Radgeschw_02_Unit "" "Unit_KiloMeterPerHour" EXTENDED_SI /end UNIT
/begin UNIT Systems_MQB2020_MEB_E3_RWI_FCan1_DataTypes_ESP_Laengsbeschl_Unit "" "Unit_MeterPerSeconSquar" EXTENDED_SI /end UNIT
/begin UNIT Systems_MQB2020_MEB_E3_RWI_FCan1_DataTypes_ESP_Querbeschleunigung_Unit "" "Unit_ForceOfGravi" EXTENDED_SI /end UNIT
/begin UNIT Systems_MQB2020_MEB_E3_RWI_FCan1_DataTypes_ESP_VL_Radgeschw_02_Unit "" "Unit_KiloMeterPerHour" EXTENDED_SI /end UNIT
/begin UNIT Systems_MQB2020_MEB_E3_RWI_FCan1_DataTypes_ESP_VR_Radgeschw_02_Unit "" "Unit_KiloMeterPerHour" EXTENDED_SI /end UNIT
/begin UNIT Systems_MQB2020_MEB_E3_RWI_FCan1_DataTypes_ESP_v_Signal_Unit "" "Unit_KiloMeterPerHour" EXTENDED_SI /end UNIT
/begin UNIT Systems_MQB2020_MEB_E3_RWI_FCan1_DataTypes_HCA_01_LM_Offset_Unit "" "Unit_NewtoMeter" EXTENDED_SI /end UNIT
/begin UNIT Systems_MQB2020_MEB_E3_RWI_FCan1_DataTypes_HCA_01_Vib_Amp_Unit "" "Unit_NewtoMeter" EXTENDED_SI /end UNIT
/begin UNIT Systems_MQB2020_MEB_E3_RWI_FCan1_DataTypes_HCA_01_Vib_Freq_Unit "" "Unit_Hertz" EXTENDED_SI /end UNIT
/begin UNIT Systems_MQB2020_MEB_E3_RWI_FCan1_DataTypes_HCA_QFK_KrSoll_Unit "" "Unit_MeterInver" EXTENDED_SI /end UNIT
/begin UNIT Systems_MQB2020_MEB_E3_RWI_FCan1_DataTypes_HCA_QFK_KruemmSoll_Unit "" "Unit_MeterInver" EXTENDED_SI /end UNIT
/begin UNIT Systems_MQB2020_MEB_E3_RWI_FCan1_DataTypes_HCA_QFK_Spuerb_Unit "" "Unit_PerCent" EXTENDED_SI /end UNIT
/begin UNIT Systems_MQB2020_MEB_E3_RWI_FCan1_DataTypes_KBI_Kilometerstand_Unit "" "Unit_KiloMeter" EXTENDED_SI /end UNIT
/begin UNIT Systems_MQB2020_MEB_E3_RWI_FCan1_DataTypes_KBI_angez_Geschw_Unit "" "Unit_KiloMeterPerHour" EXTENDED_SI /end UNIT
/begin UNIT Systems_MQB2020_MEB_E3_RWI_FCan1_DataTypes_LWI_Lenkradw_Geschw_Unit "" "Unit_DegreOfArcPerSecon" EXTENDED_SI /end UNIT
/begin UNIT Systems_MQB2020_MEB_E3_RWI_FCan1_DataTypes_LWI_Lenkradwinkel_Unit "" "Unit_DegreOfArc" EXTENDED_SI /end UNIT
/begin UNIT Systems_MQB2020_MEB_E3_RWI_FCan1_DataTypes_MA_QFK_KruemmSoll_Unit "" "Unit_MeterInver" EXTENDED_SI /end UNIT
/begin UNIT Systems_MQB2020_MEB_E3_RWI_FCan1_DataTypes_MA_QFK_Spuerb_Unit "" "Unit_PerCent" EXTENDED_SI /end UNIT
/begin UNIT Systems_MQB2020_MEB_E3_RWI_FCan1_DataTypes_MO_20_Fahrpedalrohwert_01_Unit "" "Unit_PerCent" EXTENDED_SI /end UNIT
/begin UNIT Systems_MQB2020_MEB_E3_RWI_FCan1_DataTypes_MO_50_Drehzahl_01_Unit "" "Unit_MinutInver" EXTENDED_SI /end UNIT
/begin UNIT Systems_MQB2020_MEB_E3_RWI_FCan1_DataTypes_MO_Drehzahl_01_Unit "" "Unit_MinutInver" EXTENDED_SI /end UNIT
/begin UNIT Systems_MQB2020_MEB_E3_RWI_FCan1_DataTypes_MO_Fahrpedalrohwert_01_Unit "" "Unit_PerCent" EXTENDED_SI /end UNIT
/begin UNIT Systems_MQB2020_MEB_E3_RWI_FCan1_DataTypes_MO_Faktor_Momente_02_Unit "" "Unit_NewtoMeter" EXTENDED_SI /end UNIT
/begin UNIT Systems_MQB2020_MEB_E3_RWI_FCan1_DataTypes_PLA_LW_Soll_Unit "" "Unit_DegreOfArc" EXTENDED_SI /end UNIT
/begin UNIT Systems_MQB2020_MEB_E3_RWI_FCan1_DataTypes_PLA_QFK_KrSoll_Unit "" "Unit_MeterInver" EXTENDED_SI /end UNIT
/begin UNIT Systems_MQB2020_MEB_E3_RWI_FCan1_DataTypes_PLA_QFK_KruemmSoll_Unit "" "Unit_MeterInver" EXTENDED_SI /end UNIT
/begin UNIT Systems_MQB2020_MEB_E3_RWI_FCan1_DataTypes_PLA_QFK_Spuerb_Unit "" "Unit_PerCent" EXTENDED_SI /end UNIT
/begin UNIT Systems_MQB2020_MEB_E3_RWI_FCan1_DataTypes_QFK_Anf_Giermomoffset_Unit "" "Unit_NewtoMeter" EXTENDED_SI /end UNIT
/begin UNIT Systems_MQB2020_MEB_E3_RWI_FCan1_DataTypes_QFK_IstKraftErweitert_Unit "" "Unit_Newto" EXTENDED_SI /end UNIT
/begin UNIT Systems_MQB2020_MEB_E3_RWI_FCan1_DataTypes_QFK_IstKraftNiveau_Unit "" "Unit_PerCent" EXTENDED_SI /end UNIT
/begin UNIT Systems_MQB2020_MEB_E3_RWI_FCan1_DataTypes_QFK_IstKraft_Unit "" "Unit_Newto" EXTENDED_SI /end UNIT
/begin UNIT Systems_MQB2020_MEB_E3_RWI_FCan1_DataTypes_QFK_KrIst_Unit "" "Unit_MeterInver" EXTENDED_SI /end UNIT
/begin UNIT Systems_MQB2020_MEB_E3_RWI_FCan1_DataTypes_QFK_KruemmIst_Unit "" "Unit_MeterInver" EXTENDED_SI /end UNIT
/begin UNIT Systems_MQB2020_MEB_E3_RWI_FCan1_DataTypes_QFK_SollKraft_Unit "" "Unit_Newto" EXTENDED_SI /end UNIT
/begin UNIT Systems_MQB2020_MEB_E3_RWI_FCan1_DataTypes_QFK_ZPosIst_Unit "" "Unit_MilliMeter" EXTENDED_SI /end UNIT
/begin UNIT Systems_MQB2020_MEB_E3_RWI_FCan1_DataTypes_QUER_Ist_Proz_Unit "" "Unit_PerCent" EXTENDED_SI /end UNIT
/begin UNIT Systems_MQB2020_MEB_E3_RWI_FCan1_DataTypes_RHP_QFK_KrSoll_Unit "" "Unit_MeterInver" EXTENDED_SI /end UNIT
/begin UNIT Systems_MQB2020_MEB_E3_RWI_FCan1_DataTypes_RHP_QFK_KruemmSoll_Unit "" "Unit_MeterInver" EXTENDED_SI /end UNIT
/begin UNIT Systems_MQB2020_MEB_E3_RWI_FCan1_DataTypes_RHP_QFK_Spuerb_Unit "" "Unit_PerCent" EXTENDED_SI /end UNIT
/begin UNIT Systems_MQB2020_MEB_E3_RWI_FCan1_DataTypes_SC_Masterzeit_Offset_Unit "" "Unit_Secon" EXTENDED_SI /end UNIT
/begin UNIT Systems_MQB2020_MEB_E3_RWI_FCan1_DataTypes_SOK_AWV_03_Signatur_Unit "" "Unit_None" EXTENDED_SI /end UNIT
/begin UNIT Systems_MQB2020_MEB_E3_RWI_FCan1_DataTypes_SOK_DSR_01_Signatur_Unit "" "Unit_None" EXTENDED_SI /end UNIT
/begin UNIT Systems_MQB2020_MEB_E3_RWI_FCan1_DataTypes_SOK_ESC_53_Signatur_Unit "" "Unit_None" EXTENDED_SI /end UNIT
/begin UNIT Systems_MQB2020_MEB_E3_RWI_FCan1_DataTypes_SOK_HCA_03_Signatur_Unit "" "Unit_None" EXTENDED_SI /end UNIT
/begin UNIT Systems_MQB2020_MEB_E3_RWI_FCan1_DataTypes_SOK_MA_01_Signatur_Unit "" "Unit_None" EXTENDED_SI /end UNIT
/begin UNIT Systems_MQB2020_MEB_E3_RWI_FCan1_DataTypes_SOK_PLA_05_Signatur_Unit "" "Unit_None" EXTENDED_SI /end UNIT
/begin UNIT Systems_MQB2020_MEB_E3_RWI_FCan1_DataTypes_SOK_VIN_01_Signatur_Unit "" "Unit_None" EXTENDED_SI /end UNIT
/begin UNIT Systems_MQB2020_MEB_E3_RWI_FCan1_DataTypes_SOK_Zeit_Lenkhilfe_Challenge_Unit "" "Unit_None" EXTENDED_SI /end UNIT
/begin UNIT Systems_MQB2020_MEB_E3_RWI_FCan1_DataTypes_SOK_Zeit_Lenkhilfe_Zeit_Unit "" "Unit_None" EXTENDED_SI /end UNIT
/begin UNIT Systems_MQB2020_MEB_E3_RWI_FCan1_DataTypes_SOK_ungeschuetzte_Zeit_Unit "" "Unit_None" EXTENDED_SI /end UNIT
/begin UNIT Systems_MQB2020_MEB_E3_RWI_FCan1_DataTypes_UH_Jahr_Unit "" "Unit_Year" EXTENDED_SI /end UNIT
/begin UNIT Systems_MQB2020_MEB_E3_RWI_FCan1_DataTypes_UH_Minute_Unit "" "Unit_Minut" EXTENDED_SI /end UNIT
/begin UNIT Systems_MQB2020_MEB_E3_RWI_FCan1_DataTypes_UH_Monat_Unit "" "Unit_Month" EXTENDED_SI /end UNIT
/begin UNIT Systems_MQB2020_MEB_E3_RWI_FCan1_DataTypes_UH_Sekunde_Unit "" "Unit_Secon" EXTENDED_SI /end UNIT
/begin UNIT Systems_MQB2020_MEB_E3_RWI_FCan1_DataTypes_UH_Stunde_Unit "" "Unit_Hours" EXTENDED_SI /end UNIT
/begin UNIT Systems_MQB2020_MEB_E3_RWI_FCan1_DataTypes_UH_Tag_Unit "" "Unit_Day" EXTENDED_SI /end UNIT
/*********** End of merged FUNCTION blocks ***********/ /*********** Start of merged RECORD_LAYOUT blocks ***********/
/begin RECORD_LAYOUT AblGLFKFub FNC_VALUES 1 UBYTE ROW_DIR DIRECT /end RECORD_LAYOUT
/begin RECORD_LAYOUT AblGLKLfl4 NO_AXIS_PTS_X 1 ULONG AXIS_PTS_X 2 FLOAT32_IEEE INDEX_INCR DIRECT FNC_VALUES 3 FLOAT32_IEEE COLUMN_DIR DIRECT /end RECORD_LAYOUT
/begin RECORD_LAYOUT AblGLKLub NO_AXIS_PTS_X 1 UBYTE AXIS_PTS_X 2 UBYTE INDEX_INCR DIRECT FNC_VALUES 3 UBYTE COLUMN_DIR DIRECT /end RECORD_LAYOUT
/begin RECORD_LAYOUT AblGLKWBfl4 FNC_VALUES 1 FLOAT32_IEEE COLUMN_DIR DIRECT /end RECORD_LAYOUT
/begin RECORD_LAYOUT DefaultValueRecordLayout_AUTOSAR_Platform_BaseTypes_uint32 FNC_VALUES 1 ULONG COLUMN_DIR DIRECT /end RECORD_LAYOUT
/begin RECORD_LAYOUT SBYTE_COL_DIRECT FNC_VALUES 1 SBYTE COLUMN_DIR DIRECT /end RECORD_LAYOUT
/begin RECORD_LAYOUT SLONG_COL_DIRECT FNC_VALUES 1 SLONG COLUMN_DIR DIRECT /end RECORD_LAYOUT
/begin RECORD_LAYOUT SSV__FLOAT32_IEEE_S AXIS_PTS_X 1 FLOAT32_IEEE INDEX_INCR DIRECT /end RECORD_LAYOUT
/begin RECORD_LAYOUT SSV__FLOAT64_IEEE_S AXIS_PTS_X 1 FLOAT64_IEEE INDEX_INCR DIRECT /end RECORD_LAYOUT
/begin RECORD_LAYOUT SSV__SBYTE_S AXIS_PTS_X 1 SBYTE INDEX_INCR DIRECT /end RECORD_LAYOUT
/begin RECORD_LAYOUT SSV__SLONG_S AXIS_PTS_X 1 SLONG INDEX_INCR DIRECT /end RECORD_LAYOUT
/begin RECORD_LAYOUT SSV__SWORD_S AXIS_PTS_X 1 SWORD INDEX_INCR DIRECT /end RECORD_LAYOUT
/begin RECORD_LAYOUT SSV__UBYTE_S AXIS_PTS_X 1 UBYTE INDEX_INCR DIRECT /end RECORD_LAYOUT
/begin RECORD_LAYOUT SSV__ULONG_S AXIS_PTS_X 1 ULONG INDEX_INCR DIRECT /end RECORD_LAYOUT
/begin RECORD_LAYOUT SSV__UWORD_S AXIS_PTS_X 1 UWORD INDEX_INCR DIRECT /end RECORD_LAYOUT
/begin RECORD_LAYOUT SWORD_COL_DIRECT FNC_VALUES 1 SWORD COLUMN_DIR DIRECT /end RECORD_LAYOUT
/begin RECORD_LAYOUT SWORD_X_INCR_DIRECT AXIS_PTS_X 1 SWORD INDEX_INCR DIRECT /end RECORD_LAYOUT
/begin RECORD_LAYOUT UBYTE_COL_DIRECT FNC_VALUES 1 UBYTE COLUMN_DIR DIRECT ALIGNMENT_BYTE 1 ALIGNMENT_FLOAT32_IEEE 1 ALIGNMENT_FLOAT64_IEEE 1 ALIGNMENT_LONG 1 ALIGNMENT_WORD 1 /end RECORD_LAYOUT
/begin RECORD_LAYOUT ULONG_COL_DIRECT FNC_VALUES 1 ULONG COLUMN_DIR DIRECT /end RECORD_LAYOUT
/begin RECORD_LAYOUT UWORD_COL_DIRECT FNC_VALUES 1 UWORD COLUMN_DIR DIRECT /end RECORD_LAYOUT
/begin RECORD_LAYOUT UWORD_X_INCR_DIRECT AXIS_PTS_X 1 UWORD INDEX_INCR DIRECT /end RECORD_LAYOUT
/begin RECORD_LAYOUT __FLOAT32_IEEE_S FNC_VALUES 1 FLOAT32_IEEE COLUMN_DIR DIRECT /end RECORD_LAYOUT
/begin RECORD_LAYOUT __FLOAT32_IEEE_Z FNC_VALUES 1 FLOAT32_IEEE ROW_DIR DIRECT /end RECORD_LAYOUT
/begin RECORD_LAYOUT __FLOAT64_IEEE_S FNC_VALUES 1 FLOAT64_IEEE COLUMN_DIR DIRECT /end RECORD_LAYOUT
/begin RECORD_LAYOUT __FLOAT64_IEEE_Z FNC_VALUES 1 FLOAT64_IEEE ROW_DIR DIRECT /end RECORD_LAYOUT
/begin RECORD_LAYOUT __SBYTE_S FNC_VALUES 1 SBYTE COLUMN_DIR DIRECT /end RECORD_LAYOUT
/begin RECORD_LAYOUT __SBYTE_Z FNC_VALUES 1 SBYTE ROW_DIR DIRECT /end RECORD_LAYOUT
/begin RECORD_LAYOUT __SLONG_S FNC_VALUES 1 SLONG COLUMN_DIR DIRECT /end RECORD_LAYOUT
/begin RECORD_LAYOUT __SLONG_Z FNC_VALUES 1 SLONG ROW_DIR DIRECT /end RECORD_LAYOUT
/begin RECORD_LAYOUT __SWORD_S FNC_VALUES 1 SWORD COLUMN_DIR DIRECT /end RECORD_LAYOUT
/begin RECORD_LAYOUT __SWORD_Z FNC_VALUES 1 SWORD ROW_DIR DIRECT /end RECORD_LAYOUT
/begin RECORD_LAYOUT __UBYTE_S FNC_VALUES 1 UBYTE COLUMN_DIR DIRECT /end RECORD_LAYOUT
/begin RECORD_LAYOUT __UBYTE_Z FNC_VALUES 1 UBYTE ROW_DIR DIRECT /end RECORD_LAYOUT
/begin RECORD_LAYOUT __ULONG_S FNC_VALUES 1 ULONG COLUMN_DIR DIRECT /end RECORD_LAYOUT
/begin RECORD_LAYOUT __ULONG_Z FNC_VALUES 1 ULONG ROW_DIR DIRECT /end RECORD_LAYOUT
/begin RECORD_LAYOUT __UWORD_Z FNC_VALUES 1 UWORD ROW_DIR DIRECT /end RECORD_LAYOUT
/begin RECORD_LAYOUT rlCurvefl FNC_VALUES 3 FLOAT32_IEEE COLUMN_DIR DIRECT AXIS_PTS_X 2 FLOAT32_IEEE INDEX_INCR DIRECT NO_AXIS_PTS_X 1 UBYTE /end RECORD_LAYOUT
/begin RECORD_LAYOUT rlCurvesb FNC_VALUES 3 SBYTE COLUMN_DIR DIRECT AXIS_PTS_X 2 SBYTE INDEX_INCR DIRECT NO_AXIS_PTS_X 1 UBYTE /end RECORD_LAYOUT
/begin RECORD_LAYOUT rlCurvesl FNC_VALUES 3 SLONG COLUMN_DIR DIRECT AXIS_PTS_X 2 SLONG INDEX_INCR DIRECT NO_AXIS_PTS_X 1 UBYTE /end RECORD_LAYOUT
/begin RECORD_LAYOUT rlCurvesw FNC_VALUES 3 SWORD COLUMN_DIR DIRECT AXIS_PTS_X 2 SWORD INDEX_INCR DIRECT NO_AXIS_PTS_X 1 UBYTE /end RECORD_LAYOUT
/begin RECORD_LAYOUT rlCurveub FNC_VALUES 3 UBYTE COLUMN_DIR DIRECT AXIS_PTS_X 2 UBYTE INDEX_INCR DIRECT NO_AXIS_PTS_X 1 UBYTE /end RECORD_LAYOUT
/begin RECORD_LAYOUT rlCurveul FNC_VALUES 3 ULONG COLUMN_DIR DIRECT AXIS_PTS_X 2 ULONG INDEX_INCR DIRECT NO_AXIS_PTS_X 1 UBYTE /end RECORD_LAYOUT
/begin RECORD_LAYOUT rlCurveuw FNC_VALUES 3 UWORD COLUMN_DIR DIRECT AXIS_PTS_X 2 UWORD INDEX_INCR DIRECT NO_AXIS_PTS_X 1 UBYTE /end RECORD_LAYOUT
/begin RECORD_LAYOUT rlValuefl FNC_VALUES 1 FLOAT32_IEEE COLUMN_DIR DIRECT /end RECORD_LAYOUT
/begin RECORD_LAYOUT rlValuesb FNC_VALUES 1 SBYTE COLUMN_DIR DIRECT /end RECORD_LAYOUT
/begin RECORD_LAYOUT rlValuesl FNC_VALUES 1 SLONG COLUMN_DIR DIRECT /end RECORD_LAYOUT
/begin RECORD_LAYOUT rlValueub FNC_VALUES 1 UBYTE COLUMN_DIR DIRECT /end RECORD_LAYOUT
/begin RECORD_LAYOUT rlValueul FNC_VALUES 1 ULONG COLUMN_DIR DIRECT /end RECORD_LAYOUT
/begin RECORD_LAYOUT rlValueuw FNC_VALUES 1 UWORD COLUMN_DIR DIRECT /end RECORD_LAYOUT
/*********** End of merged RECORD_LAYOUT blocks ***********/ /*********** Start of merged COMPU_TAB blocks ***********/
/begin COMPU_TAB STEERING_CHAR_STATE_NUM "" TAB_NOINTP 5 1 0 2 1 4 2 8 3 16 4 /end COMPU_TAB
/begin COMPU_VTAB ROU_RESULT "" TAB_VERB 8 1 "NoResultsAvailable" 2 "SafetyReasonAbort" 3 "ErrorAbort" 4 "PreConditionsAbort" 161 "PreConditionsValid" 162 "PreConditionsNotValid" 255 "RoutineSequenceSuccessFinished" 65535 "CorrectResults" DEFAULT_VALUE "NoResultsAvailable" /end COMPU_VTAB
/begin COMPU_VTAB ROU_STATUS "" TAB_VERB 3 1 "RoutineActive" 2 "RoutineNotActiveOrFinishedCorrectly" 3 "RoutineAbort" DEFAULT_VALUE "RoutineNotActiveOrFinishedCorrectly" /end COMPU_VTAB
/begin COMPU_VTAB VERB_SYSTEM_STATE "VERB_SYSTEM_STATE" TAB_VERB 10 0 "undefined" 1 "NMWait" 2 "KL30Wait" 3 "PreDrive" 4 "DriveDown" 5 "DriveUp" 6 "PostRun" 7 "Off" 8 "Error" 9 "Flash" /end COMPU_VTAB
/end MODULE
/end PROJECT
