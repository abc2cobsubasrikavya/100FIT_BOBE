/*
© by ASAM e.V., 2017
AML for the protocol layer specific parameters
Any use is limited to the scope described in the ASAM license terms.
This file is distributable in accordance with the ASAM license terms.
See www.asam.net/license.html for further details.
*/
/*-- Generated by A2L Merger 2023.2_4.13.0 --*/
ASAP2_VERSION 1 70
/begin PROJECT _3G1_300 "varI04"
/begin HEADER "" VERSION "3G1_300_D_70_00_T02" PROJECT_NO _3G1_300 /end HEADER
/begin MODULE XCP_EPS_ECU "100FIT"
/begin MOD_COMMON "" BYTE_ORDER MSB_LAST ALIGNMENT_BYTE 1 ALIGNMENT_WORD 2 ALIGNMENT_LONG 4 ALIGNMENT_FLOAT32_IEEE 4 ALIGNMENT_FLOAT64_IEEE 8 /end MOD_COMMON
/* Definitions for XCP */
/begin IF_DATA XCPplus 0x0102
 /begin PAG 0x06 FREEZE_SUPPORTED /end PAG
 /begin PGM PGM_MODE_ABSOLUTE 0x00 0x00 /end PGM
 /* Adding generated XCP Snippet from BSW */
 /begin XCP_ON_CAN /************************ start of CAN *********************/ 0x0104 /* XCP on CAN version */ CAN_ID_MASTER 0xDBFC9600 /* CMD/STIM CAN-ID */ /* master -> slave */ CAN_ID_SLAVE 0xDBFC9601 /* RES/ERR/EV/SERV/DAQ CAN-ID */ /* slave -> master */ /* Bit31= 1: extended identifier */ BAUDRATE 500000 /* BAUDRATE [Hz] */ SAMPLE_POINT 80 /* sample point */ /* [% complete bit time] */ BTL_CYCLES 80 /* BTL_CYCLES */ /* [slots per bit time] */ SJW 16 /* length synchr. segment */ /* [BTL_CYCLES] */ MAX_BUS_LOAD 100 /* maximum available bus */
  /begin CAN_FD MAX_DLC 64 /* 8, 12, 16, 20, 24, 32, 48 or 64 */ CAN_FD_DATA_TRANSFER_BAUDRATE 2000000 /* BAUDRATE [Hz] */ SAMPLE_POINT 70 /* sample point receiver*/ /* [% complete bit time] */ BTL_CYCLES 20 /* BTL_CYCLES */ /* [slots per bit time] */ SJW 6 /* length synchr. segment */ /* [BTL_CYCLES] */ /end CAN_FD
  /************************* end of CAN **********************/ /*************** start of PROTOCOL_LAYER *******************/
  /begin PROTOCOL_LAYER /* At MODULE */ 0x0104 /* XCP protocol layer version */ 250 /* T1 [ms] */ 250 /* T2 [ms] */ 0 /* T3 [ms] */ 0 /* T4 [ms] */ 0 /* T5 [ms] */ 0 /* T6 [ms] */ 0 /* T7 [ms] */ 64 /* MAX_CTO */ 64 /* MAX_DTO default for DAQ and STIM */ BYTE_ORDER_MSB_LAST /* BYTE_ORDER: INTEL */ ADDRESS_GRANULARITY_BYTE /* ADDRESS_GRANULARITY */ OPTIONAL_CMD GET_COMM_MODE_INFO OPTIONAL_CMD GET_ID OPTIONAL_CMD SET_MTA OPTIONAL_CMD UPLOAD OPTIONAL_CMD SHORT_UPLOAD OPTIONAL_CMD BUILD_CHECKSUM OPTIONAL_CMD USER_CMD OPTIONAL_CMD DOWNLOAD OPTIONAL_CMD DOWNLOAD_NEXT OPTIONAL_CMD DOWNLOAD_MAX OPTIONAL_CMD SHORT_DOWNLOAD OPTIONAL_CMD MODIFY_BITS OPTIONAL_CMD SET_CAL_PAGE OPTIONAL_CMD GET_CAL_PAGE OPTIONAL_CMD GET_PAG_PROCESSOR_INFO OPTIONAL_CMD GET_SEGMENT_INFO OPTIONAL_CMD GET_PAGE_INFO OPTIONAL_CMD COPY_CAL_PAGE OPTIONAL_CMD CLEAR_DAQ_LIST OPTIONAL_CMD SET_DAQ_PTR OPTIONAL_CMD WRITE_DAQ OPTIONAL_CMD SET_DAQ_LIST_MODE OPTIONAL_CMD GET_DAQ_LIST_MODE OPTIONAL_CMD START_STOP_DAQ_LIST OPTIONAL_CMD START_STOP_SYNCH OPTIONAL_CMD GET_DAQ_CLOCK OPTIONAL_CMD READ_DAQ OPTIONAL_CMD GET_DAQ_PROCESSOR_INFO OPTIONAL_CMD GET_DAQ_RESOLUTION_INFO OPTIONAL_CMD GET_DAQ_EVENT_INFO OPTIONAL_CMD FREE_DAQ OPTIONAL_CMD ALLOC_DAQ OPTIONAL_CMD ALLOC_ODT OPTIONAL_CMD ALLOC_ODT_ENTRY OPTIONAL_CMD WRITE_DAQ_MULTIPLE OPTIONAL_LEVEL1_CMD GET_VERSION COMMUNICATION_MODE_SUPPORTED /* optional modes supported */ BLOCK SLAVE /* Slave Block Mode supported */ MASTER /* Master Block Mode supported */ 255 /* MAX_BS */ 0 /* MIN_ST */ /end PROTOCOL_LAYER
  /***************** end of PROTOCOL_LAYER *******************/ /********************* start of DAQ ************************/
  /begin DAQ /* DAQ supported, at MODULE*/ DYNAMIC /* DAQ_CONFIG_TYPE */ 65535 /* MAX_DAQ */ 4 /* MAX_EVENT_CHANNEL */ 0 /* MIN_DAQ */ OPTIMISATION_TYPE_DEFAULT /* OPTIMISATION_TYPE */ ADDRESS_EXTENSION_FREE /* ADDRESS_EXTENSION */ IDENTIFICATION_FIELD_TYPE_ABSOLUTE /* IDENTIFICATION_FIELD */ GRANULARITY_ODT_ENTRY_SIZE_DAQ_BYTE /* GRANULARITY_ODT_ENTRY_SIZE_DAQ */ 255 /* MAX_ODT_ENTRY_SIZE_DAQ */ OVERLOAD_INDICATION_PID /* OVERLOAD_INDICATION */ PRESCALER_SUPPORTED
   /begin TIMESTAMP_SUPPORTED 1 /* TIMESTAMP_TICKS */ SIZE_WORD /* TIMESTAMP_SIZE */ UNIT_1MS /* RESOLUTION OF TIMESTAMP */ /end TIMESTAMP_SUPPORTED
   /begin DAQ_MEMORY_CONSUMPTION 995 /* DAQ_MEMORY_LIMIT: in Elements[AG] */ 214 /* DAQ_SIZE: number of elements[AG] per DAQ list */ 6 /* ODT_SIZE: number of elements[AG] per ODT */ 5 /* ODT_ENTRY_SIZE: number of elements[AG] per ODT_entry */ 2 /* ODT_DAQ_BUFFER_ELEMENT_SIZE: number of */ /* payload elements[AG]*factor = sizeof(send buffer)[AG] */ 0 /* ODT_STIM_BUFFER_ELEMENT_SIZE: number of */ /* payload elements[AG]*factor = sizeof(receive buffer)[AG] */
    /begin BUFFER_RESERVE /* default for all EVENTs */ 0 /* ODT_DAQ_BUFFER_ELEMENT_RESERVE in % of */ /* ODT_DAQ_BUFFER_ELEMENT_SIZE */ 0 /* ODT_STIM_BUFFER_ELEMENT_RESERVE in % of */ /* ODT_STIM_BUFFER_ELEMENT_SIZE */ /end BUFFER_RESERVE
   /end DAQ_MEMORY_CONSUMPTION
   /******************* start of EVENT ************************/
   /begin EVENT "2ms time synchronous" "2_ms" 0 DAQ 1 2 6 7 /begin MIN_CYCLE_TIME /* Configuration with 0-0 not allowed */ 5 6 /end MIN_CYCLE_TIME /end EVENT
   /begin EVENT "1ms time synchronous" "1_ms" 1 DAQ 1 1 6 8 /end EVENT
   /begin EVENT "10ms time synchronous" "10_ms" 2 DAQ 1 10 6 6 /end EVENT
   /begin EVENT "100ms time synchronous" "100_ms" 3 DAQ 1 100 6 5 /end EVENT
   /********************* end of EVENT ************************/ /end DAQ
  /********************* end of DAQ **************************/ TRANSPORT_LAYER_INSTANCE "CAN_0_PL0" /end XCP_ON_CAN
 /* End generated XCP Snippet from BSW */ /end IF_DATA
/begin MOD_PAR "SBK" VERSION "3G1_300_D_70_00_T02" CUSTOMER_NO "3G1" USER "dummy" PHONE_NO "310" ECU "SCU3_C3x_varI04" CPU_TYPE "CCCube D4" /* future use
ADDR_EPK 0x0
EPK "2026/02/24 14:26:32.87" */ /* Definitions for MEMORY_SEGMENT in FLASH */ /* FOC calibration block */
 /begin MEMORY_SEGMENT FOC_ROM "FOC calibration ROM block for initialization" DATA FLASH INTERN 0x4000 0x1500 -1 -1 -1 -1 -1
  /begin IF_DATA XCPplus 0x0102
   /begin SEGMENT 0x00 0x02 0x00 0x00 0x00
    /begin PAGE 0x0 ECU_ACCESS_DONT_CARE XCP_READ_ACCESS_WITH_ECU_ONLY XCP_WRITE_ACCESS_NOT_ALLOWED /end PAGE
    /begin PAGE 0x1 ECU_ACCESS_DONT_CARE XCP_READ_ACCESS_WITH_ECU_ONLY XCP_WRITE_ACCESS_WITH_ECU_ONLY /end PAGE
    /begin ADDRESS_MAPPING 0x4000 0xFEE94888 0x1500 /end ADDRESS_MAPPING
   /end SEGMENT
  /end IF_DATA
 /end MEMORY_SEGMENT
 /* SYSTEM calibration block */
 /begin MEMORY_SEGMENT SYSTEM_ROM "System calibration ROM block for initialization" DATA FLASH INTERN 0x6000 0x1CAC -1 -1 -1 -1 -1
  /begin IF_DATA XCPplus 0x0102
   /begin SEGMENT 0x01 0x02 0x00 0x00 0x00
    /begin PAGE 0x0 ECU_ACCESS_DONT_CARE XCP_READ_ACCESS_WITH_ECU_ONLY XCP_WRITE_ACCESS_NOT_ALLOWED /end PAGE
    /begin PAGE 0x1 ECU_ACCESS_DONT_CARE XCP_READ_ACCESS_WITH_ECU_ONLY XCP_WRITE_ACCESS_WITH_ECU_ONLY /end PAGE
    /begin ADDRESS_MAPPING 0x6000 0xFEE95D88 0x1CAC /end ADDRESS_MAPPING
   /end SEGMENT
  /end IF_DATA
 /end MEMORY_SEGMENT
 /* TUNING calibration block */
 /begin MEMORY_SEGMENT TUNING_ROM "Tuning calibration ROM block for initialization" DATA FLASH INTERN 0x8000 0x574 -1 -1 -1 -1 -1
  /begin IF_DATA XCPplus 0x0102
   /begin SEGMENT 0x02 0x02 0x00 0x00 0x00
    /begin PAGE 0x0 ECU_ACCESS_DONT_CARE XCP_READ_ACCESS_WITH_ECU_ONLY XCP_WRITE_ACCESS_NOT_ALLOWED /end PAGE
    /begin PAGE 0x1 ECU_ACCESS_DONT_CARE XCP_READ_ACCESS_WITH_ECU_ONLY XCP_WRITE_ACCESS_WITH_ECU_ONLY /end PAGE
    /begin ADDRESS_MAPPING 0x8000 0xFEE97A38 0x574 /end ADDRESS_MAPPING
   /end SEGMENT
  /end IF_DATA
 /end MEMORY_SEGMENT
 /* OEM calibration block */
 /begin MEMORY_SEGMENT OEM_ROM "OEM calibration ROM block for initialization" DATA FLASH INTERN 0xC000 0x281C -1 -1 -1 -1 -1
  /begin IF_DATA XCPplus 0x0102
   /begin SEGMENT 0x03 0x02 0x00 0x00 0x00
    /begin PAGE 0x0 ECU_ACCESS_DONT_CARE XCP_READ_ACCESS_WITH_ECU_ONLY XCP_WRITE_ACCESS_NOT_ALLOWED /end PAGE
    /begin PAGE 0x1 ECU_ACCESS_DONT_CARE XCP_READ_ACCESS_WITH_ECU_ONLY XCP_WRITE_ACCESS_WITH_ECU_ONLY /end PAGE
    /begin ADDRESS_MAPPING 0xC000 0xFEE97FB0 0x281C /end ADDRESS_MAPPING
   /end SEGMENT
  /end IF_DATA
 /end MEMORY_SEGMENT
 /* SAFEDRIVE calibration block */
 /begin MEMORY_SEGMENT SAFE_DRIVE_ROM "SafeDrive calibration ROM block for initialization" DATA FLASH INTERN 0x80CE34 0x544 -1 -1 -1 -1 -1
  /begin IF_DATA XCPplus 0x0102
   /begin SEGMENT 0x04 0x02 0x00 0x00 0x00
    /begin PAGE 0x0 ECU_ACCESS_DONT_CARE XCP_READ_ACCESS_WITH_ECU_ONLY XCP_WRITE_ACCESS_NOT_ALLOWED /end PAGE
    /begin PAGE 0x1 ECU_ACCESS_DONT_CARE XCP_READ_ACCESS_WITH_ECU_ONLY XCP_WRITE_ACCESS_WITH_ECU_ONLY /end PAGE
    /begin ADDRESS_MAPPING 0x80CE34 0xFEE9A7D0 0x544 /end ADDRESS_MAPPING
   /end SEGMENT
  /end IF_DATA
 /end MEMORY_SEGMENT
 /* SafeSystem calibration block */
 /begin MEMORY_SEGMENT SAFE_SYSTEM_ROM "SafeSystem calibration ROM block for initialization" DATA FLASH INTERN 0x80D378 0x1D4 -1 -1 -1 -1 -1
  /begin IF_DATA XCPplus 0x0102
   /begin SEGMENT 0x05 0x02 0x00 0x00 0x00
    /begin PAGE 0x0 ECU_ACCESS_DONT_CARE XCP_READ_ACCESS_WITH_ECU_ONLY XCP_WRITE_ACCESS_NOT_ALLOWED /end PAGE
    /begin PAGE 0x1 ECU_ACCESS_DONT_CARE XCP_READ_ACCESS_WITH_ECU_ONLY XCP_WRITE_ACCESS_WITH_ECU_ONLY /end PAGE
    /begin ADDRESS_MAPPING 0x80D378 0xFEE9AD18 0x1D4 /end ADDRESS_MAPPING
   /end SEGMENT
  /end IF_DATA
 /end MEMORY_SEGMENT
 /* HwLib calibration block */
 /begin MEMORY_SEGMENT HW_LIB_ROM "HwLib calibration block" DATA FLASH INTERN 0x198D0C 0x168 -1 -1 -1 -1 -1
  /begin IF_DATA XCPplus 0x0102
   /begin SEGMENT 0x06 0x02 0x00 0x00 0x00
    /begin PAGE 0x0 ECU_ACCESS_DONT_CARE XCP_READ_ACCESS_WITH_ECU_ONLY XCP_WRITE_ACCESS_NOT_ALLOWED /end PAGE
    /begin PAGE 0x1 ECU_ACCESS_DONT_CARE XCP_READ_ACCESS_WITH_ECU_ONLY XCP_WRITE_ACCESS_WITH_ECU_ONLY /end PAGE
    /begin ADDRESS_MAPPING 0x198D0C 0xFEE9AEF0 0x168 /end ADDRESS_MAPPING
   /end SEGMENT
  /end IF_DATA
 /end MEMORY_SEGMENT
 /* LRAM-1 measurement block */
 /begin MEMORY_SEGMENT LOCAL1_RAM "LRAM-1 measurement data" VARIABLES RAM INTERN 0xFEBF0000 0x10000 -1 -1 -1 -1 -1
  /begin IF_DATA XCPplus 0x0102
   /begin SEGMENT 0x07 0x01 0x00 0x00 0x00
    /begin PAGE 0x0 ECU_ACCESS_WITH_XCP_ONLY XCP_READ_ACCESS_WITH_ECU_ONLY XCP_WRITE_ACCESS_NOT_ALLOWED /end PAGE
   /end SEGMENT
  /end IF_DATA
 /end MEMORY_SEGMENT
 /* LRAM-2 measurement block */
 /begin MEMORY_SEGMENT LOCAL2_RAM "LRAM-2 measurement data" VARIABLES RAM INTERN 0xFE9F0000 0x10000 -1 -1 -1 -1 -1
  /begin IF_DATA XCPplus 0x0102
   /begin SEGMENT 0x08 0x01 0x00 0x00 0x00
    /begin PAGE 0x0 ECU_ACCESS_WITH_XCP_ONLY XCP_READ_ACCESS_WITH_ECU_ONLY XCP_WRITE_ACCESS_NOT_ALLOWED /end PAGE
   /end SEGMENT
  /end IF_DATA
 /end MEMORY_SEGMENT
 /* GRAM measurement block */
 /begin MEMORY_SEGMENT GLOBAL_RAM "GRAM measurement data" VARIABLES RAM INTERN 0xFEE9B058 0xDCFA8 -1 -1 -1 -1 -1
  /begin IF_DATA XCPplus 0x0102
   /begin SEGMENT 0x09 0x01 0x00 0x00 0x00
    /begin PAGE 0x0 ECU_ACCESS_WITH_XCP_ONLY XCP_READ_ACCESS_WITH_ECU_ONLY XCP_WRITE_ACCESS_NOT_ALLOWED /end PAGE
   /end SEGMENT
  /end IF_DATA
 /end MEMORY_SEGMENT
 /* Drive code block bank A */
 /begin MEMORY_SEGMENT DRIVE_CODE "Drive code section on flash bank A" CODE FLASH INTERN 0x48000 0x150E75 -1 -1 -1 -1 -1 /end MEMORY_SEGMENT
 /* Drive code block bank B */ /* /begin MEMORY_SEGMENT */ /* DRIVE_CODE "Drive code section on flash bank B" */ /* CODE FLASH INTERN 0x800000 0x188000 -1 -1 -1 -1 -1
/* /end MEMORY_SEGMENT */ /* OEM code block */
 /begin MEMORY_SEGMENT OEM_CODE "OEM code section" CODE FLASH INTERN 0x988000 0x48000 -1 -1 -1 -1 -1 /end MEMORY_SEGMENT
 /*********** Start of merged MOD_PAR blocks ***********/
 SYSTEM_CONSTANT "FCT_CO_NUMBER_OF_ARBITRATIONS" "3"
 SYSTEM_CONSTANT "FCT_CO_NUMBER_OF_CHANNELS" "3"
 SYSTEM_CONSTANT "PUBLICKEYLENGTHDER" "270"
 SYSTEM_CONSTANT "RP_SYNC_ARRIDX" "7"
 SYSTEM_CONSTANT "SY_SIZE_OF_DATA_SET_NAME" "12"
 SYSTEM_CONSTANT "WLC_NUMBER_OF_WARNING_LIGHT_CHANNELS" "39"
 SYSTEM_CONSTANT "SY_MASK_STARTPOS_LERNGER" "21"
 SYSTEM_CONSTANT "SY_MASK_STARTPOS_LERNTSC" "20"
 SYSTEM_CONSTANT "SY_MASK_STARTPOS_MONITORWHLSPEED" "18"
 SYSTEM_CONSTANT "SY_MASK_STARTPOS_QFKDSR" "25"
 SYSTEM_CONSTANT "SY_MASK_STARTPOS_QFKHCA" "24"
 SYSTEM_CONSTANT "SY_MASK_STARTPOS_QFKPLA" "22" /*********** End of merged MOD_PAR blocks ***********/ /end MOD_PAR
/begin CHARACTERISTIC fEndStopHsd_EnableUnFiltRotSpeed_XDU8 "0 = gefilterte Rotordrehzahl; 1 = verwende die UNgefilterte Rotordrehzahl in HighSpeedDamping" VALUE 0x6462 AblGLKWub 1.000 ZU0 0.00 1.000 FORMAT "%5.3" /end CHARACTERISTIC
/begin CHARACTERISTIC fEndStop_EnableDynamicEndStop_XDU8 "Dynamische Hubreduzierung abhaengig VFZ aktivieren" VALUE 0x80A1 AblGLKWub 1.000 ZU0 0.00 1.000 FORMAT "%5.3" /end CHARACTERISTIC
/begin CHARACTERISTIC fEndStop_EnableVehSpeedFiltering_XDU8 "function switch: 1 = Fahrzeuggeschwindigkeit aufbereiten an; 0 = ausschalten" VALUE 0x80A3 AblGLKWub 1.000 ZU0 0.00 1.000 FORMAT "%5.3" /end CHARACTERISTIC
/begin CHARACTERISTIC fEndStop_LimitEnable_XDU8 "Flag Einschalten Limitierung Endanschlagsmomente. Achtung: EndstopSupp-Komponente kann diese Limitierung aufheben wenn fEndStop_EnableDyn_XDU8 aktiv!!!" VALUE 0x6465 AblGLKWub 1.000 ZU0 0.00 1.000 FORMAT "%5.3" /end CHARACTERISTIC
/begin CHARACTERISTIC fEpsInI_AWV_QFK_Kruemmung_Fas02_XDU8 "Wechselt zwischen den Signalen AWV_QFK_KrSoll und AWV_QFK_KruemmSoll" VALUE 0x6467 AblGLKWub 1.000 ZU0 0.00 1.000 FORMAT "%5.3" /end CHARACTERISTIC
/begin CHARACTERISTIC fEpsInI_DSR_QFK_Kruemmung_Fas04_XDU8 "Wechselt zwischen den Signalen DSR_QFK_KrSoll und DSR_QFK_KruemmSoll" VALUE 0x6468 AblGLKWub 1.000 ZU0 0.00 1.000 FORMAT "%5.3" /end CHARACTERISTIC
/begin CHARACTERISTIC fEpsInI_HCA_QFK_Kruemmung_Fas03_XDU8 "Wechselt zwischen den Signalen HCA_QFK_KrSoll und HCA_QFK_KruemmSoll" VALUE 0x6469 AblGLKWub 1.000 ZU0 0.00 1.000 FORMAT "%5.3" /end CHARACTERISTIC
/begin CHARACTERISTIC fEpsInI_PLA_QFK_Kruemmung_Fas01_XDU8 "Wechselt zwischen den Signalen PLA_QFK_KrSoll und PLA_QFK_KruemmSoll" VALUE 0x646A AblGLKWub 1.000 ZU0 0.00 1.000 FORMAT "%5.3" /end CHARACTERISTIC
/begin CHARACTERISTIC fEpsInI_RHP_QFK_Kruemmung_Fas05_XDU8 "Wechselt zwischen den Signalen RHP_QFK_KrSoll und RHP_QFK_KruemmSoll" VALUE 0x646B AblGLKWub 1.000 ZU0 0.00 1.000 FORMAT "%5.3" /end CHARACTERISTIC
/begin CHARACTERISTIC fEpsOut_SetBusSteeringAngleInvalid_XDB "Deaktivieren Sie ESP/ESC, indem Sie ungÃ¼ltige Lenkwinkelinformationen auf dem CAN-Bus senden" VALUE 0x646C AblGLKWub 1.000 ZU0 0.00 1.000 FORMAT "%5.3" /end CHARACTERISTIC
/begin CHARACTERISTIC fLowVoltAssRed_HideVehSpeedDepVoltRed_XDB "Fahrzeuggeschwindigkeitsabhaengige Ausblendung der Reduktion ueber Versorgungsspannung (1=aktiv, 0=inaktiv)" VALUE 0x646D AblGLKWub 1.000 ZU0 0.00 1.000 FORMAT "%5.3" /end CHARACTERISTIC
/begin CHARACTERISTIC fSCruiseLimr_EnaDrvrIsIntractn4RackSpdLim_XDU8 "Enable DrvrIsInteractn for vSCruiseLimrI_RackSpdLim/-4Chk" VALUE 0x6476 AblGLKWub 1.000 BIT 0.00 1.000 FORMAT "%5.3" /end CHARACTERISTIC
/begin CHARACTERISTIC fSCruiseLimr_EnaESS_XDU8 "Enable detection of evasive steering support to map MaxRackSpdLim" VALUE 0x6477 AblGLKWub 1.000 BIT 0.00 1.000 FORMAT "%5.3" /end CHARACTERISTIC
/begin CHARACTERISTIC fSCruiseLimr_EnaExtReqESS_XDU8 "External request is (1: required) / (0: not required) in order to perform evasive steering support" VALUE 0x6478 AblGLKWub 1.000 BIT 0.00 1.000 FORMAT "%5.3" /end CHARACTERISTIC
/begin CHARACTERISTIC fSCruiseLimr_OpnRackSpdLimAsym_XDB "Open the rack speed limits symmetric due to driver interaction in HandsOn (0) or independent into pos/-negative direction (1)" VALUE 0x6479 AblGLKWub 1.000 BIT 0.00 1.000 FORMAT "%5.3" /end CHARACTERISTIC
/begin CHARACTERISTIC fSCruise_Enable_XDU8 "Flag to enable the Smart Cruise Interface" VALUE 0x80D3EC AblGLKWub 1.000 ZU0 0.00 1.000 FORMAT "%5.3" /end CHARACTERISTIC
/begin CHARACTERISTIC fScruiseLimr_DisableESSLimReset_XDU8 "Flag to enable/disable reset of ESS limits after switch to SFC 0=>Reset 1=> Do not reset" VALUE 0x6475 AblGLKWub 1.000 BIT 0.00 1.000 FORMAT "%5.3" /end CHARACTERISTIC
/begin CHARACTERISTIC fatD2T3Enable_XDU8 "Schalter fuer D2T3-Filter: 0 = aus; 1 = ein" VALUE 0x645E AblGLKWub 1.000 ZU0 0.00 1.000 FORMAT "%5.3" /end CHARACTERISTIC
/begin CHARACTERISTIC iLowVoltAssRed_MaxCurrentGen_XDU16 "Maximal zulaessiger Strom im generatorischen Betrieb" VALUE 0x6116 AblGLKWuw 150.0000 SM_I 0.00 150.0000 FORMAT "%8.4" /end CHARACTERISTIC
/begin CHARACTERISTIC iLowVoltAssRed_MaxCurrent_XDU16 "Maximal zulaessiger Strom" VALUE 0x611C AblGLKWuw 500.0000 SM_I 0.00 500.0000 FORMAT "%8.4" /end CHARACTERISTIC
/begin CHARACTERISTIC lEndStop_EsMechIndentLeft_XDU16 "Einruecken/Abstand in [mm] vom eingelernten Endanschlag" VALUE 0x6162 AblGLKWuw 40.00000 RACKPOS128 0.00 40.00000 FORMAT "%8.5" /end CHARACTERISTIC
/begin CHARACTERISTIC lEndStop_EsMechIndentRight_XDU16 "Einruecken/Abstand in [mm] vom eingelernten Endanschlag" VALUE 0x6164 AblGLKWuw 40.00000 RACKPOS128 0.00 40.00000 FORMAT "%8.5" /end CHARACTERISTIC
/begin CHARACTERISTIC lEndStop_MaxSteerRange_XDU16 "max. Lenkhub bezogen auf kalibrierten LWS[mm]" VALUE 0x6166 AblGLKWuw 125.0000 RACKPOS128 0.00 125.0000 FORMAT "%8.4" /end CHARACTERISTIC
/begin CHARACTERISTIC lEndStop_VehicleSpeedDepOffset_XAU16 "Fahrzeuggeschwindigkeitsabhaengiger Endanschlagsoffset fuer Hubreduzierung" CURVE 0x82A4 AblGLKLuw 20.00000 RACKPOS128 0.00 20.00000 FORMAT "%8.5"
 /begin AXIS_DESCR STD_AXIS vEndStop_VehSpeedHystFilt_xdu16 VFZHIGH 5 0.00 500.0000 FORMAT "%8.4" DEPOSIT ABSOLUTE /end AXIS_DESCR
/end CHARACTERISTIC
/begin CHARACTERISTIC lSCruise_MaxNomRackPosn_XAU16 "max. allowed nominal rack position dependent on vehicle speed" CURVE 0x65F4 AblGLKLuw 200.0000 RACKPOS256 0.00 200.0000 FORMAT "%8.4"
 /begin AXIS_DESCR STD_AXIS vSCruiseI_AbsAvgVehSpd_xdu16 VFZHIGH 9 0.00 250.0000 FORMAT "%8.4" DEPOSIT ABSOLUTE /end AXIS_DESCR
/end CHARACTERISTIC
/begin CHARACTERISTIC lSCruise_SubRackPosn_XDS16 "Substitution of ReqRackPosn if value is within valid range of ReqRackPosn" VALUE 0x617A AblGLKWsw 454.0000 RACKPOS128 -200.0000 254.0000 FORMAT "%8.4" /end CHARACTERISTIC
/begin CHARACTERISTIC mBci_V0AssistCurveAuto_XAU16 "Motormoment abhängig vom Handmoment bei Geschwindigkeit v0" CURVE 0x80AC AblGLKWBuw 15.00000 MMOT 0.00 15.00000 FORMAT "%8.5"
 /begin AXIS_DESCR COM_AXIS matAbsTorsionBarTorque_xdu16 TBTHIGH 10 0.00 20.00000 FORMAT "%8.5" AXIS_PTS_REF mBci_V0TbtArray_XAU16 /end AXIS_DESCR
/end CHARACTERISTIC
/begin CHARACTERISTIC mBci_V0AssistCurveDyn_XAU16 "Motormoment abhängig vom Handmoment bei Geschwindigkeit v0" CURVE 0x80C0 AblGLKWBuw 15.00000 MMOT 0.00 15.00000 FORMAT "%8.5"
 /begin AXIS_DESCR COM_AXIS matAbsTorsionBarTorque_xdu16 TBTHIGH 10 0.00 20.00000 FORMAT "%8.5" AXIS_PTS_REF mBci_V0TbtArray_XAU16 /end AXIS_DESCR
/end CHARACTERISTIC
/begin CHARACTERISTIC mBci_V0AssistCurveKomf_XAU16 "Motormoment abhängig vom Handmoment bei Geschwindigkeit v0" CURVE 0x80D4 AblGLKWBuw 15.00000 MMOT 0.00 15.00000 FORMAT "%8.5"
 /begin AXIS_DESCR COM_AXIS matAbsTorsionBarTorque_xdu16 TBTHIGH 10 0.00 20.00000 FORMAT "%8.5" AXIS_PTS_REF mBci_V0TbtArray_XAU16 /end AXIS_DESCR
/end CHARACTERISTIC
/begin CHARACTERISTIC mBci_V1AssistCurveAuto_XAU16 "Motormoment abhängig vom Handmoment bei Geschwindigkeit v1" CURVE 0x80E8 AblGLKWBuw 15.00000 MMOT 0.00 15.00000 FORMAT "%8.5"
 /begin AXIS_DESCR COM_AXIS matAbsTorsionBarTorque_xdu16 TBTHIGH 10 0.00 20.00000 FORMAT "%8.5" AXIS_PTS_REF mBci_V1TbtArray_XAU16 /end AXIS_DESCR
/end CHARACTERISTIC
/begin CHARACTERISTIC mBci_V1AssistCurveDyn_XAU16 "Motormoment abhängig vom Handmoment bei Geschwindigkeit v1" CURVE 0x80FC AblGLKWBuw 15.00000 MMOT 0.00 15.00000 FORMAT "%8.5"
 /begin AXIS_DESCR COM_AXIS matAbsTorsionBarTorque_xdu16 TBTHIGH 10 0.00 20.00000 FORMAT "%8.5" AXIS_PTS_REF mBci_V1TbtArray_XAU16 /end AXIS_DESCR
/end CHARACTERISTIC
/begin CHARACTERISTIC mBci_V1AssistCurveKomf_XAU16 "Motormoment abhängig vom Handmoment bei Geschwindigkeit v1" CURVE 0x8110 AblGLKWBuw 15.00000 MMOT 0.00 15.00000 FORMAT "%8.5"
 /begin AXIS_DESCR COM_AXIS matAbsTorsionBarTorque_xdu16 TBTHIGH 10 0.00 20.00000 FORMAT "%8.5" AXIS_PTS_REF mBci_V1TbtArray_XAU16 /end AXIS_DESCR
/end CHARACTERISTIC
/begin CHARACTERISTIC mBci_V2AssistCurveAuto_XAU16 "Motormoment abhängig vom Handmoment bei Geschwindigkeit v2" CURVE 0x8124 AblGLKWBuw 15.00000 MMOT 0.00 15.00000 FORMAT "%8.5"
 /begin AXIS_DESCR COM_AXIS matAbsTorsionBarTorque_xdu16 TBTHIGH 10 0.00 20.00000 FORMAT "%8.5" AXIS_PTS_REF mBci_V2TbtArray_XAU16 /end AXIS_DESCR
/end CHARACTERISTIC
/begin CHARACTERISTIC mBci_V2AssistCurveDyn_XAU16 "Motormoment abhängig vom Handmoment bei Geschwindigkeit v2" CURVE 0x8138 AblGLKWBuw 15.00000 MMOT 0.00 15.00000 FORMAT "%8.5"
 /begin AXIS_DESCR COM_AXIS matAbsTorsionBarTorque_xdu16 TBTHIGH 10 0.00 20.00000 FORMAT "%8.5" AXIS_PTS_REF mBci_V2TbtArray_XAU16 /end AXIS_DESCR
/end CHARACTERISTIC
/begin CHARACTERISTIC mBci_V2AssistCurveKomf_XAU16 "Motormoment abhängig vom Handmoment bei Geschwindigkeit v2" CURVE 0x814C AblGLKWBuw 15.00000 MMOT 0.00 15.00000 FORMAT "%8.5"
 /begin AXIS_DESCR COM_AXIS matAbsTorsionBarTorque_xdu16 TBTHIGH 10 0.00 20.00000 FORMAT "%8.5" AXIS_PTS_REF mBci_V2TbtArray_XAU16 /end AXIS_DESCR
/end CHARACTERISTIC
/begin CHARACTERISTIC mBci_V3AssistCurveAuto_XAU16 "Motormoment abhängig vom Handmoment bei Geschwindigkeit v3" CURVE 0x8160 AblGLKWBuw 15.00000 MMOT 0.00 15.00000 FORMAT "%8.5"
 /begin AXIS_DESCR COM_AXIS matAbsTorsionBarTorque_xdu16 TBTHIGH 10 0.00 20.00000 FORMAT "%8.5" AXIS_PTS_REF mBci_V3TbtArray_XAU16 /end AXIS_DESCR
/end CHARACTERISTIC
/begin CHARACTERISTIC mBci_V3AssistCurveDyn_XAU16 "Motormoment abhängig vom Handmoment bei Geschwindigkeit v3" CURVE 0x8174 AblGLKWBuw 15.00000 MMOT 0.00 15.00000 FORMAT "%8.5"
 /begin AXIS_DESCR COM_AXIS matAbsTorsionBarTorque_xdu16 TBTHIGH 10 0.00 20.00000 FORMAT "%8.5" AXIS_PTS_REF mBci_V3TbtArray_XAU16 /end AXIS_DESCR
/end CHARACTERISTIC
/begin CHARACTERISTIC mBci_V3AssistCurveKomf_XAU16 "Motormoment abhängig vom Handmoment bei Geschwindigkeit v3" CURVE 0x8188 AblGLKWBuw 15.00000 MMOT 0.00 15.00000 FORMAT "%8.5"
 /begin AXIS_DESCR COM_AXIS matAbsTorsionBarTorque_xdu16 TBTHIGH 10 0.00 20.00000 FORMAT "%8.5" AXIS_PTS_REF mBci_V3TbtArray_XAU16 /end AXIS_DESCR
/end CHARACTERISTIC
/begin CHARACTERISTIC mBci_V4AssistCurveAuto_XAU16 "Motormoment abhängig vom Handmoment bei Geschwindigkeit v4" CURVE 0x819C AblGLKWBuw 15.00000 MMOT 0.00 15.00000 FORMAT "%8.5"
 /begin AXIS_DESCR COM_AXIS matAbsTorsionBarTorque_xdu16 TBTHIGH 10 0.00 20.00000 FORMAT "%8.5" AXIS_PTS_REF mBci_V4TbtArray_XAU16 /end AXIS_DESCR
/end CHARACTERISTIC
/begin CHARACTERISTIC mBci_V4AssistCurveDyn_XAU16 "Motormoment abhängig vom Handmoment bei Geschwindigkeit v4" CURVE 0x81B0 AblGLKWBuw 15.00000 MMOT 0.00 15.00000 FORMAT "%8.5"
 /begin AXIS_DESCR COM_AXIS matAbsTorsionBarTorque_xdu16 TBTHIGH 10 0.00 20.00000 FORMAT "%8.5" AXIS_PTS_REF mBci_V4TbtArray_XAU16 /end AXIS_DESCR
/end CHARACTERISTIC
/begin CHARACTERISTIC mBci_V4AssistCurveKomf_XAU16 "Motormoment abhängig vom Handmoment bei Geschwindigkeit v4" CURVE 0x81C4 AblGLKWBuw 15.00000 MMOT 0.00 15.00000 FORMAT "%8.5"
 /begin AXIS_DESCR COM_AXIS matAbsTorsionBarTorque_xdu16 TBTHIGH 10 0.00 20.00000 FORMAT "%8.5" AXIS_PTS_REF mBci_V4TbtArray_XAU16 /end AXIS_DESCR
/end CHARACTERISTIC
/begin CHARACTERISTIC mBci_V5AssistCurveAuto_XAU16 "Motormoment abhängig vom Handmoment bei Geschwindigkeit v5" CURVE 0x81D8 AblGLKWBuw 15.00000 MMOT 0.00 15.00000 FORMAT "%8.5"
 /begin AXIS_DESCR COM_AXIS matAbsTorsionBarTorque_xdu16 TBTHIGH 10 0.00 20.00000 FORMAT "%8.5" AXIS_PTS_REF mBci_V5TbtArray_XAU16 /end AXIS_DESCR
/end CHARACTERISTIC
/begin CHARACTERISTIC mBci_V5AssistCurveDyn_XAU16 "Motormoment abhängig vom Handmoment bei Geschwindigkeit v5" CURVE 0x81EC AblGLKWBuw 15.00000 MMOT 0.00 15.00000 FORMAT "%8.5"
 /begin AXIS_DESCR COM_AXIS matAbsTorsionBarTorque_xdu16 TBTHIGH 10 0.00 20.00000 FORMAT "%8.5" AXIS_PTS_REF mBci_V5TbtArray_XAU16 /end AXIS_DESCR
/end CHARACTERISTIC
/begin CHARACTERISTIC mBci_V5AssistCurveKomf_XAU16 "Motormoment abhängig vom Handmoment bei Geschwindigkeit v5" CURVE 0x8200 AblGLKWBuw 15.00000 MMOT 0.00 15.00000 FORMAT "%8.5"
 /begin AXIS_DESCR COM_AXIS matAbsTorsionBarTorque_xdu16 TBTHIGH 10 0.00 20.00000 FORMAT "%8.5" AXIS_PTS_REF mBci_V5TbtArray_XAU16 /end AXIS_DESCR
/end CHARACTERISTIC
/begin CHARACTERISTIC mEndStopHsd_MaxAllwdMMotVHigh_GenMode_XDU16 "Max allowed damping torque at high speeds only in generator Mode" VALUE 0x619E AblGLKWuw 12.00000 MMOT 0.00 12.00000 FORMAT "%8.5" /end CHARACTERISTIC
/begin CHARACTERISTIC mEndStop_SpringTorque_XAS16 "Feder Moment Endanschlag" CURVE 0x66C8 AblGLKLsw 23.99902 MMOT 0.00 23.99902 FORMAT "%8.5"
 /begin AXIS_DESCR STD_AXIS lEndStopI_DistanceToEndstop_xds16 RACKPOS128 5 -8.000000 12.00000 FORMAT "%8.5" DEPOSIT ABSOLUTE /end AXIS_DESCR
/end CHARACTERISTIC
/begin CHARACTERISTIC mEndStop_uMotorTorque_XDU16 "Einlernbedingung: Minimales Motormoment fuer fertig gelernt" VALUE 0x61A8 AblGLKWuw 10.00000 MMOT 0.00 10.00000 FORMAT "%8.5" /end CHARACTERISTIC
/begin CHARACTERISTIC mHwlWrapI_MaxMechAllowedTorque_XDF32 "Maximales Moment das der Motor stellen kï¿½nnen darf. Hierï¿½ber kann der Motor der Mechanik angepasst werden." VALUE 0x6014 AblGLKWfl4 19.0000000 ZU0 1.00000000 20.0000000 FORMAT "%10.7" /end CHARACTERISTIC
/begin CHARACTERISTIC mInCo_V0Fading_XAU16 "Fading depending on absolute value of calculated motor torque @ v0" CURVE 0x82BC AblGLKLuw 1.000000 MMOT 0.00 1.000000 FORMAT "%8.6"
 /begin AXIS_DESCR STD_AXIS mInCo_AbsCompTorqueUnLimited_xdu16 MMOT 10 0.00 32.00000 FORMAT "%8.5" DEPOSIT ABSOLUTE /end AXIS_DESCR
/end CHARACTERISTIC
/begin CHARACTERISTIC mInCo_V1Fading_XAU16 "Fading depending on absolute value of calculated motor torque @ v1" CURVE 0x82E8 AblGLKLuw 1.000000 MMOT 0.00 1.000000 FORMAT "%8.6"
 /begin AXIS_DESCR STD_AXIS mInCo_AbsCompTorqueUnLimited_xdu16 MMOT 10 0.00 32.00000 FORMAT "%8.5" DEPOSIT ABSOLUTE /end AXIS_DESCR
/end CHARACTERISTIC
/begin CHARACTERISTIC mInCo_V2Fading_XAU16 "Fading depending on absolute value of calculated motor torque @ v2" CURVE 0x8314 AblGLKLuw 1.000000 MMOT 0.00 1.000000 FORMAT "%8.6"
 /begin AXIS_DESCR STD_AXIS mInCo_AbsCompTorqueUnLimited_xdu16 MMOT 10 0.00 32.00000 FORMAT "%8.5" DEPOSIT ABSOLUTE /end AXIS_DESCR
/end CHARACTERISTIC
/begin CHARACTERISTIC mInCo_V3Fading_XAU16 "Fading depending on absolute value of calculated motor torque @ v3" CURVE 0x8340 AblGLKLuw 1.000000 MMOT 0.00 1.000000 FORMAT "%8.6"
 /begin AXIS_DESCR STD_AXIS mInCo_AbsCompTorqueUnLimited_xdu16 MMOT 10 0.00 32.00000 FORMAT "%8.5" DEPOSIT ABSOLUTE /end AXIS_DESCR
/end CHARACTERISTIC
/begin CHARACTERISTIC mLowVoltAssRed_MinMotorTorqueGen_XDU16 "Minimales Motormoment zur Erkennung generatorischer Betrieb" VALUE 0x8008 AblGLKWuw 1.000000 MMOT 0.00 1.000000 FORMAT "%8.6" /end CHARACTERISTIC
/begin CHARACTERISTIC mSCruiseFadr_TrqThdEmgyEveIndcn_XAU16 "TBT threshold to start emergency event debouncing dependent on vehicle speed" CURVE 0x66F4 AblGLKLuw 24.99023 TBTHIGH 0.009765625 25.00000 FORMAT "%8.5"
 /begin AXIS_DESCR STD_AXIS vSCruiseI_AbsMaxSafeVehSpd_xdu16 VFZHIGH 6 0.00 400.0000 FORMAT "%8.4" DEPOSIT ABSOLUTE /end AXIS_DESCR
/end CHARACTERISTIC
/begin CHARACTERISTIC mSCruiseLimr_MaxMotTrqHandsFree_XAU16 "Max motor torque dependent on vehicle speed in HandsFree mode" CURVE 0x6710 AblGLKLuw 10.00000 MMOT 0.00 10.00000 FORMAT "%8.5"
 /begin AXIS_DESCR STD_AXIS vSCruiseI_AbsMaxSafeVehSpd_xdu16 VFZHIGH 9 0.00 500.0000 FORMAT "%8.4" DEPOSIT ABSOLUTE /end AXIS_DESCR
/end CHARACTERISTIC
/begin CHARACTERISTIC mSCruiseLimr_TbtDbnd4LoDrvr_XDU16 "dead band for TorsionBarTorque used to detect low driver interaction" VALUE 0x61E0 AblGLKWuw 12.00000 TBTHIGH 0.00 12.00000 FORMAT "%8.5" /end CHARACTERISTIC
/begin CHARACTERISTIC mSCruiseLimr_TbtDbndOpenLim_XAU16 "minium torsion bar torque to open the limit (dependent on vehicle speed)" CURVE 0x67B0 AblGLKLuw 12.00000 TBTHIGH 0.00 12.00000 FORMAT "%8.5"
 /begin AXIS_DESCR STD_AXIS vSCruiseI_AbsMaxSafeVehSpd_xdu16 VFZHIGH 9 0.00 250.0000 FORMAT "%8.4" DEPOSIT ABSOLUTE /end AXIS_DESCR
/end CHARACTERISTIC
/begin CHARACTERISTIC mSCruiseLimr_TbtGradDbndCloseLim_XDU16 "dead band for TorsionBarTorque's gradient to close limit expansion" VALUE 0x61E2 AblGLKWuw 1.899902 TORGRAD_RSH14_MS 0.00 1.899902 FORMAT "%8.6" /end CHARACTERISTIC
/begin CHARACTERISTIC mSCruiseLimr_TbtGradDbnd_XAU16 "dead band for TorsionBarTorque's gradient for driver's interaction to open limit expansion" CURVE 0x67D8 AblGLKLuw 1.899902 TORGRAD_RSH14_MS 0.00 1.899902 FORMAT "%8.6"
 /begin AXIS_DESCR STD_AXIS vSCruiseI_AbsMaxSafeVehSpd_xdu16 VFZHIGH 9 0.00 250.0000 FORMAT "%8.4" DEPOSIT ABSOLUTE /end AXIS_DESCR
/end CHARACTERISTIC
/begin CHARACTERISTIC mSCruiseLimr_TbtThdESS_XAU16 "Minimum torsion bar torque threshold for detection of evasive steering event" CURVE 0x6800 AblGLKLuw 12.00000 TBTHIGH 0.00 12.00000 FORMAT "%8.5"
 /begin AXIS_DESCR STD_AXIS vSCruiseI_AbsMaxSafeVehSpd_xdu16 VFZHIGH 9 0.00 250.0000 FORMAT "%8.4" DEPOSIT ABSOLUTE /end AXIS_DESCR
/end CHARACTERISTIC
/begin CHARACTERISTIC mSCruise_ActvJMaxTrqVehSpd_XAU16 "maximum inertia torque dependent on vehicle speed" CURVE 0x6828 AblGLKLuw 10.00000 TBTHIGH 0.00 10.00000 FORMAT "%8.5"
 /begin AXIS_DESCR STD_AXIS vSCruiseI_AbsAvgVehSpd_xdu16 VFZHIGH 4 0.00 400.0000 FORMAT "%8.4" DEPOSIT ABSOLUTE /end AXIS_DESCR
/end CHARACTERISTIC
/begin CHARACTERISTIC mSCruise_DampingTorque_XAU16 "nominal damping torque depending on vehicle speed and rotor speed" MAP 0x72BC AblGLKFuw 12.00000 TBTHIGH 0.00 12.00000 FORMAT "%8.5"
 /begin AXIS_DESCR STD_AXIS vSCruiseI_AbsAvgVehSpd_xdu16 VFZHIGH 6 0.00 500.0000 FORMAT "%8.4" DEPOSIT ABSOLUTE /end AXIS_DESCR
 /begin AXIS_DESCR STD_AXIS nSCruiseI_RotSpd_xds16 VROT_RSH2 7 0.00 8000. FORMAT "%3.0" DEPOSIT ABSOLUTE /end AXIS_DESCR
/end CHARACTERISTIC
/begin CHARACTERISTIC mSCruise_SteerTorqueHandsFree_XAU16 "nominal steering torque depending on vehicle speed and difference in requested rack position and current rack position in Hands Free mode" MAP 0x732C AblGLKFuw 25.00000 TBTHIGH 0.00 25.00000 FORMAT "%8.5"
 /begin AXIS_DESCR STD_AXIS vSCruiseI_AbsAvgVehSpd_xdu16 VFZHIGH 6 0.00 500.0000 FORMAT "%8.4" DEPOSIT ABSOLUTE /end AXIS_DESCR
 /begin AXIS_DESCR STD_AXIS lSCruiseI_RackPosn_xds16 RACKPOS128 7 0.00 60.00000 FORMAT "%8.5" DEPOSIT ABSOLUTE /end AXIS_DESCR
/end CHARACTERISTIC
/begin CHARACTERISTIC mSCruise_SteerTorqueHandsOn_XAU16 "nominal steering torque depending on vehicle speed and difference in requested rack position and current rack position in Hands On mode" MAP 0x739C AblGLKFuw 25.00000 TBTHIGH 0.00 25.00000 FORMAT "%8.5"
 /begin AXIS_DESCR STD_AXIS vSCruiseI_AbsAvgVehSpd_xdu16 VFZHIGH 6 0.00 500.0000 FORMAT "%8.4" DEPOSIT ABSOLUTE /end AXIS_DESCR
 /begin AXIS_DESCR STD_AXIS lSCruiseI_RackPosn_xds16 RACKPOS128 7 0.00 60.00000 FORMAT "%8.5" DEPOSIT ABSOLUTE /end AXIS_DESCR
/end CHARACTERISTIC
/begin CHARACTERISTIC matD2T3Fading_XAU16 "Ausblendung des D2T3 Filters" CURVE 0x6684 AblGLKLuw 12.00000 MMOT 0.00 12.00000 FORMAT "%8.5"
 /begin AXIS_DESCR STD_AXIS matAbsAssistD2T3Delta_xdu16 MMOT 6 0.00 12.00000 FORMAT "%8.5" DEPOSIT ABSOLUTE /end AXIS_DESCR
/end CHARACTERISTIC
/begin CHARACTERISTIC nEndStopHsd_HighSpeedDampingStartReverse_XAS16 "Drehzahl ab welcher die 'HighSpeed' Daempfung beginnt beim Rueckwaertsfahren" CURVE 0x68CC AblGLKLsw 5000. VROT 0.00 5000. FORMAT "%3.0"
 /begin AXIS_DESCR STD_AXIS lEndStopHsd_InternDistToES_xds16 RACKPOS128 3 0.00 125.0000 FORMAT "%8.4" DEPOSIT ABSOLUTE /end AXIS_DESCR
/end CHARACTERISTIC
/begin CHARACTERISTIC nEndStopHsd_HighSpeedDampingStart_XAS16 "Drehzahl ab welcher die 'HighSpeed' Daempfung beginnt" CURVE 0x68DC AblGLKLsw 5000. VROT 0.00 5000. FORMAT "%3.0"
 /begin AXIS_DESCR STD_AXIS lEndStopHsd_InternDistToES_xds16 RACKPOS128 3 0.00 125.0000 FORMAT "%8.4" DEPOSIT ABSOLUTE /end AXIS_DESCR
/end CHARACTERISTIC
/begin CHARACTERISTIC nEndStopHsd_RotSpeedFallingHysteresisReverse_XAU16 "Hysterese auf Eingangsdrehzahl beim Rueckwaertsfahren" CURVE 0x68EC AblGLKLuw 5000. VROT 0.00 5000. FORMAT "%3.0"
 /begin AXIS_DESCR STD_AXIS vApplI_AbsVehicleSpeedFilt_xdu16 VFZHIGH 3 0.00 500.0000 FORMAT "%8.4" DEPOSIT ABSOLUTE /end AXIS_DESCR
/end CHARACTERISTIC
/begin CHARACTERISTIC nEndStopHsd_RotSpeedFallingHysteresis_XAU16 "Hysterese auf Eingangsdrehzahl" CURVE 0x68FC AblGLKLuw 5000. VROT 0.00 5000. FORMAT "%3.0"
 /begin AXIS_DESCR STD_AXIS vApplI_AbsVehicleSpeedFilt_xdu16 VFZHIGH 3 0.00 500.0000 FORMAT "%8.4" DEPOSIT ABSOLUTE /end AXIS_DESCR
/end CHARACTERISTIC
/begin CHARACTERISTIC nEndStopHsd_UnderVoltageStartOffset_XAU16 "Drehzahl um die die Startdrehzahl bei Unterspannung reduziert wird" CURVE 0x690C AblGLKLuw 5000. VROT 0.00 5000. FORMAT "%3.0"
 /begin AXIS_DESCR STD_AXIS uApplI_SupplyVoltage_xdu16 U64V 3 0.00 20.00000 FORMAT "%8.5" DEPOSIT ABSOLUTE /end AXIS_DESCR
/end CHARACTERISTIC
/begin CHARACTERISTIC nLowVoltAssRed_EngineRunningLowerLimit_XDU16 "Verbrennnungsmotor laeuft untere Drehzahlgrenze" VALUE 0x800E AblGLKWuw 6000. VROT 0.00 6000. FORMAT "%3.0" /end CHARACTERISTIC
/begin CHARACTERISTIC nLowVoltAssRed_EngineRunningUpperLimit_XDU16 "Verbrennnungsmotor laeuft obere Drehzahlgrenze" VALUE 0x8010 AblGLKWuw 6000. VROT 0.00 6000. FORMAT "%3.0" /end CHARACTERISTIC
/begin CHARACTERISTIC nLowVoltAssRed_MinRotorSpeedGen_XDU16 "Minimale Rotordrehzahl zur Erkennung generatorischer Betrieb" VALUE 0x8012 AblGLKWuw 1000. VROT 0.00 1000. FORMAT "%3.0" /end CHARACTERISTIC
/begin CHARACTERISTIC nMchStPrv_BoundRotSpeedGRADTBT_XAU16 "Referenzdrehzahl abhängig vom Gradient Handmoment" CURVE 0x691C AblGLKLuw 150. VROT 0.00 150. FORMAT "%3.0"
 /begin AXIS_DESCR STD_AXIS mMchStPrv_FilteredGRADTBT_xdu16 TORGRAD 4 0.00 10.00000 FORMAT "%8.5" DEPOSIT ABSOLUTE /end AXIS_DESCR
/end CHARACTERISTIC
/begin CHARACTERISTIC nMchStPrv_BoundRotSpeedMeffVO_XAU16 "Referenzdrehzahl abhängig vom Wirkmoment für geringe Fahrzeuggeschwindigkeiten" CURVE 0x6930 AblGLKLuw 150. VROT 0.00 150. FORMAT "%3.0"
 /begin AXIS_DESCR STD_AXIS mMchStPrv_AbsEffMotTor_xdu16 MMOT 4 0.00 10.00000 FORMAT "%8.5" DEPOSIT ABSOLUTE /end AXIS_DESCR
/end CHARACTERISTIC
/begin CHARACTERISTIC nMchStPrv_BoundRotSpeedMeff_XAU16 "Referenzdrehzahl abhängig vom Wirkmoment" CURVE 0x6944 AblGLKLuw 150. VROT 0.00 150. FORMAT "%3.0"
 /begin AXIS_DESCR STD_AXIS mMchStPrv_AbsEffMotTor_xdu16 MMOT 4 0.00 10.00000 FORMAT "%8.5" DEPOSIT ABSOLUTE /end AXIS_DESCR
/end CHARACTERISTIC
/begin CHARACTERISTIC nMchStPrv_BoundRotSpeedSWA_XAU16 "Referenzdrehzahl abhängig vom Lenkwinkel" CURVE 0x6958 AblGLKLuw 150. VROT 0.00 150. FORMAT "%3.0"
 /begin AXIS_DESCR STD_AXIS wApplI_AbsSteeringAngle_xdu16 SA_10 4 0.00 10.00000 FORMAT "%8.5" DEPOSIT ABSOLUTE /end AXIS_DESCR
/end CHARACTERISTIC
/begin CHARACTERISTIC ncruAbsChatterGrad_XDU16 "minimum rotor acceleration to activation the Chatter detection" VALUE 0x621E AblGLKWuw 299.0000 ROTACC 1.000000 300.0000 FORMAT "%8.4" /end CHARACTERISTIC
/begin CHARACTERISTIC sRpSync_CalibControl_XDU8 "Kalibrierung iLWS: 0->3:CheckCalibAllowed, 0->6:CalibZeroPos, 0->7:ResetInit, 0->8:ResetCalib" VALUE 0x80CEF2 AblGLKWub 8.000 ZU0 0.00 8.000 FORMAT "%5.3" /end CHARACTERISTIC
/begin CHARACTERISTIC sSCruise_SubState_XDU8 "Substitution of ReqdState if value is within valid range of ReqdState: 0=Off, 1=HandsOn, 2=HandsFree, 3=Parking, 4=HandsOnInc" VALUE 0x64AA AblGLKWub 255.0 ZU0 0.00 255.0 FORMAT "%5.1" /end CHARACTERISTIC
/begin CHARACTERISTIC tDiagConn_WorkingTimeUs_XDU16 "Laufzeitgrenze Abarbeitung Events" VALUE 0x6264 AblGLKWuw 150.0000 TIMUS 0.00 150.0000 FORMAT "%8.4" /end CHARACTERISTIC
/begin CHARACTERISTIC tEndStopHsd_SpeedTooHighTol_XDU16 "Zeit in der ein Ueberschreiten des Geschwindigkeitsgrenzwerts toleriert wird, bevor Rueckwaertsfahrt abgebrochen wird" VALUE 0x6272 AblGLKWuw 4.999000 TIMSEC_1000 0.001000000 5.000000 FORMAT "%8.6" /end CHARACTERISTIC
/begin CHARACTERISTIC tEndStopHsd_VehDirDebounceTime_XDU16 "Zeitliche Entprellung des Rueckfahrflags von Rueckwaerts- auf Vorwaertsfahrt" VALUE 0x6274 AblGLKWuw 9.999000 TIMSEC_1000 0.001000000 10.00000 FORMAT "%8.5" /end CHARACTERISTIC
/begin CHARACTERISTIC tLowVoltAssRed_EngineRunningTimeLimit_XDU16 "Zeit wenn Signale Fahrbereitschaft und Motordrehzahl stabil" VALUE 0x8022 AblGLKWuw 65000.00 TIMMS 0.00 65000.00 FORMAT "%8.2" /end CHARACTERISTIC
/begin CHARACTERISTIC tLowVoltAssRed_UnderVoltageOutStageOffTime_XDU16 "Definiert maximale Zeitdauer fuer kurzes Abschalten der Endstufe " VALUE 0x80CE7C AblGLKWuw 65000.00 TIMMS 0.00 65000.00 FORMAT "%8.2" /end CHARACTERISTIC
/begin CHARACTERISTIC tMchStPrv_HakelPeriodHalf_XDU16 "Zeit in ms für eine halbe Periode für das MchStPrv Moment" VALUE 0x627A AblGLKWuw 50.00000 ZU0 0.00 50.00000 FORMAT "%8.5" /end CHARACTERISTIC
/begin CHARACTERISTIC tSCruiseLimr_DetnDebESSHiDyn_XDU8 "maximum time between beginning of the driver interaction and detection of high dynamic" VALUE 0x64BA AblGLKWub 1.000 TIMSEC_100 0.00 1.000 FORMAT "%5.3" /end CHARACTERISTIC
/begin CHARACTERISTIC tSCruiseLimr_DetnDebESSThd_XDU8 "maximum time between detection of high dynamic and the detection of an ESS trigger" VALUE 0x64BB AblGLKWub 1.000 TIMSEC_100 0.00 1.000 FORMAT "%5.3" /end CHARACTERISTIC
/begin CHARACTERISTIC tSCruiseLimr_LoDynPrecndnESS_XDU8 "Driver is not interacting for a specified time before ESS is triggert" VALUE 0x64BC AblGLKWub 2.500 TIMSEC_100 0.00 2.500 FORMAT "%5.3" /end CHARACTERISTIC
/begin CHARACTERISTIC tSCruiseLimr_MaxDebExtReqESS_XDU8 "maximum time to debounce a driver event waiting for external request of evasive steering support" VALUE 0x64BD AblGLKWub 1.000 TIMSEC_100 0.00 1.000 FORMAT "%5.3" /end CHARACTERISTIC
/begin CHARACTERISTIC tSCruiseLimr_MaxEnadESS_XDU8 "maximum time of enabled evasive steering support" VALUE 0x64BE AblGLKWub 5.000 TIMSEC_10 0.00 5.000 FORMAT "%5.3" /end CHARACTERISTIC
/begin CHARACTERISTIC tSCruiseLimr_MaxJImp_XDU8 "maximum supposed inertia impulse to suppress a TBT expansion" VALUE 0x64BF AblGLKWub 0.2480 TIMSEC_1000 0.002000 0.2500 FORMAT "%6.4" /end CHARACTERISTIC
/begin CHARACTERISTIC tSCruiseLimr_MinJImp_XDU8 "minimum supposed inertia impulse to suppress a TBT expansion" VALUE 0x64C0 AblGLKWub 0.2480 TIMSEC_1000 0.001000 0.2490 FORMAT "%6.4" /end CHARACTERISTIC
/begin CHARACTERISTIC tcrChatterCycleResetDelay_XDU16 "hold chatter cycle counter for this time to the value of MinChatterPeriodsCountDelayed" VALUE 0x6262 AblGLKWuw 59.99900 TIMSEC_1000 0.001000000 60.00000 FORMAT "%8.5" /end CHARACTERISTIC
/begin CHARACTERISTIC tcroChatterTime_XDU8 "maximum time until next half period of rotor acceleration must be detected" VALUE 0x64AF AblGLKWub 0.2530 TIMSEC_1000 0.001000 0.2540 FORMAT "%6.4" /end CHARACTERISTIC
/begin CHARACTERISTIC uEndStopHsd_ApplyUOffsetTh_XDU16 "Voltage threshold under which to apply the additional rotorspeed offset" VALUE 0x62B8 AblGLKWuw 33.00000 U64V 0.00 33.00000 FORMAT "%8.5" /end CHARACTERISTIC
/begin CHARACTERISTIC vEndStopHsd_BackwardDisableTh_XDU8 "Ruecksetzen der Rueckfahrerkennung unterhalb dieser Geschwindigkeitsschwelle" VALUE 0x64C9 AblGLKWub 50.00 VFZ 0.00 50.00 FORMAT "%5.2" /end CHARACTERISTIC
/begin CHARACTERISTIC vEndStopHsd_BackwardEnableTh_XDU8 "Rueckwaertsfahrt wird erst oberhalb dieser Geschwindigkeitsschwelle erkannt" VALUE 0x64CA AblGLKWub 50.00 VFZ 0.00 50.00 FORMAT "%5.2" /end CHARACTERISTIC
/begin CHARACTERISTIC vEndStopHsd_MaxAllowedBackward_XDU8 "Abbruch Rueckwaertsfahrterkennung oberhalb dieser Geschwindigkeit" VALUE 0x64CB AblGLKWub 90.00 VFZ 10.00 100.0 FORMAT "%5.1" /end CHARACTERISTIC
/begin CHARACTERISTIC vEndStop_HysteresisRange_XDU16 "Hysterebreite fuer Fahrzeuggeschwindigkeit" VALUE 0x62E6 AblGLKWuw 327.0000 VFZHIGH 0.00 327.0000 FORMAT "%8.4" /end CHARACTERISTIC
/begin CHARACTERISTIC vEndStop_MaxEndStopOffsetGradFalling_XDU16 "maximaler fallender Gradient fuer EndStop Verschiebung [mm/ms]" VALUE 0x803A AblGLKWuw 0.1660004 RIGHTSH18NP 0.00 0.1660004 FORMAT "%9.7" /end CHARACTERISTIC
/begin CHARACTERISTIC vEndStop_MaxEndStopOffsetGradRising_XDU16 "maximaler steigender Gradient fuer EndStop Verschiebung [mm/ms]" VALUE 0x803C AblGLKWuw 0.1660004 RIGHTSH18NP 0.00 0.1660004 FORMAT "%9.7" /end CHARACTERISTIC
/begin CHARACTERISTIC vInCo_VehSpeedForFactors_XAS16 "selection of vehicle speed dependent characteristic curves" VAL_BLK 0x6000 AblGLKWBsw 500.0000 VFZHIGH 0.00 500.0000 FORMAT "%8.4" NUMBER 4 /end CHARACTERISTIC
/begin CHARACTERISTIC vLowVoltAssRed_EngineRunningSpeedLimit_XDU16 "Schwelle fuer Fahrzeug faehrt" VALUE 0x803E AblGLKWuw 511.0000 VFZHIGH 0.00 511.0000 FORMAT "%8.4" /end CHARACTERISTIC
/begin CHARACTERISTIC vMchStPrv_MeffV0bound_XDU16 "Umschaltwert für BoundRotSpeedTBTV0 nach BoundRotSpeedTBT" VALUE 0x62EE AblGLKWuw 230.0000 VFZHIGH 0.00 230.0000 FORMAT "%8.4" /end CHARACTERISTIC
/begin CHARACTERISTIC vSCruiseLimr_MaxRackSpdDrvrIsIntractn_XAU16 "maximum allowed rack speed in case of driver interaction (dependent on vehicle speed)" CURVE 0x6994 AblGLKLuw 249.0000 RACKSPEED128 1.000000 250.0000 FORMAT "%8.4"
 /begin AXIS_DESCR STD_AXIS vSCruiseI_AbsMaxSafeVehSpd_xdu16 VFZHIGH 9 0.00 250.0000 FORMAT "%8.4" DEPOSIT ABSOLUTE /end AXIS_DESCR
/end CHARACTERISTIC
/begin CHARACTERISTIC vSCruiseLimr_MaxRackSpdESS_XAU16 "maximum allowed rack speed in case of evasive steering (dependent on vehicle speed)" CURVE 0x69BC AblGLKLuw 250.0000 RACKSPEED128 0.00 250.0000 FORMAT "%8.4"
 /begin AXIS_DESCR STD_AXIS vSCruiseI_AbsMaxSafeVehSpd_xdu16 VFZHIGH 9 0.00 250.0000 FORMAT "%8.4" DEPOSIT ABSOLUTE /end AXIS_DESCR
/end CHARACTERISTIC
/begin CHARACTERISTIC vSCruiseLimr_MaxRackSpdHandsFree_XAU16 "maximum allowed rack speed while HandsFree is active (dependent on vehicle speed)" CURVE 0x69E4 AblGLKLuw 248.9297 RACKSPEED128 0.07031250 249.0000 FORMAT "%8.4"
 /begin AXIS_DESCR STD_AXIS vSCruiseI_AbsMaxSafeVehSpd_xdu16 VFZHIGH 9 0.00 250.0000 FORMAT "%8.4" DEPOSIT ABSOLUTE /end AXIS_DESCR
/end CHARACTERISTIC
/begin CHARACTERISTIC vSCruiseLimr_MaxRackSpdHandsOnInc_XAU16 "maximum allowed rack speed while HandsOn Dynamic Increased is active (dependent on vehicle speed)" CURVE 0x6A0C AblGLKLuw 249.0000 RACKSPEED128 0.00 249.0000 FORMAT "%8.4"
 /begin AXIS_DESCR STD_AXIS vSCruiseI_AbsMaxSafeVehSpd_xdu16 VFZHIGH 9 0.00 250.0000 FORMAT "%8.4" DEPOSIT ABSOLUTE /end AXIS_DESCR
/end CHARACTERISTIC
/begin CHARACTERISTIC vSCruiseLimr_MaxRackSpdHandsOn_XAU16 "maximum allowed rack speed while HandsOn is active (dependent on vehicle speed)" CURVE 0x6A34 AblGLKLuw 249.0000 RACKSPEED128 0.00 249.0000 FORMAT "%8.4"
 /begin AXIS_DESCR STD_AXIS vSCruiseI_AbsMaxSafeVehSpd_xdu16 VFZHIGH 9 0.00 250.0000 FORMAT "%8.4" DEPOSIT ABSOLUTE /end AXIS_DESCR
/end CHARACTERISTIC
/begin CHARACTERISTIC vSCruiseLimr_MaxRackSpdPrkg_XAU16 "maximum allowed rack speed while parking is active (dependent on vehicle speed). If vehicle speed is above highest setpoint vSCruiseLimr_MaxRackSpdHandsFree_XAU16 will be applied." CURVE 0x6A5C AblGLKLuw 249.0000 RACKSPEED128 0.00 249.0000 FORMAT "%8.4"
 /begin AXIS_DESCR STD_AXIS vSCruiseI_AbsMaxSafeVehSpd_xdu16 VFZHIGH 3 0.00 250.0000 FORMAT "%8.4" DEPOSIT ABSOLUTE /end AXIS_DESCR
/end CHARACTERISTIC
/begin CHARACTERISTIC vSCruiseLimr_MaxVehSpdESS_XDU8 "maximum vehicle speed for evasive steering support" VALUE 0x64CC AblGLKWub 250.0 VFZ 0.00 250.0 FORMAT "%5.1" /end CHARACTERISTIC
/begin CHARACTERISTIC vSCruiseLimr_MinVehSpdESS_XDU8 "minimum vehicle speed for evasive steering support" VALUE 0x64CD AblGLKWub 250.0 VFZ 0.00 250.0 FORMAT "%5.1" /end CHARACTERISTIC
/begin CHARACTERISTIC vSCruiseLimr_RackSpdThdESS_XAU16 "Minimum RackSpeed threshold for detection of evasive steering event" CURVE 0x6A6C AblGLKLuw 249.0000 RACKSPEED128 0.00 249.0000 FORMAT "%8.4"
 /begin AXIS_DESCR STD_AXIS vSCruiseI_AbsMinSafeVehSpd_xdu16 VFZHIGH 9 0.00 250.0000 FORMAT "%8.4" DEPOSIT ABSOLUTE /end AXIS_DESCR
/end CHARACTERISTIC
/begin CHARACTERISTIC vcrVehSpeedLimit_XDU16 "minimum vahicle speed to start the holding timer" VALUE 0x62CE AblGLKWuw 255.0000 VFZHIGH 0.00 255.0000 FORMAT "%8.4" /end CHARACTERISTIC
/begin CHARACTERISTIC xBci_AssistPostscaleFactorAuto_XDU16 "Charisma Auto: Faktorisierung der Assist-Kennlinien in y-Richtung (Motormoment)" VALUE 0x804C AblGLKWuw 1.000000 RIGHTSH13NP 0.5000000 1.500000 FORMAT "%8.6" /end CHARACTERISTIC
/begin CHARACTERISTIC xBci_AssistPostscaleFactorDyn_XDU16 "Charisma Dynamic: Faktorisierung der Assist-Kennlinien in y-Richtung (Motormoment)" VALUE 0x804E AblGLKWuw 1.000000 RIGHTSH13NP 0.5000000 1.500000 FORMAT "%8.6" /end CHARACTERISTIC
/begin CHARACTERISTIC xBci_AssistPostscaleFactorKomf_XDU16 "Charisma Komfort: Faktorisierung der Assist-Kennlinien in y-Richtung (Motormoment)" VALUE 0x8050 AblGLKWuw 1.000000 RIGHTSH13NP 0.5000000 1.500000 FORMAT "%8.6" /end CHARACTERISTIC
/begin CHARACTERISTIC xBci_AssistPrescaleFactorAuto_XDU16 "Charisma Auto: Faktorisierung der Assist-Kennlinien in X-Richtung (Drehstabmoment)" VALUE 0x8052 AblGLKWuw 1.000000 RIGHTSH13NP 0.5000000 1.500000 FORMAT "%8.6" /end CHARACTERISTIC
/begin CHARACTERISTIC xBci_AssistPrescaleFactorDyn_XDU16 "Charisma Dynamik: Faktorisierung der Assist-Kennlinien in X-Richtung (Drehstabmoment)" VALUE 0x8054 AblGLKWuw 1.000000 RIGHTSH13NP 0.5000000 1.500000 FORMAT "%8.6" /end CHARACTERISTIC
/begin CHARACTERISTIC xBci_AssistPrescaleFactorKomf_XDU16 "Charisma Komfort: Faktorisierung der Assist-Kennlinien in X-Richtung (Drehstabmoment)" VALUE 0x8056 AblGLKWuw 1.000000 RIGHTSH13NP 0.5000000 1.500000 FORMAT "%8.6" /end CHARACTERISTIC
/begin CHARACTERISTIC xCalDatHdl_EraseAllXcpFlashedData_XDU8 "Lï¿½schen alle Bereiche die per XCP beschrieben wurden. 0 = mache nichts; 1 = loeschen" VALUE 0x80CEF8 AblGLKWub 1.000 ZU0 0.00 1.000 FORMAT "%5.3" /end CHARACTERISTIC
/begin CHARACTERISTIC xCalDatHdl_StartXcpFlash_XDU8 "Ausloeser fï¿½r XCP Flash" VALUE 0x80CEF9 AblGLKWub 1.000 ZU0 0.00 1.000 FORMAT "%5.3" /end CHARACTERISTIC
/begin CHARACTERISTIC xEndStopHsd_HighSpeedDampingFactorReverse_XAU16 "'High Speed Daempfungsfaktor Nm*min abhaengig von vFahrzeug beim Rueckwaertsfahren" CURVE 0x6B70 AblGLKLuw 0.004882813 RIGHTSH15NP 0.00 0.004882813 FORMAT "%11.9"
 /begin AXIS_DESCR STD_AXIS vApplI_AbsVehicleSpeedFilt_xdu16 VFZHIGH 4 0.00 255.0000 FORMAT "%8.4" DEPOSIT ABSOLUTE /end AXIS_DESCR
/end CHARACTERISTIC
/begin CHARACTERISTIC xEndStopHsd_HighSpeedDampingFactor_XAU16 "'High Speed Daempfungsfaktor Nm*min abhaengig von vFahrzeug" CURVE 0x6B84 AblGLKLuw 0.004882813 RIGHTSH15NP 0.00 0.004882813 FORMAT "%11.9"
 /begin AXIS_DESCR STD_AXIS vApplI_AbsVehicleSpeedFilt_xdu16 VFZHIGH 4 0.00 255.0000 FORMAT "%8.4" DEPOSIT ABSOLUTE /end AXIS_DESCR
/end CHARACTERISTIC
/begin CHARACTERISTIC xEndStop_Damping_XAS16 "Daempfungskennlinie in Nm/(1024/min) abhaengig vom Abstand zum Endanschlag" CURVE 0x6BC0 AblGLKLsw 10.00000 NM_MIN_1024 0.00 10.00000 FORMAT "%8.5"
 /begin AXIS_DESCR STD_AXIS lEndStopI_DistanceToEndstop_xds16 RACKPOS128 5 -8.000000 12.00000 FORMAT "%8.5" DEPOSIT ABSOLUTE /end AXIS_DESCR
/end CHARACTERISTIC
/begin CHARACTERISTIC xEndStop_OversteerabilityFactor_XDU16 "Ueberlenkbarkeitsfaktor" VALUE 0x806A AblGLKWuw 1.000000 RIGHTSH15NP 0.00 1.000000 FORMAT "%8.6" /end CHARACTERISTIC
/begin CHARACTERISTIC xEndStop_RotSpeedFiltFact_XDU16 "Filterfaktor fuer Rotordrehzahl; [value = filterfact * task cycle time]" VALUE 0x6388 AblGLKWuw 0.9882813 RIGHTSH8NP 0.01171875 1.000000 FORMAT "%8.6" /end CHARACTERISTIC
/begin CHARACTERISTIC xEndStop_VehSpeedFiltFact_XDU16 "Filterfaktor fuer Fahrzeuggeschwindigkeit" VALUE 0x806E AblGLKWuw 0.9997559 RIGHTSH12NP 0.0002441406 1.000000 FORMAT "%8.6" /end CHARACTERISTIC
/begin CHARACTERISTIC xInCo_ChatterRotAccFactor_XAS16 "Trägheitsmomentfaktor abhängig von der Fahrzeuggeschwindigkeit, wenn Umschaltgrenze -zInCo_ChatterCountLimitInertia_XDU8- ueberschritten" CURVE 0x6C00 AblGLKLsw 3.999939 INERTOR_HIGH -2.000000 1.999939 FORMAT "%8.6"
 /begin AXIS_DESCR STD_AXIS vInCo_AbsVehicleSpeedFilt_xds16 VFZHIGH 5 0.00 500.0000 FORMAT "%8.4" DEPOSIT ABSOLUTE /end AXIS_DESCR
/end CHARACTERISTIC
/begin CHARACTERISTIC xInCo_InvalidInputSigRotAccFactor_XDS16 "Traegheitsmomentfaktor, wenn Eingangssignale ungueltig" VALUE 0x638E AblGLKWsw 3.999939 INERTOR_HIGH -2.000000 1.999939 FORMAT "%8.6" /end CHARACTERISTIC
/begin CHARACTERISTIC xInCo_RotAccFactor_XAS16 "Trägheitsmomentfaktor abhängig von der Fahrzeuggeschwindigkeit" CURVE 0x6C18 AblGLKLsw 3.999939 INERTOR_HIGH -2.000000 1.999939 FORMAT "%8.6"
 /begin AXIS_DESCR STD_AXIS vInCo_AbsVehicleSpeedFilt_xds16 VFZHIGH 5 0.00 500.0000 FORMAT "%8.4" DEPOSIT ABSOLUTE /end AXIS_DESCR
/end CHARACTERISTIC
/begin CHARACTERISTIC xLowVoltAssRed_AssistFactorSupVoltDef_XDU16 "Unterstuetzungsfaktor bei erkanntem Defekt der Spannungsversorgung" VALUE 0x63B4 AblGLKWuw 50.00000 RSH15 50.00000 100.0000 FORMAT "%8.4" /end CHARACTERISTIC
/begin CHARACTERISTIC xLowVoltAssRed_CurrentFactorSupVoltDef_XDU16 "Stromfaktor bei erkanntem Defekt der Spannungsversorgung" VALUE 0x63BE AblGLKWuw 100.0000 RSH15 0.00 100.0000 FORMAT "%8.4" /end CHARACTERISTIC
/begin CHARACTERISTIC xLowVoltAssRed_CurrentGradientFactorSupVoltDef_XDU16 "Stromgradientfaktor bei erkanntem Defekt der Spannungsversorgung" VALUE 0x63C8 AblGLKWuw 100.0000 RSH15_GRAD1MS 0.00 100.0000 FORMAT "%8.4" /end CHARACTERISTIC
/begin CHARACTERISTIC xLowVoltAssRed_EngineRunningAssistLimit_XDU16 "Minimale Unterstuetzungsschwelle fuer Motor laeuft stabil" VALUE 0x8078 AblGLKWuw 100.0000 RSH15 0.00 100.0000 FORMAT "%8.4" /end CHARACTERISTIC
/begin CHARACTERISTIC xLowVoltAssRed_GradTorqueGradientNegDAC_XDU16 "Reduktionsgradient (fallend) fuer Motormoment Gradientenreduktion DAC" VALUE 0x8080 AblGLKWuw 100.0000 RSH15_GRAD1MS 0.00 100.0000 FORMAT "%8.4" /end CHARACTERISTIC
/begin CHARACTERISTIC xLowVoltAssRed_GradTorqueGradientPosDAC_XDU16 "Reduktionsgradient (steigend) fuer Motormoment Gradientenreduktion DAC" VALUE 0x8082 AblGLKWuw 100.0000 RSH15_GRAD1MS 0.00 100.0000 FORMAT "%8.4" /end CHARACTERISTIC
/begin CHARACTERISTIC xLowVoltAssRed_NegGradAssistFactor_XDU16 "Negativer Gradient des Unterstuetzungsfaktors" VALUE 0x8084 AblGLKWuw 100.0000 RSH15_GRAD1MS 0.00 100.0000 FORMAT "%8.4" /end CHARACTERISTIC
/begin CHARACTERISTIC xLowVoltAssRed_NegGradCurrentFactor_XDU16 "Negativer Gradient des Stromfaktors" VALUE 0x8086 AblGLKWuw 100.0000 RSH15_GRAD1MS 0.00 100.0000 FORMAT "%8.4" /end CHARACTERISTIC
/begin CHARACTERISTIC xLowVoltAssRed_NegGradCurrentGradientFactor_XDU16 "Negativer Gradient des Stromgradientfaktors" VALUE 0x8088 AblGLKWuw 100.0000 RSH15_GRAD1MS 0.00 100.0000 FORMAT "%8.4" /end CHARACTERISTIC
/begin CHARACTERISTIC xLowVoltAssRed_PosGradCurrentFactorVehNotRun_XDU16 "Positiver Gradient des Stromfaktors wenn das Fahrzeug steht" VALUE 0x808E AblGLKWuw 100.0000 RSH15_GRAD1MS 0.00 100.0000 FORMAT "%8.4" /end CHARACTERISTIC
/begin CHARACTERISTIC xLowVoltAssRed_UnderVoltageAssistFactorGen_XAU16 "Unterstuetzungsfaktor generatorischer Betrieb abhaengig von Versorgungsspannung" CURVE 0x6C30 AblGLKLuw 100.0000 RSH15 0.00 100.0000 FORMAT "%8.4"
 /begin AXIS_DESCR STD_AXIS uHwlWrapI_SupplyVoltageUnfilt_xdu16 U64V 3 0.00 33.00000 FORMAT "%8.5" DEPOSIT ABSOLUTE /end AXIS_DESCR
/end CHARACTERISTIC
/begin CHARACTERISTIC xLowVoltAssRed_UnderVoltageTorqueGradientDAC_XAU16 "Motormoment Gradient Reduktionsfaktor DAC" CURVE 0x6CBC AblGLKLuw 100.0000 RSH15_GRAD1MS 0.00 100.0000 FORMAT "%8.4"
 /begin AXIS_DESCR STD_AXIS uHwlWrapI_SupplyVoltageUnfilt_xdu16 U64V 3 0.00 33.00000 FORMAT "%8.5" DEPOSIT ABSOLUTE /end AXIS_DESCR
/end CHARACTERISTIC
/begin CHARACTERISTIC xMchStPrv_GradTBTFilterFact_XDU16 "Filterfaktor auf Gradienten des TBT" VALUE 0x63CA AblGLKWuw 0.9990234 RIGHTSH10NP 0.0009765625 1.000000 FORMAT "%8.6" /end CHARACTERISTIC
/begin CHARACTERISTIC xMchStPrv_GroundLevelFactHakel_XDU16 "Faktor auf die MchStPrv Amplitude für Grundniveau das immer aufgeschaltet wird" VALUE 0x63CC AblGLKWuw 1.000000 RIGHTSH15NP 0.00 1.000000 FORMAT "%8.6" /end CHARACTERISTIC
/begin CHARACTERISTIC xMchStPrv_GroundLevelHakelAngle_XAU16 "Faktor auf Grundnieveau der Antihakelamplitude abhängig vom Lenkwinkel" CURVE 0x6CCC AblGLKLuw 1.000000 RIGHTSH15NP 0.00 1.000000 FORMAT "%8.6"
 /begin AXIS_DESCR STD_AXIS wApplI_AbsSteeringAngle_xdu16 SA_10 4 0.00 500.0000 FORMAT "%8.4" DEPOSIT ABSOLUTE /end AXIS_DESCR
/end CHARACTERISTIC
/begin CHARACTERISTIC xMchStPrv_GroundLevelHakelVFZFactor_XAU16 "Faktor auf Grundniveau der MchStPrv Amplitude abhängig von der Fahrzeuggeschwindigkeit" CURVE 0x6CE0 AblGLKLuw 1.000000 RIGHTSH15NP 0.00 1.000000 FORMAT "%8.6"
 /begin AXIS_DESCR STD_AXIS vApplI_AbsVehicleSpeedFilt_xdu16 VFZHIGH 4 0.00 250.0000 FORMAT "%8.4" DEPOSIT ABSOLUTE /end AXIS_DESCR
/end CHARACTERISTIC
/begin CHARACTERISTIC xMchStPrv_HakelGrad_XDU16 "Gradient zum Einrampen des MchStPrv Momentes" VALUE 0x63CE AblGLKWuw 1.000000 RIGHTSH15NP 0.00 1.000000 FORMAT "%8.6" /end CHARACTERISTIC
/begin CHARACTERISTIC xMchStPrv_MaxActDepSteeringAngle_XAU16 "Maximale Aktivierung in Abhängigkeit des Lenkwinkels" CURVE 0x6CF4 AblGLKLuw 1.000000 RIGHTSH15NP 0.00 1.000000 FORMAT "%8.6"
 /begin AXIS_DESCR STD_AXIS wApplI_AbsSteeringAngle_xdu16 SA_10 3 0.00 600.0000 FORMAT "%8.4" DEPOSIT ABSOLUTE /end AXIS_DESCR
/end CHARACTERISTIC
/begin CHARACTERISTIC xMchStPrv_MaxActDepVFZ_XAU16 "Maximale Aktivierung in Abhängigkeit der Fahrzeugeschwindigkeit" CURVE 0x6D04 AblGLKLuw 1.000000 RIGHTSH15NP 0.00 1.000000 FORMAT "%8.6"
 /begin AXIS_DESCR STD_AXIS vApplI_AbsVehicleSpeedFilt_xdu16 VFZHIGH 4 0.00 250.0000 FORMAT "%8.4" DEPOSIT ABSOLUTE /end AXIS_DESCR
/end CHARACTERISTIC
/begin CHARACTERISTIC xMchStPrv_RotSpeedRefVFZFactor_XAU16 "Faktor auf Referenzdrehzahl abhängig von der Fahrzeuggeschwindigkeit" CURVE 0x6D18 AblGLKLuw 1.000000 RIGHTSH10NP 0.00 1.000000 FORMAT "%8.6"
 /begin AXIS_DESCR STD_AXIS vApplI_AbsVehicleSpeedFilt_xdu16 VFZHIGH 4 0.00 250.0000 FORMAT "%8.4" DEPOSIT ABSOLUTE /end AXIS_DESCR
/end CHARACTERISTIC
/begin CHARACTERISTIC xRotSp_RotAccelerationLowFilterFact_XDU16 "Geringer Filterfaktor der nicht gefilterten Rotorbeschleunigung" VALUE 0x8098 AblGLKWuw 1.000000 RIGHTSH6NP 0.00 1.000000 FORMAT "%8.6" /end CHARACTERISTIC
/begin CHARACTERISTIC xRotSp_RotSpeedFilterFact_XDU16 "Filterfaktor der gefilterten Rotorgeschwindigkeit" VALUE 0x809C AblGLKWuw 0.4990234 RIGHTSH10NP 0.0009765625 0.5000000 FORMAT "%9.7" /end CHARACTERISTIC
/begin CHARACTERISTIC xSCruiseLimr_AsymRackSpdLim_XAS16 "Reduction of asymmetric RackSpdLim into opposite direction for HandsFree mode (curve will be mirrored to both sides)" MAP 0x80D310 AblGLKFsw 2.000000 RIGHTSH10NP -1.000000 1.000000 FORMAT "%8.6"
 /begin AXIS_DESCR STD_AXIS vSCruiseI_AbsAvgVehSpd_xdu16 VFZHIGH 9 0.00 500.0000 FORMAT "%8.4" DEPOSIT ABSOLUTE /end AXIS_DESCR
 /begin AXIS_DESCR STD_AXIS lApplI_RackPosition_xds16 RACKPOS128 4 0.00 50.00000 FORMAT "%8.5" DEPOSIT ABSOLUTE /end AXIS_DESCR
/end CHARACTERISTIC
/begin CHARACTERISTIC xSCruiseLimr_MaxRackSpd4JImpFac_XDU8 "factor to limit of rack speed used for inertia impulse detection" VALUE 0x64D4 AblGLKWub 1.000 RIGHTSH7NP 0.00 1.000 FORMAT "%5.3" /end CHARACTERISTIC
/begin CHARACTERISTIC xSCruiseLimr_MaxRackSpdOpenFac_XDU8 "factor to limit of rack speed used for OPENING limits" VALUE 0x64D5 AblGLKWub 0.2031 RIGHTSH7NP 0.7969 1.000 FORMAT "%5.3" /end CHARACTERISTIC
/begin CHARACTERISTIC xSCruiseLimr_MaxRackSpdRedFac_XDU8 "factor to limit of rack speed used for low driver interaction indication (lower hysteresis)" VALUE 0x64D6 AblGLKWub 1.000 RIGHTSH7NP 0.00 1.000 FORMAT "%5.3" /end CHARACTERISTIC
/begin CHARACTERISTIC xSCruiseLimr_TbtGrdtFilFac_XDU16 "filter factor for TorsionBarTorque's gradient" VALUE 0x63E6 AblGLKWuw 0.9998779 RIGHTSH13NP 0.0001220703 1.000000 FORMAT "%8.6" /end CHARACTERISTIC
/begin CHARACTERISTIC xSCruise_ActvJFacTrq_XAU16 "active inertia factor dependent on TorsionBarTorque" CURVE 0x6E18 AblGLKLuw 1.000000 RIGHTSH10NP 0.00 1.000000 FORMAT "%8.6"
 /begin AXIS_DESCR STD_AXIS mSCruiseI_TorsBarTrq_xds16 TBTHIGH 4 0.00 8.000000 FORMAT "%8.6" DEPOSIT ABSOLUTE /end AXIS_DESCR
/end CHARACTERISTIC
/begin CHARACTERISTIC xSCruise_ActvJFacVehSpd_XAU16 "Gain factor of inertia dependent on vehicle speed" CURVE 0x6E2C AblGLKLuw 10.00000 RIGHTSH10NP 0.00 10.00000 FORMAT "%8.5"
 /begin AXIS_DESCR STD_AXIS vSCruiseI_AbsAvgVehSpd_xdu16 VFZHIGH 4 0.00 400.0000 FORMAT "%8.4" DEPOSIT ABSOLUTE /end AXIS_DESCR
/end CHARACTERISTIC
/begin CHARACTERISTIC xSCruise_HandsOnRampGrdt_XDU16 "Gradient of ramping to a HandsOn mode and from a HandsOn mode to non-HandsOn modes" VALUE 0x63E8 AblGLKWuw 999.5000 RIGHTSH6NP_1S 0.5000000 1000.000 FORMAT "%8.3" /end CHARACTERISTIC
/begin CHARACTERISTIC xSCruise_MaxRackSpdLimFact_XDU8 "Factor to apply for rack speed limit to reduce or have a reserve to SCruiseLimiter" VALUE 0x64DA AblGLKWub 1.500 RIGHTSH6NP 0.5000 2.000 FORMAT "%5.3" /end CHARACTERISTIC
/begin CHARACTERISTIC xSCruise_MinRedLvlHandsFree_XDU8 "minimum allowed requested reduction level for HandsFree mode to enable/continue SCI" VALUE 0x64DB AblGLKWub 1.000 RIGHTSH7NP 0.00 1.000 FORMAT "%5.3" /end CHARACTERISTIC
/begin CHARACTERISTIC xSCruise_PPartRackSpdCtrlr_XAU16 "P-Part gain of rack speed controller" CURVE 0x6F1C AblGLKLuw 10.00000 RIGHTSH12NP 0.00 10.00000 FORMAT "%8.5"
 /begin AXIS_DESCR STD_AXIS lSCruiseI_RackPosnDelta_xds16 RACKPOS128 5 0.00 60.00000 FORMAT "%8.5" DEPOSIT ABSOLUTE /end AXIS_DESCR
/end CHARACTERISTIC
/begin CHARACTERISTIC xatAssistFilterFrequFast_XDU16 "Grenzfrequenz in kHz fuer AssistFilter fuer schnelles Zurueckfiltern" VALUE 0x6358 AblGLKWuw 0.09863281 RIGHTSH11NP 0.0009765625 0.09960938 FORMAT "%10.8" /end CHARACTERISTIC
/begin CHARACTERISTIC xatAssistFilterFrequ_XAU16 "Grenzfrequenz in kHz fuer AssistFilter, abhaengig von der Reduzierung durch Fahrzeuggeschwindigkeit" CURVE 0x6AE4 AblGLKLuw 0.09863281 RIGHTSH11NP 0.0009765625 0.09960938 FORMAT "%10.8"
 /begin AXIS_DESCR STD_AXIS vApplI_AbsVehicleSpeedFilt_xdu16 VFZHIGH 4 0.00 500.0000 FORMAT "%8.4" DEPOSIT ABSOLUTE /end AXIS_DESCR
/end CHARACTERISTIC
/begin CHARACTERISTIC xatD2T3FactSumMax_XDU16 "D2T3 Faktorsumme Max Schwellwert" VALUE 0x635C AblGLKWuw 1.000000 RIGHTSH14NP 1.000000 2.000000 FORMAT "%8.6" /end CHARACTERISTIC
/begin CHARACTERISTIC xatD2T3FactSumMin_XDU16 "D2T3 Faktorsumme Min Schwellwert" VALUE 0x635E AblGLKWuw 1.000000 RIGHTSH14NP 0.00 1.000000 FORMAT "%8.6" /end CHARACTERISTIC
/begin CHARACTERISTIC xatD2T3FiltA1V2_XDF32 "Parameter Filter D2T3 a1" VALUE 0x602C AblGLKWfl4 32.0000000 ZU0 -16.0000000 16.0000000 FORMAT "%10.7" /end CHARACTERISTIC
/begin CHARACTERISTIC xatD2T3FiltA1_XDF32 "Parameter Filter D2T3 a1" VALUE 0x6030 AblGLKWfl4 32.0000000 ZU0 -16.0000000 16.0000000 FORMAT "%10.7" /end CHARACTERISTIC
/begin CHARACTERISTIC xatD2T3FiltA2V2_XDF32 "Parameter Filter D2T3 a2" VALUE 0x6034 AblGLKWfl4 32.0000000 ZU0 -16.0000000 16.0000000 FORMAT "%10.7" /end CHARACTERISTIC
/begin CHARACTERISTIC xatD2T3FiltA2_XDF32 "Parameter Filter D2T3 a2" VALUE 0x6038 AblGLKWfl4 32.0000000 ZU0 -16.0000000 16.0000000 FORMAT "%10.7" /end CHARACTERISTIC
/begin CHARACTERISTIC xatD2T3FiltB0V2_XDF32 "Parameter Filter D2T3 b0" VALUE 0x603C AblGLKWfl4 32.0000000 ZU0 -16.0000000 16.0000000 FORMAT "%10.7" /end CHARACTERISTIC
/begin CHARACTERISTIC xatD2T3FiltB0_XDF32 "Parameter Filter D2T3 b0" VALUE 0x6040 AblGLKWfl4 32.0000000 ZU0 -16.0000000 16.0000000 FORMAT "%10.7" /end CHARACTERISTIC
/begin CHARACTERISTIC xatD2T3FiltB1V2_XDF32 "Parameter Filter D2T3 b1" VALUE 0x6044 AblGLKWfl4 32.0000000 ZU0 -16.0000000 16.0000000 FORMAT "%10.7" /end CHARACTERISTIC
/begin CHARACTERISTIC xatD2T3FiltB1_XDF32 "Parameter Filter D2T3 b1" VALUE 0x6048 AblGLKWfl4 32.0000000 ZU0 -16.0000000 16.0000000 FORMAT "%10.7" /end CHARACTERISTIC
/begin CHARACTERISTIC xatD2T3FiltB2V2_XDF32 "Parameter Filter D2T3 b2" VALUE 0x604C AblGLKWfl4 32.0000000 ZU0 -16.0000000 16.0000000 FORMAT "%10.7" /end CHARACTERISTIC
/begin CHARACTERISTIC xatD2T3FiltB2_XDF32 "Parameter Filter D2T3 b2" VALUE 0x6050 AblGLKWfl4 32.0000000 ZU0 -16.0000000 16.0000000 FORMAT "%10.7" /end CHARACTERISTIC
/begin CHARACTERISTIC xatD2T3FiltPT1FiltFactV2_XDU16 "Filterfaktor fuer PT1 des D2T3-Filters" VALUE 0x6360 AblGLKWuw 0.9990234 RIGHTSH12NP 0.0009765625 1.000000 FORMAT "%8.6" /end CHARACTERISTIC
/begin CHARACTERISTIC xatD2T3FiltPT1FiltFact_XDU16 "Filterfaktor für PT1 des D2T3-Filters" VALUE 0x6362 AblGLKWuw 0.9990234 RIGHTSH12NP 0.0009765625 1.000000 FORMAT "%8.6" /end CHARACTERISTIC
/begin CHARACTERISTIC xatD2T3NoFiltFact_XAU16 "D2T3 NoFiltFact" CURVE 0x6AF8 AblGLKLuw 1.000000 RIGHTSH14NP 0.00 1.000000 FORMAT "%8.6"
 /begin AXIS_DESCR STD_AXIS vApplI_AbsVehicleSpeedFilt_xdu16 VFZHIGH 2 0.00 500.0000 FORMAT "%8.4" DEPOSIT ABSOLUTE /end AXIS_DESCR
/end CHARACTERISTIC
/begin CHARACTERISTIC xatD2T3V0Fact_XAU16 "D2T3 V0Fact" CURVE 0x6B04 AblGLKLuw 1.000000 RIGHTSH14NP 0.00 1.000000 FORMAT "%8.6"
 /begin AXIS_DESCR STD_AXIS vApplI_AbsVehicleSpeedFilt_xdu16 VFZHIGH 2 0.00 500.0000 FORMAT "%8.4" DEPOSIT ABSOLUTE /end AXIS_DESCR
/end CHARACTERISTIC
/begin CHARACTERISTIC xatD2T3V1Fact_XAU16 "D2T3 V1Fact" CURVE 0x6B10 AblGLKLuw 1.000000 RIGHTSH14NP 0.00 1.000000 FORMAT "%8.6"
 /begin AXIS_DESCR STD_AXIS vApplI_AbsVehicleSpeedFilt_xdu16 VFZHIGH 4 0.00 500.0000 FORMAT "%8.4" DEPOSIT ABSOLUTE /end AXIS_DESCR
/end CHARACTERISTIC
/begin CHARACTERISTIC xatMaxGradChatterActive_XAU16 "Maximler Gradient wenn Rattern erkannt, abhaengig von v Fahrzeug " CURVE 0x6B24 AblGLKLuw 1.999023 TORGAINHIGH 0.0009765625 2.000000 FORMAT "%8.6"
 /begin AXIS_DESCR STD_AXIS vApplI_AbsSafeNssVehicleSpeed_xdu16 VFZHIGH 4 0.00 300.0000 FORMAT "%8.4" DEPOSIT ABSOLUTE /end AXIS_DESCR
/end CHARACTERISTIC
/begin CHARACTERISTIC xatMaxGradTorGrad_XAU16 "Max Gradient fuer Steigungsbgrenzung DAC abhaengig vom Reduktionsfaktor" CURVE 0x6B38 AblGLKLuw 5.000000 TORGAINHIGH 0.00 5.000000 FORMAT "%8.6"
 /begin AXIS_DESCR STD_AXIS xatActTorGradFact_xdu16 RSH15 3 0.00 100.0000 FORMAT "%8.4" DEPOSIT ABSOLUTE /end AXIS_DESCR
/end CHARACTERISTIC
/begin CHARACTERISTIC xatMaxGradvVehicleReverse_XAU16 "Max Gradient fuer Steigungsbgrenzung DAC abhaengig von v Fahrzeug bei Rueckwaertsfahrt" CURVE 0x6B48 AblGLKLuw 5.000000 TORGAINHIGH 0.00 5.000000 FORMAT "%8.6"
 /begin AXIS_DESCR STD_AXIS vApplI_AbsSafeNssVehicleSpeed_xdu16 VFZHIGH 4 0.00 300.0000 FORMAT "%8.4" DEPOSIT ABSOLUTE /end AXIS_DESCR
/end CHARACTERISTIC
/begin CHARACTERISTIC xatMaxGradvVehicle_XAU16 "Max Gradient fuer Steigungsbgrenzung DAC abhaengig von v Fahrzeug" CURVE 0x6B5C AblGLKLuw 5.000000 TORGAINHIGH 0.00 5.000000 FORMAT "%8.6"
 /begin AXIS_DESCR STD_AXIS vApplI_AbsSafeNssVehicleSpeed_xdu16 VFZHIGH 4 0.00 300.0000 FORMAT "%8.4" DEPOSIT ABSOLUTE /end AXIS_DESCR
/end CHARACTERISTIC
/begin CHARACTERISTIC yLowVoltAssRed_MaxCurrentGradient_XDU16 "Maximal zulaessiger Stromgradient" VALUE 0x6438 AblGLKWuw 65.56250 SM_I_MS 0.00 65.56250 FORMAT "%8.5" /end CHARACTERISTIC
/begin CHARACTERISTIC ySy_FocDatasetName_XAU8 "Bezeichner des FOC Dataset" VAL_BLK 0x54F0 AblGLKWBub 255.0 ZU0 0.00 255.0 FORMAT "%5.1" NUMBER 12 /end CHARACTERISTIC
/begin CHARACTERISTIC ySy_OemDatasetName_XAU8 "Bezeichner des OEM Dataset" VAL_BLK 0xE80C AblGLKWBub 255.0 ZU0 0.00 255.0 FORMAT "%5.1" NUMBER 12 /end CHARACTERISTIC
/begin CHARACTERISTIC ySy_SysDatasetName_XAU8 "Bezeichner des SYS Dataset" VAL_BLK 0x65BC AblGLKWBub 255.0 ZU0 0.00 255.0 FORMAT "%5.1" NUMBER 12 /end CHARACTERISTIC
/begin CHARACTERISTIC ySy_TunDatasetName_XAU8 "Bezeichner des TUN Dataset" VAL_BLK 0x8214 AblGLKWBub 255.0 ZU0 0.00 255.0 FORMAT "%5.1" NUMBER 12 /end CHARACTERISTIC
/begin CHARACTERISTIC zBci_AssistCurveSelect_XAU16 "geschwindigkeitsabhängige BasicSteerTorque-Kennlinienauswahl" VAL_BLK 0x8220 AblGLKWBuw 500.0000 VFZHIGH 0.00 500.0000 FORMAT "%8.4" NUMBER 6 /end CHARACTERISTIC
/begin CHARACTERISTIC zInCo_ChatterCountLimitInertia_XDU8 "Grenzewert Anzahl Ratterzyklen für Umschaltung auf Traegheitsmomentfaktor xInCo_ChatterRotAccFactor_XAS16" VALUE 0x64F6 AblGLKWub 255.0 ZU0 0.00 255.0 FORMAT "%5.1" /end CHARACTERISTIC
/begin CHARACTERISTIC zcrMinChatterPeriodsCountDelayed_XDU8 "minimum chatter cycle counter during holing time (after chatter detection finished)" VALUE 0x64F0 AblGLKWub 30.00 ZU0 0.00 30.00 FORMAT "%5.2" /end CHARACTERISTIC
/begin AXIS_PTS mBci_V0TbtArray_XAU16 "X-Array für V0 Kennlinie" 0x822C matAbsTorsionBarTorque_xdu16 AblGLSstuw 20.00000 TBTHIGH 10 0.00 20.00000 FORMAT "%8.5" DEPOSIT ABSOLUTE /end AXIS_PTS
/begin AXIS_PTS mBci_V1TbtArray_XAU16 "X-Array für V1 Kennlinie" 0x8240 matAbsTorsionBarTorque_xdu16 AblGLSstuw 20.00000 TBTHIGH 10 0.00 20.00000 FORMAT "%8.5" DEPOSIT ABSOLUTE /end AXIS_PTS
/begin AXIS_PTS mBci_V2TbtArray_XAU16 "X-Array für V2 Kennlinie" 0x8254 matAbsTorsionBarTorque_xdu16 AblGLSstuw 20.00000 TBTHIGH 10 0.00 20.00000 FORMAT "%8.5" DEPOSIT ABSOLUTE /end AXIS_PTS
/begin AXIS_PTS mBci_V3TbtArray_XAU16 "X-Array für V3 Kennlinie" 0x8268 matAbsTorsionBarTorque_xdu16 AblGLSstuw 20.00000 TBTHIGH 10 0.00 20.00000 FORMAT "%8.5" DEPOSIT ABSOLUTE /end AXIS_PTS
/begin AXIS_PTS mBci_V4TbtArray_XAU16 "X-Array für V4 Kennlinie" 0x827C matAbsTorsionBarTorque_xdu16 AblGLSstuw 20.00000 TBTHIGH 10 0.00 20.00000 FORMAT "%8.5" DEPOSIT ABSOLUTE /end AXIS_PTS
/begin AXIS_PTS mBci_V5TbtArray_XAU16 "X-Array für V5 Kennlinie" 0x8290 matAbsTorsionBarTorque_xdu16 AblGLSstuw 20.00000 TBTHIGH 10 0.00 20.00000 FORMAT "%8.5" DEPOSIT ABSOLUTE /end AXIS_PTS
/begin MEASUREMENT aApplI_RotAcceleration_xds16 "Rotorbeschleunigung" SWORD ROTACC 1 100 -500.0000 500.0000 FORMAT "%8.4" ECU_ADDRESS 0xFE9F87E0 /end MEASUREMENT
/begin MEASUREMENT cApplI_InternTempFilt_xdu8 "HW LIB: Gefilterte Temperatur Intern (Leiterplatte)" UBYTE TMPOUTS 1 100 -70.00 184.0 FORMAT "%5.1" ECU_ADDRESS 0xFEE9B104 /end MEASUREMENT
/begin MEASUREMENT cApplI_OutstageTempFilt_xdu8 "HW LIB: Gefilterte Temperatur Endstufe (DBC)" UBYTE TMPOUTS 1 100 -70.00 184.0 FORMAT "%5.1" ECU_ADDRESS 0xFEE9B105 /end MEASUREMENT
/begin MEASUREMENT fEndStopHsdI_EnableUndervoltOffset_xdb "Enable undervolt offset in EndStopHsd if set to true" UWORD ZU0 1 100 0.00 1.000 FORMAT "%5.3" BIT_MASK 0x1 ECU_ADDRESS 0xFE9F8D5A /end MEASUREMENT
/begin MEASUREMENT fEndStopHsd_Disable_xdb "Disable flag: Wird beim Monitoring ein Fehler erkannt, wird das Disable-Flag gesetzt" UWORD ZU0 1 100 0.00 1.000 FORMAT "%5.3" BIT_MASK 0x1 ECU_ADDRESS 0xFE9F8D5C /end MEASUREMENT
/begin MEASUREMENT fEndStopHsd_ForwardDrv_xdb "Internal fwd driving flag (0=bwd; 1=fwd)" UWORD ZU0 1 100 0.00 1.000 FORMAT "%5.3" BIT_MASK 0x1 ECU_ADDRESS 0xFE9F8D5D /end MEASUREMENT
/begin MEASUREMENT fEndStop_NoLearnFlag_xdu8 "Ist dieses Flag gesetzt wird nicht nachgelernt" UBYTE ZU0 1 100 0.00 1.000 FORMAT "%5.3" ECU_ADDRESS 0xFE9F8D69 /end MEASUREMENT
/begin MEASUREMENT fEngRnI_EngineRunningStable_xdb "Motor laeuft stabil (Immer wahr fuer MEB)" UBYTE STATUS 1 100 0.00 1.000 FORMAT "%5.3" BIT_MASK 0x1 ECU_ADDRESS 0xFE9F8D6E /end MEASUREMENT
/begin MEASUREMENT fLowVoltAssRedI_StartStopEnabled_xdb "Flag ob auf Start/Stop Maï¿½nahmen umgeschaltet wurde (fuer HighSpeedDamping)" UBYTE STATUS 1 100 0.00 1.000 FORMAT "%5.3" BIT_MASK 0x1 ECU_ADDRESS 0xFE9F8D93 /end MEASUREMENT
/begin MEASUREMENT fLowVoltAssRedI_UHighError_xdb "UHigh_Error und gelbe Lampe" UBYTE STATUS 1 100 0.00 1.000 FORMAT "%5.3" BIT_MASK 0x1 ECU_ADDRESS 0xFE9F8D94 /end MEASUREMENT
/begin MEASUREMENT fLowVoltAssRedI_ULowError_xdb "ULow_Error und rote Lampe" UBYTE STATUS 1 100 0.00 1.000 FORMAT "%5.3" BIT_MASK 0x1 ECU_ADDRESS 0xFE9F8D95 /end MEASUREMENT
/begin MEASUREMENT fLowVoltAssRed_GeneratorMode_xdu8 "Betriebszustand des Motors, nur MEB (0 = Motorischer Betrieb, 1 = Generatorischer Betrieb)" UBYTE ZU0 1 100 0.00 1.000 FORMAT "%5.3" ECU_ADDRESS 0xFE9F8D96 /end MEASUREMENT
/begin MEASUREMENT fSCruiseFadrI_EmgyEveIndcn_xdb "Emergency event due to high torsion bar torque indicated" UWORD ZU0 1 100 0.00 1.000 FORMAT "%5.3" BIT_MASK 0x1 ECU_ADDRESS 0xFE9F8DD3 /end MEASUREMENT
/begin MEASUREMENT fSCruiseFadr_MonSafeOk_xdb "Indicate whether the MonitorSafe checks report OK (true) or if they have detected a problem (false)" UWORD ZU0 1 100 0.00 1.000 FORMAT "%5.3" BIT_MASK 0x1 ECU_ADDRESS 0xFE9F8DD5 /end MEASUREMENT
/begin MEASUREMENT fSCruiseI_SigPrcrReqOff_xdu8 "Summarizes different inputs required from SCruiseSignalProcessor to switch SCI Off(1) or keep available(0)" UBYTE ZU0 1 100 0.00 1.000 FORMAT "%5.3" ECU_ADDRESS 0xFE9F8DD7 /end MEASUREMENT
/begin MEASUREMENT fSCruiseLimrI_MonSafeOk_xdb "Indicates whether the MonitorSafe checks report OK (true) or if they have detected a problem (false)" UWORD ZU0 1 100 0.00 1.000 FORMAT "%5.3" BIT_MASK 0x1 ECU_ADDRESS 0xFE9F8DD9 /end MEASUREMENT
/begin MEASUREMENT fSCruiseLimrI_ReqOff_xdb "Request off (fade-out) in case of invalid inputs" UWORD ZU0 1 100 0.00 1.000 FORMAT "%5.3" BIT_MASK 0x1 ECU_ADDRESS 0xFE9F8DDB /end MEASUREMENT
/begin MEASUREMENT fScruiseLimr_LoDrvrIntractn_xdu8 "Flag to indicate low driver interaction leading to reset the limit expansion" UWORD ZU0 1 100 0.00 1.000 FORMAT "%5.3" BIT_MASK 0x1 ECU_ADDRESS 0xFE9F8DDD /end MEASUREMENT
/begin MEASUREMENT fatD2T3FactSumOutOfRange_xdb "D2T3 Filterfaktor Summe ausserhalb 0.95...1.05" UWORD ZU0 1 100 0.00 1.000 FORMAT "%5.3" BIT_MASK 0x1 ECU_ADDRESS 0xFE9F8D49 /end MEASUREMENT
/begin MEASUREMENT iApplI_BatteryCurrent_xds16 "HW LIB: Batterie Strom ohne Prozessor Strom" SWORD SM_I 1 100 -150.0000 150.0000 FORMAT "%8.4" ECU_ADDRESS 0xFEE9B09C /end MEASUREMENT
/begin MEASUREMENT iApplI_MaxBattCurr_xdu16 " maximal erlaubter Batteriestrom " UWORD SM_I 1 100 0.00 200.0000 FORMAT "%8.4" ECU_ADDRESS 0xFEE9B0A0 /end MEASUREMENT
/begin MEASUREMENT kBbaSacInI_QhmRackForce_xds16 "Motormoment Haptikmodul" SWORD FRACK 1 100 -32768.00 32767.00 FORMAT "%8.2" ECU_ADDRESS 0xFE9F8810 /end MEASUREMENT
/begin MEASUREMENT lApplI_RackPosition_xds16 "Zahnstangenposition [mm]" SWORD RACKPOS128 1 100 -200.0000 200.0000 FORMAT "%8.4" ECU_ADDRESS 0xFE9F8824 /end MEASUREMENT
/begin MEASUREMENT lApplI_VehCentRackPos_xds16 "Zahnstangenposition bezogen auf Fahrzeugmitte [mm]" SWORD RACKPOS128 1 100 -200.0000 200.0000 FORMAT "%8.4" ECU_ADDRESS 0xFE9F8826 /end MEASUREMENT
/begin MEASUREMENT lEndStopHsd_InternDistToES_xds16 "Interne Groesse - Abstand vom Endanschlag in mm" SWORD RACKPOS128 1 100 -125.0000 125.0000 FORMAT "%8.4" ECU_ADDRESS 0xFE9F8850 /end MEASUREMENT
/begin MEASUREMENT lEndStopI_DistanceToEndstop_xds16 "Abstand vom Endanschlag in mm" SWORD RACKPOS128 1 100 -125.0000 125.0000 FORMAT "%8.4" ECU_ADDRESS 0xFE9F885A /end MEASUREMENT
/begin MEASUREMENT lEndStopI_RackPosMax_xds16 "Max Zahnstangenhub" SWORD RACKPOS128 1 100 -200.0000 200.0000 FORMAT "%8.4" ECU_ADDRESS 0xFE9F8866 /end MEASUREMENT
/begin MEASUREMENT lEndStopI_RackPosMin_xds16 "Min Zahnstangenhub" SWORD RACKPOS128 1 100 -200.0000 200.0000 FORMAT "%8.4" ECU_ADDRESS 0xFE9F8868 /end MEASUREMENT
/begin MEASUREMENT lSCruiseI_NomRackPosnLimd_xds32 "Nominal rack position for Rack Position Feed Forward (after input limitation)" SLONG RACKPOS_RSH15 1 100 -200.000000000 200.000000000 FORMAT "%13.9" ECU_ADDRESS 0xFE9F8480 /end MEASUREMENT
/begin MEASUREMENT lSCruiseI_NomRackPosn_xds32 "Nominal Rack Position after Transfer function calculation" SLONG RACKPOS_RSH15 1 100 -200.000000000 200.000000000 FORMAT "%13.9" ECU_ADDRESS 0xFE9F8484 /end MEASUREMENT
/begin MEASUREMENT lSCruiseI_RackPosnDelta_xds16 "This signal is the Rack Position Deviation which was between filtered Rack Position and Nominal Rack Position (after InputLimiter)" SWORD RACKPOS128 1 100 -200.0000 200.0000 FORMAT "%8.4" ECU_ADDRESS 0xFE9F8890 /end MEASUREMENT
/begin MEASUREMENT lSCruiseI_RackPosn_xds16 "SCruise filtered current Rackposition" SWORD RACKPOS128 1 100 -200.0000 200.0000 FORMAT "%8.4" ECU_ADDRESS 0xFE9F8894 /end MEASUREMENT
/begin MEASUREMENT lSCruiseI_ReqdRackPosn_xds32 "Requested Rackposition for SCruise from Bus, mapped to internally" SLONG RACKPOS256 1 100 -200.000000000 200.000000000 FORMAT "%13.9" ECU_ADDRESS 0xFE9F8488 /end MEASUREMENT
/begin MEASUREMENT lSCruiseLimr_ReqdRackPosnLimd_xds32 "Rate limited requested rack position to calculate the rack position deviation" SLONG RIGHTSH11NP 1 100 -200.000000000 200.000000000 FORMAT "%13.9" ECU_ADDRESS 0xFE9F848C /end MEASUREMENT
/begin MEASUREMENT mApplI_LimitedMotorTorque_xds16 "Begrenztes Motormoment durch Momentenkoordinator" SWORD MMOT 1 100 -12.00000 12.00000 FORMAT "%8.5" ECU_ADDRESS 0xFEE9B0A6 /end MEASUREMENT
/begin MEASUREMENT mApplI_MaxRequiredMotorTorque_xdu16 "max angefordertes Motormoment" UWORD MMOT 1 100 0.00 12.00000 FORMAT "%8.5" ECU_ADDRESS 0xFE9F88AE /end MEASUREMENT
/begin MEASUREMENT mApplI_NominalMotorTorque_xds16 "summation of all power assist motor torques including AddOnFunctions" SWORD MMOT 1 100 -12.00000 12.00000 FORMAT "%8.5" ECU_ADDRESS 0xFE9F88B0 /end MEASUREMENT
/begin MEASUREMENT mBciI_AssistCurveMMotYAxis_xau16 "y-Achsenwerte der berechneten Unterstützungs-Kennlinie (nominelles Unterstützungsmoment)" UWORD MMOT 1 100 0.00 12.00000 FORMAT "%8.5" ECU_ADDRESS 0xFE9F9240 MATRIX_DIM 10 1 1 /end MEASUREMENT
/begin MEASUREMENT mBciI_AssistCurveTBTXAxis_xau16 "x-Achsenwerte der berechneten Unterstützungs-Kennlinie (Handmoment)" UWORD TBTHIGH 1 100 0.00 15.00000 FORMAT "%8.5" ECU_ADDRESS 0xFE9F9254 MATRIX_DIM 10 1 1 /end MEASUREMENT
/begin MEASUREMENT mBci_LimitedAssistCurveMMotYAxis_xau16 "y-Achsenwerte der berechneten Unterstützungs-Kennlinie (nominelles Unterstützungsmoment)" UWORD MMOT 1 100 0.00 12.00000 FORMAT "%8.5" ECU_ADDRESS 0xFE9F92CC MATRIX_DIM 10 1 1 /end MEASUREMENT
/begin MEASUREMENT mBci_LimitedAssistCurveTBTXAxis_xau16 "x-Achsenwerte der berechneten Unterstützungs-Kennlinie (Handmoment)" UWORD TBTHIGH 1 100 0.00 15.00000 FORMAT "%8.5" ECU_ADDRESS 0xFE9F92E0 MATRIX_DIM 10 1 1 /end MEASUREMENT
/begin MEASUREMENT mBci_ScaledAssistCurveMMotYAxis_xau16 "y-Achsenwerte der berechneten Unterstützungs-Kennlinie (nominelles Unterstützungsmoment)" UWORD MMOT 1 100 0.00 12.00000 FORMAT "%8.5" ECU_ADDRESS 0xFE9F92F4 MATRIX_DIM 10 1 1 /end MEASUREMENT
/begin MEASUREMENT mBci_ScaledAssistCurveTBTXAxis_xau16 "x-Achsenwerte der berechneten Unterstützungs-Kennlinie (Handmoment)" UWORD TBTHIGH 1 100 0.00 15.00000 FORMAT "%8.5" ECU_ADDRESS 0xFE9F9308 MATRIX_DIM 10 1 1 /end MEASUREMENT
/begin MEASUREMENT mEndStopHsdI_MotTrq_xds16 "DÃ¤mpfungsmoment bei hohen Drehzahlen" SWORD MMOT 1 100 -12.00000 12.00000 FORMAT "%8.5" ECU_ADDRESS 0xFE9F88EC /end MEASUREMENT
/begin MEASUREMENT mEndStopI_MotorTorque_xds16 "Endanschlagsmoment" SWORD MMOT 1 100 -24.00000 24.00000 FORMAT "%8.5" ECU_ADDRESS 0xFE9F88FE /end MEASUREMENT
/begin MEASUREMENT mInCoI_InertiaComp_xds16 "Motormomentenoffset von Trägheitskompensation" SWORD MMOT 1 100 -1.000000 1.000000 FORMAT "%8.6" ECU_ADDRESS 0xFE9F8920 /end MEASUREMENT
/begin MEASUREMENT mInCo_AbsCompTorqueUnLimited_xdu16 "Absolutwert des berechneten Motormoments" UWORD MMOT 1 100 0.00 32.00000 FORMAT "%8.5" ECU_ADDRESS 0xFE9F8922 /end MEASUREMENT
/begin MEASUREMENT mMchStPrv_AbsEffMotTor_xdu16 "Betrag Effektives Motormoment (Wirkmoment = TBT * Übersetzung + MMOT)" UWORD MMOT 1 100 0.00 10.00000 FORMAT "%8.5" ECU_ADDRESS 0xFE9F8944 /end MEASUREMENT
/begin MEASUREMENT mMchStPrv_FilteredGRADTBT_xdu16 "Gefilterter Gradient des Drehstabes" UWORD TORGRAD 1 100 0.00 25.00000 FORMAT "%8.5" ECU_ADDRESS 0xFE9F8946 /end MEASUREMENT
/begin MEASUREMENT mMotTorLimI_ValidatedMotorTorque_xds16 "Begrenztes Motormoment durch MotorTorqueLimiter" SWORD MMOT 1 100 -12.00000 12.00000 FORMAT "%8.5" ECU_ADDRESS 0xFE9F894A /end MEASUREMENT
/begin MEASUREMENT mSCruiseFadrI_MotTrq_xds16 "faded motor torque" SWORD MMOT 1 100 -12.00000 12.00000 FORMAT "%8.5" ECU_ADDRESS 0xFE9F897C /end MEASUREMENT
/begin MEASUREMENT mSCruiseI_MotTrq_xds16 "MotorTorque requested by the SCruiseController" SWORD MMOT 1 100 -12.00000 12.00000 FORMAT "%8.5" ECU_ADDRESS 0xFE9F8986 /end MEASUREMENT
/begin MEASUREMENT mSCruiseI_NomActvJTrq_xds16 "Nominal active inertia torque of SCruise" SWORD TBTHIGH 1 100 -10.00000 10.00000 FORMAT "%8.5" ECU_ADDRESS 0xFE9F8988 /end MEASUREMENT
/begin MEASUREMENT mSCruiseI_NomDampgTrq_xds16 "nominal damping torque" SWORD TBTHIGH 1 100 -12.00000 12.00000 FORMAT "%8.5" ECU_ADDRESS 0xFE9F898A /end MEASUREMENT
/begin MEASUREMENT mSCruiseI_NomPrimCtrlrTrq_xds16 "Nominal Steer Torque to increase Rack Position accuracy in the primary controller" SWORD TBTHIGH 1 100 -12.00000 12.00000 FORMAT "%8.5" ECU_ADDRESS 0xFE9F898C /end MEASUREMENT
/begin MEASUREMENT mSCruiseI_NomSteerTrq_xds16 "This signal is the TorsionBarTorque which was interpolated and factorized and will be send to the SCruiseSteeringTorqueConnector for summation" SWORD TBTHIGH 1 100 -25.00000 25.00000 FORMAT "%8.5" ECU_ADDRESS 0xFE9F8992 /end MEASUREMENT
/begin MEASUREMENT mSCruiseLimrI_GradTorsBarTrq_xds16 "gradient of the torsion bar torque" SWORD TORGRAD_RSH14_MS 1 100 -1.900024 1.900024 FORMAT "%8.6" ECU_ADDRESS 0xFE9F8996 /end MEASUREMENT
/begin MEASUREMENT mSCruiseLimrI_MotTrq_xds16 "SCruise Limiter Motor Torque" SWORD MMOT 1 100 -12.00000 12.00000 FORMAT "%8.5" ECU_ADDRESS 0xFE9F899A /end MEASUREMENT
/begin MEASUREMENT mSCruiseLimr_RackSpdCtrlrTrq_xds16 "rack speed controller's motor torque" SWORD MMOT 1 100 -24.00000 24.00000 FORMAT "%8.5" ECU_ADDRESS 0xFE9F899E /end MEASUREMENT
/begin MEASUREMENT mSCruise_DPart_xds16 "DPart of the PID controller" SWORD MMOT 1 100 -12.00000 12.00000 FORMAT "%8.5" ECU_ADDRESS 0xFE9F89A2 /end MEASUREMENT
/begin MEASUREMENT mSCruise_IPart_xds16 "IPart of the PID controller" SWORD MMOT 1 100 -12.00000 12.00000 FORMAT "%8.5" ECU_ADDRESS 0xFE9F89A8 /end MEASUREMENT
/begin MEASUREMENT mSCruise_PPart_xds16 "PPart of the PID controller" SWORD MMOT 1 100 -12.00000 12.00000 FORMAT "%8.5" ECU_ADDRESS 0xFE9F89B2 /end MEASUREMENT
/begin MEASUREMENT mSCruise_TbtDeviation_xds16 "TorsionBarTorque deviation as input of controller" SWORD TBTHIGH 1 100 -25.00000 25.00000 FORMAT "%8.5" ECU_ADDRESS 0xFE9F89B6 /end MEASUREMENT
/begin MEASUREMENT matAbsAssistD2T3Delta_xdu16 "assistance torque limited D2T3 filter offset" UWORD MMOT 1 100 0.00 12.00000 FORMAT "%8.5" ECU_ADDRESS 0xFE9F87A8 /end MEASUREMENT
/begin MEASUREMENT matAbsTorsionBarTorque_xdu16 "Absolutes Drehstabmoment" UWORD TBTHIGH 1 100 0.00 25.00000 FORMAT "%8.5" ECU_ADDRESS 0xFE9F88BA /end MEASUREMENT
/begin MEASUREMENT matAssistD2T3V0AfterPT1_xds16 "assistance torque D2T3 V0 after PT1 filter" SWORD MMOT 1 100 -12.00000 12.00000 FORMAT "%8.5" ECU_ADDRESS 0xFE9F87AA /end MEASUREMENT
/begin MEASUREMENT matAssistD2T3V1AfterPT1_xds16 "assistance torque D2T3 V1 after PT1 filter" SWORD MMOT 1 100 -12.00000 12.00000 FORMAT "%8.5" ECU_ADDRESS 0xFE9F87AC /end MEASUREMENT
/begin MEASUREMENT matAssistD2T3_xds16 "assistance torque D2T3 filter output" SWORD MMOT 1 100 -12.00000 12.00000 FORMAT "%8.5" ECU_ADDRESS 0xFE9F87AE /end MEASUREMENT
/begin MEASUREMENT matAssistantTorque_xds16 "Unterstuetzungsmoment" SWORD MMOT 1 100 -12.00000 12.00000 FORMAT "%8.5" ECU_ADDRESS 0xFE9F88BC /end MEASUREMENT
/begin MEASUREMENT matLimitation_xds16 "Steigungsbegrenztes Unterstuetzungsmoment ohne PT1 Offset" SWORD MMOT 1 100 -12.00000 12.00000 FORMAT "%8.5" ECU_ADDRESS 0xFE9F88C2 /end MEASUREMENT
/begin MEASUREMENT nApplI_AbsRotorSpeedFilt_xdu16 "absolute, gefilterte Rotorgeschwindigkeit" UWORD VROT 1 100 0.00 13000. FORMAT "%3.0" ECU_ADDRESS 0xFE9F89FC /end MEASUREMENT
/begin MEASUREMENT nApplI_RotorSpeedFilt_xds16 "gefilterte Rotorgeschwindigkeit" SWORD VROT 1 100 -13000. 13000. FORMAT "%3.0" ECU_ADDRESS 0xFE9F89FE /end MEASUREMENT
/begin MEASUREMENT nApplI_RotorSpeed_xds16 "ungefilterte Rotorgeschwindigkeit" SWORD VROT 1 100 -13000. 13000. FORMAT "%3.0" ECU_ADDRESS 0xFEE9B0B6 /end MEASUREMENT
/begin MEASUREMENT nEpsInI_EngineSpeed_xdu16 "Fahrzeug Motor Drehzahl" UWORD VROT 1 100 0.00 16382. FORMAT "%3.0" ECU_ADDRESS 0xFE9F8A0A /end MEASUREMENT
/begin MEASUREMENT sAhaDetI_AheadFromWheels_xdu8 "Flag: Geradeauslauf erkannt aus Raddrehzahlen" UBYTE ZU0 1 100 0.00 255.0 FORMAT "%5.1" ECU_ADDRESS 0xFE9F8E09 /end MEASUREMENT
/begin MEASUREMENT sAhaDetI_AheadFromYaw_xdu8 "Flag: Geradeauslauf erkannt aus Drehstabmoment und Fahrzeuggeschwindigkeit (Gierrate etc)" UBYTE ZU0 1 100 0.00 255.0 FORMAT "%5.1" ECU_ADDRESS 0xFE9F8E0A /end MEASUREMENT
/begin MEASUREMENT sApplI_CommBusTml50_xdu8 "Status Klemme 50" UBYTE ZU0 1 100 0.00 254.0 FORMAT "%5.1" ECU_ADDRESS 0xFE9F8E10 /end MEASUREMENT
/begin MEASUREMENT sApplI_EcuState_xdu8 " Sicherer Status der Ecu " UBYTE ECU_STATE 1 100 0.00 8.00000000000 FORMAT "%13.11" ECU_ADDRESS 0xFE9F8E12 /end MEASUREMENT
/begin MEASUREMENT sApplI_EngineRunning_xdu8 "Status des Verbrennungsmotors (0 == EngineNotRunning, 1 == EngineRunning, 2 == EngineRunningStable)" UBYTE ZU0 1 100 0.00 2.000 FORMAT "%5.3" ECU_ADDRESS 0xFE9F8E13 /end MEASUREMENT
/begin MEASUREMENT sApplI_SteeringAngleLinState_xdu8 "Status LW aus RW nicht korrigiert" UBYTE ZU0 1 100 0.00 2.000 FORMAT "%5.3" ECU_ADDRESS 0xFE9F8E18 /end MEASUREMENT
/begin MEASUREMENT sApplI_SystemState_xdu8 "System Status" UBYTE SYSTEM_STATE 1 100 1.00000000000 14.0000000000 FORMAT "%13.10" ECU_ADDRESS 0xFE9F8E1A /end MEASUREMENT
/begin MEASUREMENT sApplI_VehicleRunning_xdu8 "Status Fahrzeug fï¿½hrt (0 Fahrzeug steht, 1 Fahrzeug fï¿½hrt)" UBYTE ZU0 1 100 0.00 1.000 FORMAT "%5.3" ECU_ADDRESS 0xFE9F8E1C /end MEASUREMENT
/begin MEASUREMENT sApplI_VehicleSpeedState_xdu8 "Gï¿½ltigkeitsflag fï¿½r die Fahrzeuggeschw. vApplI_AbsVehicleSpeedFilt_xdu16 (1 = gï¿½ltig; 0 = ungï¿½ltig oder Ersatzgeschw.)" UBYTE ZU0 1 100 0.00 1.000 FORMAT "%5.3" ECU_ADDRESS 0xFE9F8E1D /end MEASUREMENT
/begin MEASUREMENT sBciI_ErrLvl_xdu8 "Bci Error Request" UBYTE ZU0 1 100 0.00 2.000 FORMAT "%5.3" ECU_ADDRESS 0xFE9F8E55 /end MEASUREMENT
/begin MEASUREMENT sEpsInI_VehicleSpeedQualifier_xdu8 "Qualifizierungssignal fuer das Fahrzeuggeschwindigkeitssignal" UBYTE ZU0 1 100 0.00 7.000 FORMAT "%5.3" ECU_ADDRESS 0xFE9F8EC5 /end MEASUREMENT
/begin MEASUREMENT sLowVoltAssRedI_OutStageState_xdu8 "Status Endstufe (0 = Endstufe EIN, 1 = Endstufe AUS kurze Zeit, 2 = Endstufe AUS lange Zeit)" UBYTE STATUS 1 100 0.00 2.000 FORMAT "%5.3" ECU_ADDRESS 0xFE9F8EF9 /end MEASUREMENT
/begin MEASUREMENT sLowVoltAssRed_RedLamp_xdu8 "Zeigt den aktuellen Status der roten Warnlampe" UBYTE ZU0 1 100 0.00 254.0 FORMAT "%5.1" ECU_ADDRESS 0xFE9F8EFC /end MEASUREMENT
/begin MEASUREMENT sLowVoltAssRed_YellowLamp_xdu8 "Zeigt den aktuellen Status der gelben Warnlampe" UBYTE ZU0 1 100 0.00 254.0 FORMAT "%5.1" ECU_ADDRESS 0xFE9F8EFE /end MEASUREMENT
/begin MEASUREMENT sRpSyncI_CalibAllowed_xdu8 "calibration: 1-allowed, 0-not allowed" UBYTE ZU0 1 100 0.00 1.000 FORMAT "%5.3" ECU_ADDRESS 0xFE9F8F1B /end MEASUREMENT
/begin MEASUREMENT sSCruiseFadrI_Reas_xdu8 "Fading reason of unexpected FadeOut or suppressed FadeIn: Bit0=ExtReq, Bit1=IntReq, Bit2=EMGY_DII" UBYTE ZU0 1 100 0.00 7.000 FORMAT "%5.3" ECU_ADDRESS 0xFE9F8F50 /end MEASUREMENT
/begin MEASUREMENT sSCruiseFadrI_State_xdu8 "FaderState (0=SFC; 1=SCI; 2=SFC2SCI; 3=SCI2SFC; 4=EMGY; 5=SCI2SFCPND; 6=REPLCMT; 7=ERR)" UBYTE SCRUISE_FADR_STATE 1 100 0.00 7.00000000000 FORMAT "%13.11" ECU_ADDRESS 0xFE9F8F52 /end MEASUREMENT
/begin MEASUREMENT sSCruiseI_CnclCdn_xdu16 "Cancel conditions indicating why active control mode of statemachine cannot be reached: Bit0=RedLvlTooLo, Bit1=FctCoOverruled, Bit2=SigInvld, Bit3=CtrlErr, Bit4=LimrErr, Bit5=FaderErr, Bit6=FaderEmgcy, Bit7=EcuSt, Bit8=VehSpd, Bit9=BlkdSteer, Bit10=SigPrcrReqOff, Bit11=SteerTrqReqOff, Bit12=FastReset, Bit13=SCIStateImps" UWORD ZU0 1 100 0.00 65535.00 FORMAT "%8.2" ECU_ADDRESS 0xFE9F8A56 /end MEASUREMENT
/begin MEASUREMENT sSCruiseI_Mod_xdu8 "SmartCruise operation mode: 0=Inactive, 1=HandsOn, 2=HandsFree, 3=Parking, 4=HandsOnInc" UBYTE SCRUISE_REQD_STATE 1 100 0.00 4.00000000000 FORMAT "%13.11" ECU_ADDRESS 0xFE9F8F55 /end MEASUREMENT
/begin MEASUREMENT sSCruiseI_ReqdState_xdu8 "Requested State for SCruise from Bus, mapped to internally. 0-Inactive, 1-HandsOn, 2-HandsFree, 3-Parking, 4=HandsOnInc" UBYTE SCRUISE_REQD_STATE 1 100 0.00 4.00000000000 FORMAT "%13.11" ECU_ADDRESS 0xFE9F8F56 /end MEASUREMENT
/begin MEASUREMENT sSCruiseI_State_xdu8 "State of SmartCruise Statemachine: 0=Inin, 1=NotAvl, 2=Avl, 3=FctCoReq, 4=FadeIn, 5=Actv, 6=FadeOut" UBYTE SCRUISE_STATE 1 100 0.00 6.00000000000 FORMAT "%13.11" ECU_ADDRESS 0xFE9F8F57 /end MEASUREMENT
/begin MEASUREMENT sSCruiseLimrI_State_xdu8 "Indicates the state of the SCruise Limiter: 0 = Not limited, 1 = Positiv Limited, 2 = Negativ Limited, 3 = Problem Detected" UBYTE SCRUISE_DYNLIM_STATUS 1 100 0.00 3.00000000000 FORMAT "%13.11" ECU_ADDRESS 0xFE9F8F58 /end MEASUREMENT
/begin MEASUREMENT sSCruiseLimr_StateESS_xdu8 "State of evasive steering support: 0=Inactv, 1=LoDynDetd, 2=IncDynDet, 3=HiDynDet, 4=ChkExtReq, 5=ESSActvt" UBYTE SCRUISE_STATE_ESS 1 100 0.00 3.00000000000 FORMAT "%13.11" ECU_ADDRESS 0xFE9F8F5B /end MEASUREMENT
/begin MEASUREMENT tEpsInI_SCruiseCmftFadeOutTi_xdu16 "SCruise fade out time comfort fading (SFC<=SCI)" UWORD TIMSEC_1000 1 100 0.001000000 6.200000 FORMAT "%8.6" ECU_ADDRESS 0xFE9F8A74 /end MEASUREMENT
/begin MEASUREMENT tLowVoltAssRed_HoldTimerRed_xdu16 "Timer fuer Haltezeit Rote Lampe" UWORD TIMMS 1 100 0.00 65000.00 FORMAT "%8.2" ECU_ADDRESS 0xFE9F8A76 /end MEASUREMENT
/begin MEASUREMENT tLowVoltAssRed_HoldTimerYellow_xdu16 "Timer fuer Haltezeit gelbe Lampe" UWORD TIMMS 1 100 0.00 65000.00 FORMAT "%8.2" ECU_ADDRESS 0xFE9F8A78 /end MEASUREMENT
/begin MEASUREMENT uApplI_SupplyVoltage_xdu16 "SupplyVoltage" UWORD U64V 1 100 0.00 33.00000 FORMAT "%8.5" ECU_ADDRESS 0xFEE9B0E8 /end MEASUREMENT
/begin MEASUREMENT uHwlWrapI_SupplyVoltageUnfilt_xdu16 "Ungefilterte Versorgungsspannung" UWORD U64V 1 100 0.00 33.00000 FORMAT "%8.5" ECU_ADDRESS 0xFEE9B0EA /end MEASUREMENT
/begin MEASUREMENT vApplI_AbsSafeNssVehicleSpeed_xdu16 "Abs. Fahrzeuggeschwindigkeit: Abgesichert im stillstandsnahen Bereich" UWORD VFZHIGH 1 100 0.00 500.0000 FORMAT "%8.4" ECU_ADDRESS 0xFE9F8AB0 /end MEASUREMENT
/begin MEASUREMENT vApplI_AbsSafeVehicleSpeed_xdu16 "Abs. Fahrzeuggeschwindigkeit: Abgesichert ï¿½ber den kompletten Geschwindigkeitsbereich" UWORD VFZHIGH 1 100 0.00 500.0000 FORMAT "%8.4" ECU_ADDRESS 0xFEE9B0EC /end MEASUREMENT
/begin MEASUREMENT vApplI_AbsSteeringAngleSpeed_xdu16 "Abs. Lenkwinkelgeschwindigkeit" UWORD SAS_8 1 100 0.00 1500.000 FORMAT "%8.3" ECU_ADDRESS 0xFE9F8AB2 /end MEASUREMENT
/begin MEASUREMENT vApplI_AbsVehicleSpeedFilt_xdu16 "Abs. Fahrzeuggeschwindigkeit: aufbereitet" UWORD VFZHIGH 1 100 0.00 511.0000 FORMAT "%8.4" ECU_ADDRESS 0xFE9F8AB4 /end MEASUREMENT
/begin MEASUREMENT vApplI_RackSpeed_xds16 "Zahnstangengeschwindigkeit [mm/s]" SWORD RACKSPEED128 1 100 -250.0000 250.0000 FORMAT "%8.4" ECU_ADDRESS 0xFE9F8AB6 /end MEASUREMENT
/begin MEASUREMENT vApplI_SteeringAngleSpeed_xds16 "Lenkwinkelgeschwindigkeit" SWORD SAS_8 1 100 -1500.000 1500.000 FORMAT "%8.3" ECU_ADDRESS 0xFE9F8AB8 /end MEASUREMENT
/begin MEASUREMENT vApplI_YawVelocity_xds16 "Gierrate" SWORD VGIER 1 100 -150.0000 150.0000 FORMAT "%8.4" ECU_ADDRESS 0xFE9F8ABA /end MEASUREMENT
/begin MEASUREMENT vBbaSacInI_MaxVehicleSpeed_xdu16 "max. Fahrzeuggeschwindigkeit aus SAC" UWORD VFZHIGH 1 100 0.00 1023.984 FORMAT "%8.3" ECU_ADDRESS 0xFE9F8ABE /end MEASUREMENT
/begin MEASUREMENT vEndStop_VehSpeedHystFilt_xdu16 "AbsVehicleSpeedFilt nach Hysterese und Filter fuer SWEA" UWORD VFZHIGH 1 100 0.00 500.0000 FORMAT "%8.4" ECU_ADDRESS 0xFE9F8AC6 /end MEASUREMENT
/begin MEASUREMENT vEpsInI_VehicleSpeedRaw_xds16 "Fahrzeug Geschwindigkeit Rohwert" SWORD VFZHIGH 1 100 0.00 511.0000 FORMAT "%8.4" ECU_ADDRESS 0xFE9F8ACC /end MEASUREMENT
/begin MEASUREMENT vEpsInI_WheelSpeedFLDiv_xds16 "Diverse Rad Geschwindigkeit vorne links" SWORD VFZHIGH 1 100 0.00 491.4844 FORMAT "%8.4" ECU_ADDRESS 0xFE9F8ACE /end MEASUREMENT
/begin MEASUREMENT vEpsInI_WheelSpeedFRDiv_xds16 "Diverse Rad Geschwindigkeit vorne rechts" SWORD VFZHIGH 1 100 0.00 491.4844 FORMAT "%8.4" ECU_ADDRESS 0xFE9F8AD0 /end MEASUREMENT
/begin MEASUREMENT vEpsInI_WheelSpeedRLDiv_xds16 "Diverse Rad Geschwindigkeit hinten links" SWORD VFZHIGH 1 100 0.00 491.4844 FORMAT "%8.4" ECU_ADDRESS 0xFE9F8AD2 /end MEASUREMENT
/begin MEASUREMENT vEpsInI_WheelSpeedRRDiv_xds16 "Diverse Rad Geschwindigkeit hinten rechts" SWORD VFZHIGH 1 100 0.00 491.4844 FORMAT "%8.4" ECU_ADDRESS 0xFE9F8AD4 /end MEASUREMENT
/begin MEASUREMENT vInCo_AbsVehicleSpeedFilt_xds16 "lokale kopie von vApplI_AbsVehicleSpeedFilt_xdu16 als Signed um DAMOS Kennlinieninterpolation verwende zu können" SWORD VFZHIGH 1 100 0.00 500.0000 FORMAT "%8.4" ECU_ADDRESS 0xFE9F8ADC /end MEASUREMENT
/begin MEASUREMENT vSCruiseI_AbsAvgVehSpd_xdu16 "SCruise mapped average vehicle speed. Goal: be as close to the actual speed over ground as possible." UWORD VFZHIGH 1 100 0.00 500.0000 FORMAT "%8.4" ECU_ADDRESS 0xFE9F8AE6 /end MEASUREMENT
/begin MEASUREMENT vSCruiseI_AbsMaxSafeVehSpd_xdu16 "Maximum safe vehicle speed" UWORD VFZHIGH 1 100 0.00 500.0000 FORMAT "%8.4" ECU_ADDRESS 0xFE9F8AE8 /end MEASUREMENT
/begin MEASUREMENT vSCruiseI_AbsMinSafeVehSpd_xdu16 "Minimum safe vehicle speed" UWORD VFZHIGH 1 100 0.00 500.0000 FORMAT "%8.4" ECU_ADDRESS 0xFE9F8AEA /end MEASUREMENT
/begin MEASUREMENT vSCruiseLimrI_NegRackSpdLim_xds16 "max. allowed negative rack speed with possible limit opening due to driver interaction checked" SWORD RACKSPEED128 1 100 -250.0000 250.0000 FORMAT "%8.4" ECU_ADDRESS 0xFE9F8AEE /end MEASUREMENT
/begin MEASUREMENT vSCruiseLimrI_PosRackSpdLim_xds16 "max. allowed positive rack speed with possible limit opening due to driver interaction checked" SWORD RACKSPEED128 1 100 -250.0000 250.0000 FORMAT "%8.4" ECU_ADDRESS 0xFE9F8AF2 /end MEASUREMENT
/begin MEASUREMENT vSCruiseLimrI_RackSpdLim4Chk_xdu16 "max. allowed rack speed" UWORD RACKSPEED128 1 100 0.00 250.0000 FORMAT "%8.4" ECU_ADDRESS 0xFE9F8AF6 /end MEASUREMENT
/begin MEASUREMENT vSCruiseLimrI_RackSpdLim_xdu16 "max. allowed rack speed w/o driver interaction" UWORD RACKSPEED128 1 100 0.00 250.0000 FORMAT "%8.4" ECU_ADDRESS 0xFE9F8AF8 /end MEASUREMENT
/begin MEASUREMENT vSCruise_NomRackSpd_xds32 "acceleration limited nominal rack speed which will be used to integrate nominal rack position" SLONG RIGHTSH17NP 1 100 -250.000000000 250.000000000 FORMAT "%13.9" ECU_ADDRESS 0xFE9F85A4 /end MEASUREMENT
/begin MEASUREMENT wApplI_AbsSteeringAngle_xdu16 "Abs. korrigierter Lenkwinkel" UWORD SA_10 1 100 0.00 1000.000 FORMAT "%8.3" ECU_ADDRESS 0xFE9F8B26 /end MEASUREMENT
/begin MEASUREMENT wApplI_PinionAngle_xds16 "Ritzel Winkel" SWORD SA_10 1 100 -1000.000 1000.000 FORMAT "%8.3" ECU_ADDRESS 0xFE9F8B2C /end MEASUREMENT
/begin MEASUREMENT wApplI_RotorPosition_xds32 "HW LIB: aufintegrierter, sprungkompensierter Rotorlagewinkel" SLONG ROTPOS 1 100 -32000.0097656 32000.0097656 FORMAT "%13.7" ECU_ADDRESS 0xFEE9B084 /end MEASUREMENT
/begin MEASUREMENT wApplI_SteeringAngle_xds16 "korrigierter Lenkwinkel" SWORD SA_10 1 100 -1000.000 1000.000 FORMAT "%8.3" ECU_ADDRESS 0xFE9F8B30 /end MEASUREMENT
/begin MEASUREMENT xApplI_TotalMotTorLim_xdu16 "Gesamtreduktion des Torque Reduction Coordinators" UWORD RIGHTSH15NP 1 100 0.00 1.000000 FORMAT "%8.6" ECU_ADDRESS 0xFEE9B0F6 /end MEASUREMENT
/begin MEASUREMENT xBci_AssistPostscaler_xdu16 "Y-Faktor auf Assist-Kennlinie" UWORD RIGHTSH14NP 1 100 0.5000000 1.500000 FORMAT "%8.6" ECU_ADDRESS 0xFE9F8BB4 /end MEASUREMENT
/begin MEASUREMENT xBci_AssistPrescaler_xdu16 "X-Faktor auf Assist-Kennlinie" UWORD RIGHTSH14NP 1 100 0.5000000 1.500000 FORMAT "%8.6" ECU_ADDRESS 0xFE9F8BB6 /end MEASUREMENT
/begin MEASUREMENT xLowVoltAssRed_AssistFactor_xdu16 "Faktorreduktion (angefordertes Motormoment)" UWORD RSH15 1 100 0.00 100.0000 FORMAT "%8.4" ECU_ADDRESS 0xFE9F8C24 /end MEASUREMENT
/begin MEASUREMENT xLowVoltAssRed_CurrentGradientFactor_xdu16 "Reduktionsfaktor auf maximalen Stromgradient" UWORD RSH15_GRAD1MS 1 100 0.00 100.0000 FORMAT "%8.4" ECU_ADDRESS 0xFE9F8C26 /end MEASUREMENT
/begin MEASUREMENT xMchStPrv_ActivationLevel_xdu16 "Activation Rechtecksignal Mechanical Stuck Prevention" UWORD RIGHTSH15NP 1 100 0.00 1.000000 FORMAT "%8.6" ECU_ADDRESS 0xFE9F8C2A /end MEASUREMENT
/begin MEASUREMENT xMotTorLim_ReductionLevel_xdu16 "Reduktionsgrad" UWORD RIGHTSH15NP 1 100 0.00 1.000000 FORMAT "%8.6" ECU_ADDRESS 0xFE9F8C32 /end MEASUREMENT
/begin MEASUREMENT xSCruiseFadrI_Prgs2SCI_xdu16 "Factor indicates fading progress (0=SFC; 1=SCI)" UWORD RIGHTSH15NP 1 100 0.00 1.000000 FORMAT "%8.6" ECU_ADDRESS 0xFE9F8C3A /end MEASUREMENT
/begin MEASUREMENT xSCruiseI_HandsOnFadrFac_xdu16 "Fading factor from a HandsOn (1) mode to non-HandsOn modes (0)" UWORD RIGHTSH10NP 1 100 0.00 1.000000 FORMAT "%8.6" ECU_ADDRESS 0xFE9F8C42 /end MEASUREMENT
/begin MEASUREMENT xSCruiseLimr_DrvrIntractnCloseLim_xds8 "factor to indicate Driver Interaction to close limit due to opp sign RackSpeed and TBT Grad" SBYTE ZU0 1 100 -1.000 1.000 FORMAT "%5.3" ECU_ADDRESS 0xFE9F8F9E /end MEASUREMENT
/begin MEASUREMENT xSCruiseLimr_DrvrIntractnOpenNegLim_xds8 "Indicate driver interaction to open limit into negative direction" SBYTE ZU0 1 100 -1.000 1.000 FORMAT "%5.3" ECU_ADDRESS 0xFE9F8F9F /end MEASUREMENT
/begin MEASUREMENT xSCruiseLimr_DrvrIntractnOpenPosLim_xds8 "Indicate driver interaction to open limit into positive direction" SBYTE ZU0 1 100 -1.000 1.000 FORMAT "%5.3" ECU_ADDRESS 0xFE9F8FA0 /end MEASUREMENT
/begin MEASUREMENT xatActTorGradFact_xdu16 "aktuelle Gradientenbegrenzung Unterspannungsueberwachung" UWORD RSH15 1 100 0.00 100.0000 FORMAT "%8.4" ECU_ADDRESS 0xFE9F8BA2 /end MEASUREMENT
/begin MEASUREMENT xatD2T3NoFiltFact_xdu16 "Faktor auf ohne Filter" UWORD RIGHTSH14NP 1 100 0.00 1.000000 FORMAT "%8.6" ECU_ADDRESS 0xFE9F87D2 /end MEASUREMENT
/begin MEASUREMENT xatD2T3V0Fact_xdu16 "Faktor auf Standfilter" UWORD RIGHTSH14NP 1 100 0.00 1.000000 FORMAT "%8.6" ECU_ADDRESS 0xFE9F87D4 /end MEASUREMENT
/begin MEASUREMENT xatD2T3V1Fact_xdu16 "Faktor auf Fahrfilter" UWORD RIGHTSH14NP 1 100 0.00 1.000000 FORMAT "%8.6" ECU_ADDRESS 0xFE9F87D6 /end MEASUREMENT
/begin MEASUREMENT xtcLimMotTorFactor_xdu16 "Faktor zur Begrenzung des Motormoments" UWORD RSH15 1 100 0.00 100.0000 FORMAT "%8.4" ECU_ADDRESS 0xFEE9B0FC /end MEASUREMENT
/begin MEASUREMENT yApplI_MaxBatteryCurrentGradient_xdu16 "Maximal erlaubter Batteriestromgradient der vom TRC (SDK) zum TLC (HwLib) geschickt wird" UWORD SM_I_MS 1 100 0.00 120.0000 FORMAT "%8.4" ECU_ADDRESS 0xFE9F8C84 /end MEASUREMENT
/begin MEASUREMENT yBci_CalcBoostCurvesL1PosVal_xdu16 "BoostCurveInterpolation - CalcBoostCurves - level 1 pos value" UWORD ZU0 1 100 0.00 65535.00 FORMAT "%8.2" ECU_ADDRESS 0xFE9F8C88 /end MEASUREMENT
/begin MEASUREMENT yEpsInI_NVEM_SupplyVoltageDefect_xdu8 "Defekte Versorgungsspannung bei >0" UBYTE ZU0 1 100 0.00 4.000 FORMAT "%5.3" ECU_ADDRESS 0xFE9F8FDB /end MEASUREMENT
/begin MEASUREMENT yeeEsLearnStatLeft_xdu8 "learn state left  / endstop" UBYTE ZU0 1 100 0.00 255.0 FORMAT "%5.1" ECU_ADDRESS 0xFE9F8FBE /end MEASUREMENT
/begin MEASUREMENT yeeEsLearnStatRight_xdu8 "learn state right  / endstop" UBYTE ZU0 1 100 0.00 255.0 FORMAT "%5.1" ECU_ADDRESS 0xFE9F8FBF /end MEASUREMENT
/begin MEASUREMENT zSCruiseLimr_CntrESS_xdu16 "counter of evasive steering detection; used for debouncing and maximum ESS" UWORD TIMSEC_1000 1 100 0.00 5.000000 FORMAT "%8.6" ECU_ADDRESS 0xFE9F8D14 /end MEASUREMENT
/begin MEASUREMENT zSCruiseLimr_JImp_xds16 "inertia impulse counter" SWORD TIMSEC_1000 1 100 -0.2500000 0.2500000 FORMAT "%9.7" ECU_ADDRESS 0xFE9F8D18 /end MEASUREMENT
/begin MEASUREMENT zcrChatterPeriodsCount_xdu8 "counter of the chatter oscillations" UBYTE ZU0 1 100 0.00 254.0 FORMAT "%5.1" ECU_ADDRESS 0xFE9F8D29 /end MEASUREMENT
/begin COMPU_METHOD ALR_IST_PROZ "" RAT_FUNC "%6.3" "%" COEFFS 0 2.5 0 0 0 1 /end COMPU_METHOD
/begin COMPU_METHOD ANG_ACCEL_REAL "angular acceleration in rad/sÂ² for float values" RAT_FUNC "%4.5" "rad/sÂ²" COEFFS 0 1.0 0.0 0 0 1 /end COMPU_METHOD
/begin COMPU_METHOD ANG_RAD_REAL "angle in rad for float values" RAT_FUNC "%4.5" "rad" COEFFS 0 1.0 0.0 0 0 1 /end COMPU_METHOD
/begin COMPU_METHOD ANG_VEL_REAL "angular velocity in rad/s for float values" RAT_FUNC "%4.5" "rad/s" COEFFS 0 1.0 0.0 0 0 1 /end COMPU_METHOD
/begin COMPU_METHOD AOC_FEATURES "" TAB_VERB "%6.3" "Feature" COMPU_TAB_REF AOC_FEATURES /end COMPU_METHOD
/begin COMPU_METHOD AOC_FEAT_STATE "" TAB_VERB "%6.3" "Status" COMPU_TAB_REF AOC_FEAT_STATE /end COMPU_METHOD
/begin COMPU_METHOD ARFACT "" RAT_FUNC "%7.6" "Nm s / Â°" COEFFS 0 16384 0 0 0 1 /end COMPU_METHOD
/begin COMPU_METHOD AUTOSAR_RTE_CompuMethods_RTE_Std_ReturnType_Enum_Values "Enum values for RTE_Std_ReturnType" TAB_VERB "%10.5" "-" COMPU_TAB_REF AUTOSAR_RTE_CompuMethods_RTE_Std_ReturnType_Enum_Values REF_UNIT AUTOSAR_AISpecification_Units_NoUnit /end COMPU_METHOD
/begin COMPU_METHOD BIT "" RAT_FUNC "%6.2" "Bitanzeige" COEFFS 0 1 0 0 0 1 /end COMPU_METHOD
/begin COMPU_METHOD CURR_GRAD_INT "current gradient" RAT_FUNC "%4.5" "A/ms" COEFFS 0 16.0 0.0 0 0 1 /end COMPU_METHOD
/begin COMPU_METHOD CURR_INT "current in A for integer values" RAT_FUNC "%4.5" "A" COEFFS 0 16.0 0.0 0 0 1 /end COMPU_METHOD
/begin COMPU_METHOD DefaultIdenticalCompu "" RAT_FUNC "%10.5" "" COEFFS 0.0 1.0 0.0 0.0 0.0 1.0 /end COMPU_METHOD
/begin COMPU_METHOD ECU_STATE "" TAB_VERB "%6.3" "Status" COMPU_TAB_REF ECU_STATE /end COMPU_METHOD
/begin COMPU_METHOD ENC_M12_h "" RAT_FUNC "%14.12" "Void" COEFFS 0 4096 0 0 0 1 /end COMPU_METHOD
/begin COMPU_METHOD Eps_Repository_DiagnosticManagement_DiagnosticConnector_CompuMethods_Identical "" RAT_FUNC "%10.5" "-" COEFFS 0.0 1.0 0.0 0.0 0.0 1.0 REF_UNIT Eps_Repository_DiagnosticManagement_DiagnosticConnector_Unit_NoUnit /end COMPU_METHOD
/begin COMPU_METHOD Eps_Repository_LoadTracking_BallNutGearLoadTracker_CompuMethods_Identical "" RAT_FUNC "%10.5" "-" COEFFS 0.0 1.0 0.0 0.0 0.0 1.0 REF_UNIT Eps_Repository_LoadTracking_BallNutGearLoadTracker_Unit_NoUnit /end COMPU_METHOD
/begin COMPU_METHOD Eps_Repository_LoadTracking_BallNutGearLoadTracker_CompuMethods_KgtAlteration "" RAT_FUNC "%10.5" "-" COEFFS 0.0 -1024.0 0.0 0.0 0.0 -1.0 REF_UNIT Eps_Repository_LoadTracking_BallNutGearLoadTracker_Unit_NoUnit /end COMPU_METHOD
/begin COMPU_METHOD Eps_Repository_LoadTracking_MechanicalLoadTracker_CompuMethods_Identical "" RAT_FUNC "%10.5" "-" COEFFS 0.0 1.0 0.0 0.0 0.0 1.0 REF_UNIT Eps_Repository_LoadTracking_MechanicalLoadTracker_Unit_NoUnit /end COMPU_METHOD
/begin COMPU_METHOD Eps_Repository_LoadTracking_MileageTracker_CompuMethods_Identical "" RAT_FUNC "%10.5" "-" COEFFS 0.0 1.0 0.0 0.0 0.0 1.0 REF_UNIT Eps_Repository_LoadTracking_MileageTracker_Unit_NoUnit /end COMPU_METHOD
/begin COMPU_METHOD Eps_Repository_LoadTracking_SteeringRangeTracker_CompuMethods_Identical "" RAT_FUNC "%10.5" "-" COEFFS 0.0 1.0 0.0 0.0 0.0 1.0 REF_UNIT Eps_Repository_LoadTracking_SteeringRangeTracker_Unit_NoUnit /end COMPU_METHOD
/begin COMPU_METHOD Eps_Repository_LoadTracking_TemperatureTracker_CompuMethods_Identical "" RAT_FUNC "%10.5" "-" COEFFS 0.0 1.0 0.0 0.0 0.0 1.0 REF_UNIT Eps_Repository_LoadTracking_TemperatureTracker_Unit_NoUnit /end COMPU_METHOD
/begin COMPU_METHOD Eps_Repository_LoadTracking_WormWheelDamageTracker_CompuMethods_Identical "" RAT_FUNC "%10.5" "-" COEFFS 0.0 1.0 0.0 0.0 0.0 1.0 REF_UNIT Eps_Repository_LoadTracking_WormWheelDamageTracker_Unit_NoUnit /end COMPU_METHOD
/begin COMPU_METHOD Eps_Repository_MeasurementAndCalibration_CustomerData_CompuMethods_Identical "" RAT_FUNC "%10.5" "" COEFFS 0.0 1.0 0.0 0.0 0.0 1.0 REF_UNIT Eps_Repository_MeasurementAndCalibration_CustomerData_Unit_NoUnit /end COMPU_METHOD
/begin COMPU_METHOD Eps_Repository_MeasurementAndCalibration_SimpleVarMeasurement_CompuMethods_Identical "" RAT_FUNC "%10.5" "" COEFFS 0.0 1.0 0.0 0.0 0.0 1.0 REF_UNIT Eps_Repository_MeasurementAndCalibration_SimpleVarMeasurement_Unit_NoUnit /end COMPU_METHOD
/begin COMPU_METHOD Eps_Repository_MeasurementAndCalibration_SystemData_CompuMethods_Identical "" RAT_FUNC "%10.5" "" COEFFS 0.0 1.0 0.0 0.0 0.0 1.0 REF_UNIT Eps_Repository_MeasurementAndCalibration_SystemData_Unit_NoUnit /end COMPU_METHOD
/begin COMPU_METHOD Eps_Repository_OperatingSystem_TaskControl_CompuMethods_Identical "" RAT_FUNC "%10.5" "-" COEFFS 0.0 1.0 0.0 0.0 0.0 1.0 REF_UNIT Eps_Repository_OperatingSystem_TaskControl_Unit_NoUnit /end COMPU_METHOD
/begin COMPU_METHOD Eps_Repository_SoftwareEndstop_EndStop_CompuMethods_Identical "" RAT_FUNC "%10.5" "" COEFFS 0.0 1.0 0.0 0.0 0.0 1.0 REF_UNIT Eps_Repository_SoftwareEndstop_EndStop_Unit_NoUnit /end COMPU_METHOD
/begin COMPU_METHOD Eps_Repository_SoftwareEndstop_EndStop_CompuMethods_Linear "" RAT_FUNC "%10.5" "" COEFFS 0.0 -128.0 0.0 0.0 0.0 -1.0 REF_UNIT Eps_Repository_SoftwareEndstop_EndStop_Unit_NoUnit /end COMPU_METHOD
/begin COMPU_METHOD Eps_Repository_SteeringAngleCalculation_RackPositionCorrection_CompuMethods_Identical "" RAT_FUNC "%10.5" "" COEFFS 0.0 1.0 0.0 0.0 0.0 1.0 REF_UNIT Eps_Repository_SteeringAngleCalculation_RackPositionCorrection_Unit_NoUnit /end COMPU_METHOD
/begin COMPU_METHOD Eps_Repository_SteeringAngleCalculation_RackPositionSynchronization_CompuMethods_Identical "" RAT_FUNC "%10.5" "" COEFFS 0.0 1.0 0.0 0.0 0.0 1.0 REF_UNIT Eps_Repository_SteeringAngleCalculation_RackPositionSynchronization_Unit_NoUnit /end COMPU_METHOD
/begin COMPU_METHOD FACTOR_100 "" RAT_FUNC "%6.4" "%" COEFFS 0 100 0 0 0 1 /end COMPU_METHOD
/begin COMPU_METHOD FLOAT "" RAT_FUNC "%16.7" "NA" COEFFS 0 1 0 0 0 1 /end COMPU_METHOD
/begin COMPU_METHOD FORCE2TORQUE "" RAT_FUNC "%10.9" "Nm/N" COEFFS 0 16777216 0 0 0 1 /end COMPU_METHOD
/begin COMPU_METHOD FRACK "" RAT_FUNC "%6.2" "N" COEFFS 0 1 0 0 0 1 /end COMPU_METHOD
/begin COMPU_METHOD FREQ "" RAT_FUNC "%6.2" "Hz" COEFFS 0 1 0 0 0 1 /end COMPU_METHOD
/begin COMPU_METHOD FREQHZ "" RAT_FUNC "%6.3" "Hz" COEFFS 0 8 0 0 0 1 /end COMPU_METHOD
/begin COMPU_METHOD INDUCTANCE_REAL "inductance in ÂµH for float values" RAT_FUNC "%4.5" "ÂµH" COEFFS 0 0.000001 0.0 0 0 1 /end COMPU_METHOD
/begin COMPU_METHOD INERTOR_HIGH "" RAT_FUNC "%7.6" "g * mÂ²" COEFFS 0 16384 0 0 0 1 /end COMPU_METHOD
/begin COMPU_METHOD LENK_X "" RAT_FUNC "%6.4" "DegreOfArc" COEFFS 0 27 0 0 0 1 /end COMPU_METHOD
/begin COMPU_METHOD LENK_Y "" RAT_FUNC "%6.5" "" COEFFS 0 1052 0 0 0 1 /end COMPU_METHOD
/begin COMPU_METHOD LEN_REAL "length in m for float values" RAT_FUNC "%4.5" "m" COEFFS 0 1.0 0.0 0 0 1 /end COMPU_METHOD
/begin COMPU_METHOD MAGN_FLUX_REAL "magnetic flux in Vs for float values" RAT_FUNC "%4.5" "Vs" COEFFS 0 1.0 0.0 0 0 1 /end COMPU_METHOD
/begin COMPU_METHOD METERS "" RAT_FUNC "%6.2" "m" COEFFS 0 1 0 0 0 1 /end COMPU_METHOD
/begin COMPU_METHOD MILEAGE "FktH=1.0 / 16.0 * phys + 0.0;" RAT_FUNC "%4.5" "km" COEFFS 0 0.0625 0.0 0 0 1 /end COMPU_METHOD
/begin COMPU_METHOD MMOT "" RAT_FUNC "%6.5" "Nm" COEFFS 0 1024 0 0 0 1 /end COMPU_METHOD
/begin COMPU_METHOD MMOT_RSH4 "" RAT_FUNC "%6.4" "Nm" COEFFS 0 16 0 0 0 1 /end COMPU_METHOD
/begin COMPU_METHOD MMOT_RSH5 "" RAT_FUNC "%6.4" "Nm" COEFFS 0 32 0 0 0 1 /end COMPU_METHOD
/begin COMPU_METHOD MMOT_RSH6 "" RAT_FUNC "%6.4" "Nm" COEFFS 0 64 0 0 0 1 /end COMPU_METHOD
/begin COMPU_METHOD NM_MIN_1024 "" RAT_FUNC "%6.5" "Nm/(1024/min)" COEFFS 0 1024 0 0 0 1 /end COMPU_METHOD
/begin COMPU_METHOD OHM_REAL "resistance in mâ„¦ for float values" RAT_FUNC "%4.5" "mâ„¦" COEFFS 0 0.001 0.0 0 0 1 /end COMPU_METHOD
/begin COMPU_METHOD PERCENT_GRAD_INT "percent gradient in %/s for integer values" RAT_FUNC "%4.5" "%/s" COEFFS 0 327.68 0.0 0 0 1 /end COMPU_METHOD
/begin COMPU_METHOD PERCENT_PER_S "FktH=32768.0 / 100.0 * phys + 0.0;" RAT_FUNC "%4.5" "%/s" COEFFS 0 327.68 0.0 0 0 1 /end COMPU_METHOD
/begin COMPU_METHOD POWER_REAL "power in W for float values" RAT_FUNC "%4.5" "W" COEFFS 0 1.0 0.0 0 0 1 /end COMPU_METHOD
/begin COMPU_METHOD QUO_INTGL_1MS "" RAT_FUNC "%7.6" "%/100*ms" COEFFS 0 32768 0 0 0 1 /end COMPU_METHOD
/begin COMPU_METHOD QUO_INTGL_1S "" RAT_FUNC "%7.6" "%/100*s" COEFFS 0 32768 0 0 0 1 /end COMPU_METHOD
/begin COMPU_METHOD RACKPOS128 "" RAT_FUNC "%6.4" "mm" COEFFS 0 128 0 0 0 1 /end COMPU_METHOD
/begin COMPU_METHOD RACKPOS256 "" RAT_FUNC "%6.4" "mm" COEFFS 0 256 0 0 0 1 /end COMPU_METHOD
/begin COMPU_METHOD RACKPOS_RSH15 "" RAT_FUNC "%7.6" "mm" COEFFS 0 32768 0 0 0 1 /end COMPU_METHOD
/begin COMPU_METHOD RACKPOS_RSH3 "" RAT_FUNC "%6.3" "mm" COEFFS 0 8 0 0 0 1 /end COMPU_METHOD
/begin COMPU_METHOD RACKSPEED "" RAT_FUNC "%6.2" "mm/s" COEFFS 0 1 0 0 0 1 /end COMPU_METHOD
/begin COMPU_METHOD RACKSPEED128 "" RAT_FUNC "%6.4" "mm/s" COEFFS 0 128 0 0 0 1 /end COMPU_METHOD
/begin COMPU_METHOD RAD_STAND "" RAT_FUNC "%6.5" "m" COEFFS 0 1111 0 0 0 1 /end COMPU_METHOD
/begin COMPU_METHOD RIGHTSH10NP "" RAT_FUNC "%6.5" "" COEFFS 0 1024 0 0 0 1 /end COMPU_METHOD
/begin COMPU_METHOD RIGHTSH10NP_1MS "" RAT_FUNC "%6.5" "1/1ms" COEFFS 0 1024 0 0 0 1 /end COMPU_METHOD
/begin COMPU_METHOD RIGHTSH11NP "" RAT_FUNC "%6.5" "" COEFFS 0 2048 0 0 0 1 /end COMPU_METHOD
/begin COMPU_METHOD RIGHTSH12NP "" RAT_FUNC "%6.5" "" COEFFS 0 4096 0 0 0 1 /end COMPU_METHOD
/begin COMPU_METHOD RIGHTSH13NP "" RAT_FUNC "%6.5" "1" COEFFS 0 8192 0 0 0 1 /end COMPU_METHOD
/begin COMPU_METHOD RIGHTSH14NP "" RAT_FUNC "%7.6" "" COEFFS 0 16384 0 0 0 1 /end COMPU_METHOD
/begin COMPU_METHOD RIGHTSH15NP "" RAT_FUNC "%7.6" "" COEFFS 0 32768 0 0 0 1 /end COMPU_METHOD
/begin COMPU_METHOD RIGHTSH15NP2N "RIGHTSH15NP to N " FORM "%6.5" "N" /begin FORMULA "X1 * 2737 / 32768" FORMULA_INV "X1 * 32768 / 2737" /end FORMULA /end COMPU_METHOD
/begin COMPU_METHOD RIGHTSH15NP_1MS "" RAT_FUNC "%7.6" "1/1ms" COEFFS 0 32768 0 0 0 1 /end COMPU_METHOD
/begin COMPU_METHOD RIGHTSH16NP "" RAT_FUNC "%7.6" "" COEFFS 0 65536 0 0 0 1 /end COMPU_METHOD
/begin COMPU_METHOD RIGHTSH17NP "" RAT_FUNC "%8.7" "" COEFFS 0 131072 0 0 0 1 /end COMPU_METHOD
/begin COMPU_METHOD RIGHTSH18NP "" RAT_FUNC "%8.7" "" COEFFS 0 262144 0 0 0 1 /end COMPU_METHOD
/begin COMPU_METHOD RIGHTSH20NP "" RAT_FUNC "%9.8" "" COEFFS 0 1048576 0 0 0 1 /end COMPU_METHOD
/begin COMPU_METHOD RIGHTSH21NP "" RAT_FUNC "%9.8" "" COEFFS 0 2097152 0 0 0 1 /end COMPU_METHOD
/begin COMPU_METHOD RIGHTSH6NP "" RAT_FUNC "%6.4" "" COEFFS 0 64 0 0 0 1 /end COMPU_METHOD
/begin COMPU_METHOD RIGHTSH6NP_1S "" RAT_FUNC "%6.4" "1/s" COEFFS 0 64 0 0 0 1 /end COMPU_METHOD
/begin COMPU_METHOD RIGHTSH7NP "" RAT_FUNC "%6.4" "" COEFFS 0 128 0 0 0 1 /end COMPU_METHOD
/begin COMPU_METHOD RIGHTSH8NP "" RAT_FUNC "%6.4" "" COEFFS 0 256 0 0 0 1 /end COMPU_METHOD
/begin COMPU_METHOD ROTACC "" RAT_FUNC "%6.4" "1/min/ms" COEFFS 0 64 0 0 0 1 /end COMPU_METHOD
/begin COMPU_METHOD ROTPOS "" RAT_FUNC "%6.3" "Â°" COEFFS 0 11.3777777777778 0 0 0 1 /end COMPU_METHOD
/begin COMPU_METHOD RSH15 "" RAT_FUNC "%6.4" "%" COEFFS 0 327.68 0 0 0 1 /end COMPU_METHOD
/begin COMPU_METHOD RSH15_GRAD1MS "" RAT_FUNC "%6.4" "% / ms" COEFFS 0 327.68 0 0 0 1 /end COMPU_METHOD
/begin COMPU_METHOD SAS_8 "" RAT_FUNC "%6.3" "Â°/s" COEFFS 0 8 0 0 0 1 /end COMPU_METHOD
/begin COMPU_METHOD SA_10 "" RAT_FUNC "%6.3" "Â°" COEFFS 0 10 0 0 0 1 /end COMPU_METHOD
/begin COMPU_METHOD SCRUISE_DYNLIM_STATUS "" TAB_VERB "%6.3" "Status" COMPU_TAB_REF SCRUISE_DYNLIM_STATUS /end COMPU_METHOD
/begin COMPU_METHOD SCRUISE_FADR_STATE "" TAB_VERB "%6.3" "Status" COMPU_TAB_REF SCRUISE_FADR_STATE /end COMPU_METHOD
/begin COMPU_METHOD SCRUISE_REQD_STATE "" TAB_VERB "%6.3" "Status" COMPU_TAB_REF SCRUISE_REQD_STATE /end COMPU_METHOD
/begin COMPU_METHOD SCRUISE_STATE "" TAB_VERB "%6.3" "Status" COMPU_TAB_REF SCRUISE_STATE /end COMPU_METHOD
/begin COMPU_METHOD SCRUISE_STATE_ESS "" TAB_VERB "%6.3" "Status" COMPU_TAB_REF SCRUISE_STATE_ESS /end COMPU_METHOD
/begin COMPU_METHOD SM_I "" RAT_FUNC "%6.4" "A" COEFFS 0 16 0 0 0 1 /end COMPU_METHOD
/begin COMPU_METHOD SM_I_MS "" RAT_FUNC "%6.4" "A/ms" COEFFS 0 16 0 0 0 1 /end COMPU_METHOD
/begin COMPU_METHOD STATUS "" RAT_FUNC "%6.2" "Status" COEFFS 0 1 0 0 0 1 /end COMPU_METHOD
/begin COMPU_METHOD SYSTEM_STATE "" TAB_VERB "%6.3" "Status" COMPU_TAB_REF SYSTEM_STATE /end COMPU_METHOD
/begin COMPU_METHOD TBTHIGH "" RAT_FUNC "%6.5" "Nm" COEFFS 0 1024 0 0 0 1 /end COMPU_METHOD
/begin COMPU_METHOD TIMMS "" RAT_FUNC "%6.2" "ms" COEFFS 0 1 0 0 0 1 /end COMPU_METHOD
/begin COMPU_METHOD TIMSEC_10 "" RAT_FUNC "%6.3" "s" COEFFS 0 10 0 0 0 1 /end COMPU_METHOD
/begin COMPU_METHOD TIMSEC_100 "" RAT_FUNC "%6.4" "s" COEFFS 0 100 0 0 0 1 /end COMPU_METHOD
/begin COMPU_METHOD TIMSEC_1000 "" RAT_FUNC "%6.5" "s" COEFFS 0 1000 0 0 0 1 /end COMPU_METHOD
/begin COMPU_METHOD TIMUS "" RAT_FUNC "%6.2" "us" COEFFS 0 1 0 0 0 1 /end COMPU_METHOD
/begin COMPU_METHOD TMPOUTS "" RAT_FUNC "%6.2" "Â°C" COEFFS 0 1 70 0 0 1 /end COMPU_METHOD
/begin COMPU_METHOD TORGAINHIGH "" RAT_FUNC "%6.5" "Nm/Nm" COEFFS 0 1024 0 0 0 1 /end COMPU_METHOD
/begin COMPU_METHOD TORGRAD "" RAT_FUNC "%6.5" "Nm/ms" COEFFS 0 1024 0 0 0 1 /end COMPU_METHOD
/begin COMPU_METHOD TORGRAD_RSH14_MS "" RAT_FUNC "%7.6" "Nm/ms" COEFFS 0 16384 0 0 0 1 /end COMPU_METHOD
/begin COMPU_METHOD U64V "" RAT_FUNC "%6.4" "V" COEFFS 0 64 0 0 0 1 /end COMPU_METHOD
/begin COMPU_METHOD VFZ "" RAT_FUNC "%6.2" "km/h" COEFFS 0 1 0 0 0 1 /end COMPU_METHOD
/begin COMPU_METHOD VFZHIGH "" RAT_FUNC "%6.4" "km/h" COEFFS 0 64 0 0 0 1 /end COMPU_METHOD
/begin COMPU_METHOD VGIER "" RAT_FUNC "%6.4" "Â°/s" COEFFS 0 200 0 0 0 1 /end COMPU_METHOD
/begin COMPU_METHOD VROT "" RAT_FUNC "%3.1" "1/min" COEFFS 0 1 0 0 0 1 /end COMPU_METHOD
/begin COMPU_METHOD VROT_RSH2 "" RAT_FUNC "%3.1" "1/min" COEFFS 0 4 0 0 0 1 /end COMPU_METHOD
/begin COMPU_METHOD ZU0 "" RAT_FUNC "%6.2" "" COEFFS 0 1 0 0 0 1 /end COMPU_METHOD
/begin UNIT AUTOSAR_AISpecification_Units_NoUnit "No Unit" "-" EXTENDED_SI SI_EXPONENTS 0 0 0 0 0 0 0 /end UNIT
/begin UNIT Eps_Repository_DiagnosticManagement_DiagnosticConnector_Unit_NoUnit "" "-" EXTENDED_SI SI_EXPONENTS 0 0 0 0 0 0 0 /end UNIT
/begin UNIT Eps_Repository_LoadTracking_BallNutGearLoadTracker_Unit_NoUnit "" "-" EXTENDED_SI SI_EXPONENTS 0 0 0 0 0 0 0 /end UNIT
/begin UNIT Eps_Repository_LoadTracking_MechanicalLoadTracker_Unit_NoUnit "" "-" EXTENDED_SI SI_EXPONENTS 0 0 0 0 0 0 0 /end UNIT
/begin UNIT Eps_Repository_LoadTracking_MileageTracker_Unit_NoUnit "" "-" EXTENDED_SI SI_EXPONENTS 0 0 0 0 0 0 0 /end UNIT
/begin UNIT Eps_Repository_LoadTracking_SteeringRangeTracker_Unit_NoUnit "" "-" EXTENDED_SI SI_EXPONENTS 0 0 0 0 0 0 0 /end UNIT
/begin UNIT Eps_Repository_LoadTracking_TemperatureTracker_Unit_NoUnit "" "-" EXTENDED_SI SI_EXPONENTS 0 0 0 0 0 0 0 /end UNIT
/begin UNIT Eps_Repository_LoadTracking_WormWheelDamageTracker_Unit_NoUnit "" "-" EXTENDED_SI SI_EXPONENTS 0 0 0 0 0 0 0 /end UNIT
/begin UNIT Eps_Repository_MeasurementAndCalibration_CustomerData_Unit_NoUnit "" "" EXTENDED_SI SI_EXPONENTS 0 0 0 0 0 0 0 /end UNIT
/begin UNIT Eps_Repository_MeasurementAndCalibration_SimpleVarMeasurement_Unit_NoUnit "" "" EXTENDED_SI SI_EXPONENTS 0 0 0 0 0 0 0 /end UNIT
/begin UNIT Eps_Repository_MeasurementAndCalibration_SystemData_Unit_NoUnit "" "" EXTENDED_SI SI_EXPONENTS 0 0 0 0 0 0 0 /end UNIT
/begin UNIT Eps_Repository_OperatingSystem_TaskControl_Unit_NoUnit "" "-" EXTENDED_SI SI_EXPONENTS 0 0 0 0 0 0 0 /end UNIT
/begin UNIT Eps_Repository_SoftwareEndstop_EndStop_Unit_NoUnit "" "" EXTENDED_SI SI_EXPONENTS 0 0 0 0 0 0 0 /end UNIT
/begin UNIT Eps_Repository_SteeringAngleCalculation_RackPositionCorrection_Unit_NoUnit "" "" EXTENDED_SI SI_EXPONENTS 0 0 0 0 0 0 0 /end UNIT
/begin UNIT Eps_Repository_SteeringAngleCalculation_RackPositionSynchronization_Unit_NoUnit "" "" EXTENDED_SI SI_EXPONENTS 0 0 0 0 0 0 0 /end UNIT
/*********** End of merged UNIT blocks ***********/ /*********** Start of merged FUNCTION blocks ***********/
/begin FUNCTION ActiveReturn "Active Return" /begin IN_MEASUREMENT wApplI_AbsSteeringAngle_xdu16 /end IN_MEASUREMENT /end FUNCTION
/begin FUNCTION ActiveReturnCheck "ActiveReturnCheck"
 /begin IN_MEASUREMENT vVehSpI_AbsMaxSafeVehSpd_xdu16 wApplI_AbsSteeringAngle_xdu16 /end IN_MEASUREMENT
/end FUNCTION
/begin FUNCTION AheadDetection_Main_Interface "AheadDetection Main Interface kgt" /begin OUT_MEASUREMENT sAhaDetI_AheadFromWheels_xdu8 sAhaDetI_AheadFromYaw_xdu8 /end OUT_MEASUREMENT /end FUNCTION
/begin FUNCTION ApplicationInterfaceI "Applikations Schnittsstelle"
 /begin OUT_MEASUREMENT aApplI_RotAcceleration_xds16 iApplI_MaxBattCurr_xdu16 lApplI_RackPosition_xds16 lApplI_VehCentRackPos_xds16 mApplI_MaxRequiredMotorTorque_xdu16 mApplI_NominalMotorTorque_xds16 nApplI_AbsRotorSpeedFilt_xdu16 nApplI_RotorSpeedFilt_xds16 nApplI_RotorSpeed_xds16 sApplI_CommBusTml50_xdu8 sApplI_EcuState_xdu8 sApplI_EngineRunning_xdu8 sApplI_SteeringAngleLinState_xdu8 sApplI_VehicleRunning_xdu8 sApplI_VehicleSpeedState_xdu8 vApplI_AbsSafeNssVehicleSpeed_xdu16 vApplI_AbsSafeVehicleSpeed_xdu16 vApplI_AbsSteeringAngleSpeed_xdu16 vApplI_AbsVehicleSpeedFilt_xdu16 vApplI_RackSpeed_xds16 vApplI_SteeringAngleSpeed_xds16 vApplI_YawVelocity_xds16 wApplI_AbsSteeringAngle_xdu16 wApplI_PinionAngle_xds16 wApplI_SteeringAngle_xds16 xApplI_TotalMotTorLim_xdu16 yApplI_MaxBatteryCurrentGradient_xdu16 /end OUT_MEASUREMENT
/end FUNCTION
/begin FUNCTION AssistanceI "Interface Unterstuetzungsmoment" /begin OUT_MEASUREMENT matAssistantTorque_xds16 /end OUT_MEASUREMENT /end FUNCTION
/begin FUNCTION AssistanceV3 "Unterstuetzungsmoment V3"
 /begin DEF_CHARACTERISTIC fatD2T3Enable_XDU8 matD2T3Fading_XAU16 xatAssistFilterFrequFast_XDU16 xatAssistFilterFrequ_XAU16 xatD2T3FactSumMax_XDU16 xatD2T3FactSumMin_XDU16 xatD2T3FiltA1V2_XDF32 xatD2T3FiltA1_XDF32 xatD2T3FiltA2V2_XDF32 xatD2T3FiltA2_XDF32 xatD2T3FiltB0V2_XDF32 xatD2T3FiltB0_XDF32 xatD2T3FiltB1V2_XDF32 xatD2T3FiltB1_XDF32 xatD2T3FiltB2V2_XDF32 xatD2T3FiltB2_XDF32 xatD2T3FiltPT1FiltFactV2_XDU16 xatD2T3FiltPT1FiltFact_XDU16 xatD2T3NoFiltFact_XAU16 xatD2T3V0Fact_XAU16 xatD2T3V1Fact_XAU16 xatMaxGradChatterActive_XAU16 xatMaxGradTorGrad_XAU16 xatMaxGradvVehicleReverse_XAU16 xatMaxGradvVehicle_XAU16 /end DEF_CHARACTERISTIC
 /begin IN_MEASUREMENT vApplI_AbsSafeNssVehicleSpeed_xdu16 vApplI_AbsVehicleSpeedFilt_xdu16 /end IN_MEASUREMENT
 /begin OUT_MEASUREMENT fatD2T3FactSumOutOfRange_xdb matAbsAssistD2T3Delta_xdu16 matAbsTorsionBarTorque_xdu16 matAssistD2T3V0AfterPT1_xds16 matAssistD2T3V1AfterPT1_xds16 matAssistD2T3_xds16 matLimitation_xds16 xatActTorGradFact_xdu16 xatD2T3NoFiltFact_xdu16 xatD2T3V0Fact_xdu16 xatD2T3V1Fact_xdu16 /end OUT_MEASUREMENT
/end FUNCTION
/begin FUNCTION BbaSacIn "BBASACIN"
 /begin OUT_MEASUREMENT kBbaSacInI_QhmRackForce_xds16 vBbaSacInI_MaxVehicleSpeed_xdu16 /end OUT_MEASUREMENT
/end FUNCTION
/begin FUNCTION BoostCurveInterpolationI "Unterstuetzungskennlinien"
 /begin OUT_MEASUREMENT mBciI_AssistCurveMMotYAxis_xau16 mBciI_AssistCurveTBTXAxis_xau16 sBciI_ErrLvl_xdu8 /end OUT_MEASUREMENT
/end FUNCTION
/begin FUNCTION BoostCurveInterpolation_TorqueBased "Unterstuetzungskennlinien (calculate boost curves)"
 /begin DEF_CHARACTERISTIC mBci_V0AssistCurveAuto_XAU16 mBci_V0AssistCurveDyn_XAU16 mBci_V0AssistCurveKomf_XAU16 mBci_V0TbtArray_XAU16 mBci_V1AssistCurveAuto_XAU16 mBci_V1AssistCurveDyn_XAU16 mBci_V1AssistCurveKomf_XAU16 mBci_V1TbtArray_XAU16 mBci_V2AssistCurveAuto_XAU16 mBci_V2AssistCurveDyn_XAU16 mBci_V2AssistCurveKomf_XAU16 mBci_V2TbtArray_XAU16 mBci_V3AssistCurveAuto_XAU16 mBci_V3AssistCurveDyn_XAU16 mBci_V3AssistCurveKomf_XAU16 mBci_V3TbtArray_XAU16 mBci_V4AssistCurveAuto_XAU16 mBci_V4AssistCurveDyn_XAU16 mBci_V4AssistCurveKomf_XAU16 mBci_V4TbtArray_XAU16 mBci_V5AssistCurveAuto_XAU16 mBci_V5AssistCurveDyn_XAU16 mBci_V5AssistCurveKomf_XAU16 mBci_V5TbtArray_XAU16 xBci_AssistPostscaleFactorAuto_XDU16 xBci_AssistPostscaleFactorDyn_XDU16 xBci_AssistPostscaleFactorKomf_XDU16 xBci_AssistPrescaleFactorAuto_XDU16 xBci_AssistPrescaleFactorDyn_XDU16 xBci_AssistPrescaleFactorKomf_XDU16 zBci_AssistCurveSelect_XAU16 /end DEF_CHARACTERISTIC
 /begin IN_MEASUREMENT matAbsTorsionBarTorque_xdu16 /end IN_MEASUREMENT
 /begin OUT_MEASUREMENT mBci_LimitedAssistCurveMMotYAxis_xau16 mBci_LimitedAssistCurveTBTXAxis_xau16 mBci_ScaledAssistCurveMMotYAxis_xau16 mBci_ScaledAssistCurveTBTXAxis_xau16 xBci_AssistPostscaler_xdu16 xBci_AssistPrescaler_xdu16 yBci_CalcBoostCurvesL1PosVal_xdu16 /end OUT_MEASUREMENT
/end FUNCTION
/begin FUNCTION CalDatHdl_RefOffset "Berechnung der Adressoffsets fï¿½r den Zugriff auf Kalibrierdaten"
 /begin DEF_CHARACTERISTIC xCalDatHdl_EraseAllXcpFlashedData_XDU8 xCalDatHdl_StartXcpFlash_XDU8 ySy_FocDatasetName_XAU8 ySy_OemDatasetName_XAU8 ySy_SysDatasetName_XAU8 ySy_TunDatasetName_XAU8 /end DEF_CHARACTERISTIC
/end FUNCTION
/begin FUNCTION ChatterSensor "ChatterSensor"
 /begin DEF_CHARACTERISTIC ncruAbsChatterGrad_XDU16 tcrChatterCycleResetDelay_XDU16 tcroChatterTime_XDU8 vcrVehSpeedLimit_XDU16 zcrMinChatterPeriodsCountDelayed_XDU8 /end DEF_CHARACTERISTIC
/end FUNCTION
/begin FUNCTION ChatterSensorI "ChatterSensorI" /begin OUT_MEASUREMENT zcrChatterPeriodsCount_xdu8 /end OUT_MEASUREMENT /end FUNCTION
/begin FUNCTION DiagConnI_MainFunction "Gibt Events an den DEM weiter" /begin DEF_CHARACTERISTIC tDiagConn_WorkingTimeUs_XDU16 /end DEF_CHARACTERISTIC /end FUNCTION
/begin FUNCTION EndStop "Endanschlag"
 /begin DEF_CHARACTERISTIC fEndStop_LimitEnable_XDU8 lEndStop_EsMechIndentLeft_XDU16 lEndStop_EsMechIndentRight_XDU16 mEndStop_SpringTorque_XAS16 mEndStop_uMotorTorque_XDU16 xEndStop_Damping_XAS16 xEndStop_RotSpeedFiltFact_XDU16 /end DEF_CHARACTERISTIC
 /begin IN_MEASUREMENT lEndStopI_DistanceToEndstop_xds16 nApplI_AbsRotorSpeedFilt_xdu16 /end IN_MEASUREMENT
 /begin OUT_MEASUREMENT fEndStop_NoLearnFlag_xdu8 /end OUT_MEASUREMENT
/end FUNCTION
/begin FUNCTION EndStopHsdSuppI "EndStopHsdSupp - interface" /begin OUT_MEASUREMENT fEndStopHsdI_EnableUndervoltOffset_xdb /end OUT_MEASUREMENT /end FUNCTION
/begin FUNCTION EndStopSupp "Endanschlag Supp-Komponente"
 /begin DEF_CHARACTERISTIC fEndStop_EnableDynamicEndStop_XDU8 fEndStop_EnableVehSpeedFiltering_XDU8 lEndStop_MaxSteerRange_XDU16 lEndStop_VehicleSpeedDepOffset_XAU16 vEndStop_HysteresisRange_XDU16 vEndStop_MaxEndStopOffsetGradFalling_XDU16 vEndStop_MaxEndStopOffsetGradRising_XDU16 xEndStop_OversteerabilityFactor_XDU16 xEndStop_VehSpeedFiltFact_XDU16 /end DEF_CHARACTERISTIC
 /begin OUT_MEASUREMENT vEndStop_VehSpeedHystFilt_xdu16 /end OUT_MEASUREMENT
/end FUNCTION
/begin FUNCTION EndStop_I "Endanschlag"
 /begin OUT_MEASUREMENT lEndStopI_DistanceToEndstop_xds16 lEndStopI_RackPosMax_xds16 lEndStopI_RackPosMin_xds16 mEndStopI_MotorTorque_xds16 /end OUT_MEASUREMENT
/end FUNCTION
/begin FUNCTION EpsOutput_B00I "Interface Mess- und ApplikationsgrÃ¶ÃŸen AssSysMon" /begin DEF_CHARACTERISTIC fEpsOut_SetBusSteeringAngleInvalid_XDB /end DEF_CHARACTERISTIC /end FUNCTION
/begin FUNCTION HWLibDamosInterface "Interfaces der Hardware lib used in ROM Kennlinie in the SDK" /begin DEF_CHARACTERISTIC mHwlWrapI_MaxMechAllowedTorque_XDF32 /end DEF_CHARACTERISTIC
 /begin OUT_MEASUREMENT cApplI_InternTempFilt_xdu8 cApplI_OutstageTempFilt_xdu8 iApplI_BatteryCurrent_xds16 mApplI_LimitedMotorTorque_xds16 uApplI_SupplyVoltage_xdu16 uHwlWrapI_SupplyVoltageUnfilt_xdu16 wApplI_RotorPosition_xds32 xtcLimMotTorFactor_xdu16 /end OUT_MEASUREMENT
/end FUNCTION
/begin FUNCTION HighSpeedDamping "Daempfung bei hohen Rotorgeschwindigkeiten"
 /begin DEF_CHARACTERISTIC fEndStopHsd_EnableUnFiltRotSpeed_XDU8 nEndStopHsd_HighSpeedDampingStartReverse_XAS16 nEndStopHsd_HighSpeedDampingStart_XAS16 nEndStopHsd_RotSpeedFallingHysteresisReverse_XAU16 nEndStopHsd_RotSpeedFallingHysteresis_XAU16 nEndStopHsd_UnderVoltageStartOffset_XAU16 tEndStopHsd_SpeedTooHighTol_XDU16 tEndStopHsd_VehDirDebounceTime_XDU16 vEndStopHsd_BackwardDisableTh_XDU8 vEndStopHsd_BackwardEnableTh_XDU8 vEndStopHsd_MaxAllowedBackward_XDU8 xEndStopHsd_HighSpeedDampingFactorReverse_XAU16 xEndStopHsd_HighSpeedDampingFactor_XAU16 /end DEF_CHARACTERISTIC
 /begin IN_MEASUREMENT uApplI_SupplyVoltage_xdu16 vApplI_AbsVehicleSpeedFilt_xdu16 /end IN_MEASUREMENT
 /begin OUT_MEASUREMENT fEndStopHsd_ForwardDrv_xdb lEndStopHsd_InternDistToES_xds16 /end OUT_MEASUREMENT
/end FUNCTION
/begin FUNCTION HighSpeedDampingCheck "DÃ¤mpfung bei hohen Rotorgeschwindigkeiten"
 /begin DEF_CHARACTERISTIC mEndStopHsd_MaxAllwdMMotVHigh_GenMode_XDU16 uEndStopHsd_ApplyUOffsetTh_XDU16 /end DEF_CHARACTERISTIC
 /begin OUT_MEASUREMENT fEndStopHsd_Disable_xdb /end OUT_MEASUREMENT
/end FUNCTION
/begin FUNCTION HighSpeedDampingCheckI "berPrÃ¼fung der DÃ¤mpfung hoher Rotorgeschwindigkeiten - Interface" /begin OUT_MEASUREMENT mEndStopHsdI_MotTrq_xds16 /end OUT_MEASUREMENT /end FUNCTION
/begin FUNCTION IEpsInput "InterfacegrÃ¶ÃŸen der Komponente EpsInput"
 /begin DEF_CHARACTERISTIC fEpsInI_AWV_QFK_Kruemmung_Fas02_XDU8 fEpsInI_DSR_QFK_Kruemmung_Fas04_XDU8 fEpsInI_HCA_QFK_Kruemmung_Fas03_XDU8 fEpsInI_PLA_QFK_Kruemmung_Fas01_XDU8 fEpsInI_RHP_QFK_Kruemmung_Fas05_XDU8 /end DEF_CHARACTERISTIC
 /begin OUT_MEASUREMENT nEpsInI_EngineSpeed_xdu16 sEpsInI_VehicleSpeedQualifier_xdu8 vEpsInI_VehicleSpeedRaw_xds16 vEpsInI_WheelSpeedFLDiv_xds16 vEpsInI_WheelSpeedFRDiv_xds16 vEpsInI_WheelSpeedRLDiv_xds16 vEpsInI_WheelSpeedRRDiv_xds16 yEpsInI_NVEM_SupplyVoltageDefect_xdu8 /end OUT_MEASUREMENT
/end FUNCTION
/begin FUNCTION IInertiaModification "Trägheitskompensation - Interfacegrößen" /begin OUT_MEASUREMENT mInCoI_InertiaComp_xds16 /end OUT_MEASUREMENT /end FUNCTION
/begin FUNCTION ILowVoltageAssistReduction "UnderVoltage reduction activation"
 /begin OUT_MEASUREMENT fEngRnI_EngineRunningStable_xdb fLowVoltAssRedI_StartStopEnabled_xdb fLowVoltAssRedI_UHighError_xdb fLowVoltAssRedI_ULowError_xdb /end OUT_MEASUREMENT
/end FUNCTION
/begin FUNCTION ILowVoltageAssistReductionCheck "UnderVoltage reduction activation" /begin OUT_MEASUREMENT sLowVoltAssRedI_OutStageState_xdu8 /end OUT_MEASUREMENT /end FUNCTION
/begin FUNCTION InertiaModification "Trägheitskompensation - Mess- und Applikationsgrößen"
 /begin DEF_CHARACTERISTIC mInCo_V0Fading_XAU16 mInCo_V1Fading_XAU16 mInCo_V2Fading_XAU16 mInCo_V3Fading_XAU16 vInCo_VehSpeedForFactors_XAS16 xInCo_ChatterRotAccFactor_XAS16 xInCo_InvalidInputSigRotAccFactor_XDS16 xInCo_RotAccFactor_XAS16 zInCo_ChatterCountLimitInertia_XDU8 /end DEF_CHARACTERISTIC
 /begin OUT_MEASUREMENT mInCo_AbsCompTorqueUnLimited_xdu16 vInCo_AbsVehicleSpeedFilt_xds16 /end OUT_MEASUREMENT
/end FUNCTION
/begin FUNCTION LowVoltageAssistReductionCheck "LowVoltageAssistReductionCheck"
 /begin DEF_CHARACTERISTIC iLowVoltAssRed_MaxCurrentGen_XDU16 tLowVoltAssRed_UnderVoltageOutStageOffTime_XDU16 /end DEF_CHARACTERISTIC
 /begin OUT_MEASUREMENT xLowVoltAssRed_AssistFactor_xdu16 xLowVoltAssRed_CurrentGradientFactor_xdu16 /end OUT_MEASUREMENT
/end FUNCTION
/begin FUNCTION LowVoltageAssistReduction_Under "Unterspannungsreduzierung"
 /begin DEF_CHARACTERISTIC fLowVoltAssRed_HideVehSpeedDepVoltRed_XDB iLowVoltAssRed_MaxCurrent_XDU16 mLowVoltAssRed_MinMotorTorqueGen_XDU16 nLowVoltAssRed_EngineRunningLowerLimit_XDU16 nLowVoltAssRed_EngineRunningUpperLimit_XDU16 nLowVoltAssRed_MinRotorSpeedGen_XDU16 tLowVoltAssRed_EngineRunningTimeLimit_XDU16 vLowVoltAssRed_EngineRunningSpeedLimit_XDU16 xLowVoltAssRed_AssistFactorSupVoltDef_XDU16 xLowVoltAssRed_CurrentFactorSupVoltDef_XDU16 xLowVoltAssRed_CurrentGradientFactorSupVoltDef_XDU16 xLowVoltAssRed_EngineRunningAssistLimit_XDU16 xLowVoltAssRed_GradTorqueGradientNegDAC_XDU16 xLowVoltAssRed_GradTorqueGradientPosDAC_XDU16 xLowVoltAssRed_NegGradAssistFactor_XDU16 xLowVoltAssRed_NegGradCurrentFactor_XDU16 xLowVoltAssRed_NegGradCurrentGradientFactor_XDU16 xLowVoltAssRed_PosGradCurrentFactorVehNotRun_XDU16 xLowVoltAssRed_UnderVoltageAssistFactorGen_XAU16 xLowVoltAssRed_UnderVoltageTorqueGradientDAC_XAU16 yLowVoltAssRed_MaxCurrentGradient_XDU16 /end DEF_CHARACTERISTIC
 /begin IN_MEASUREMENT uHwlWrapI_SupplyVoltageUnfilt_xdu16 /end IN_MEASUREMENT
 /begin OUT_MEASUREMENT fLowVoltAssRed_GeneratorMode_xdu8 sLowVoltAssRed_RedLamp_xdu8 sLowVoltAssRed_YellowLamp_xdu8 tLowVoltAssRed_HoldTimerRed_xdu16 tLowVoltAssRed_HoldTimerYellow_xdu16 /end OUT_MEASUREMENT
/end FUNCTION
/begin FUNCTION MchStPrv "Mechanical Stuck Prevention"
 /begin DEF_CHARACTERISTIC nMchStPrv_BoundRotSpeedGRADTBT_XAU16 nMchStPrv_BoundRotSpeedMeffVO_XAU16 nMchStPrv_BoundRotSpeedMeff_XAU16 nMchStPrv_BoundRotSpeedSWA_XAU16 tMchStPrv_HakelPeriodHalf_XDU16 vMchStPrv_MeffV0bound_XDU16 xMchStPrv_GradTBTFilterFact_XDU16 xMchStPrv_GroundLevelFactHakel_XDU16 xMchStPrv_GroundLevelHakelAngle_XAU16 xMchStPrv_GroundLevelHakelVFZFactor_XAU16 xMchStPrv_HakelGrad_XDU16 xMchStPrv_MaxActDepSteeringAngle_XAU16 xMchStPrv_MaxActDepVFZ_XAU16 xMchStPrv_RotSpeedRefVFZFactor_XAU16 /end DEF_CHARACTERISTIC
 /begin IN_MEASUREMENT vApplI_AbsVehicleSpeedFilt_xdu16 wApplI_AbsSteeringAngle_xdu16 /end IN_MEASUREMENT
 /begin OUT_MEASUREMENT mMchStPrv_AbsEffMotTor_xdu16 mMchStPrv_FilteredGRADTBT_xdu16 xMchStPrv_ActivationLevel_xdu16 /end OUT_MEASUREMENT
/end FUNCTION
/begin FUNCTION MotorTorqueLimiter "Begrenzung des Motormoments" /begin OUT_MEASUREMENT xMotTorLim_ReductionLevel_xdu16 /end OUT_MEASUREMENT /end FUNCTION
/begin FUNCTION MotorTorqueLimiterI "limitation of the motor torque - interface" /begin OUT_MEASUREMENT mMotTorLimI_ValidatedMotorTorque_xds16 /end OUT_MEASUREMENT /end FUNCTION
/begin FUNCTION OpenInterfacesComponentI "OpenInterfacesComponentI"
 /begin OUT_MEASUREMENT tEpsInI_SCruiseCmftFadeOutTi_xdu16 yeeEsLearnStatLeft_xdu8 yeeEsLearnStatRight_xdu8 /end OUT_MEASUREMENT
/end FUNCTION
/begin FUNCTION ProductionServices_L_Adapter "Mess- und Applikationsgroessen ProductionServices_L_Adapter" /begin OUT_MEASUREMENT sApplI_SystemState_xdu8 /end OUT_MEASUREMENT /end FUNCTION
/begin FUNCTION RackPos_Sync_CalibControl "RackPosition Synchronization kgt for calibration control" /begin DEF_CHARACTERISTIC sRpSync_CalibControl_XDU8 /end DEF_CHARACTERISTIC /end FUNCTION
/begin FUNCTION RackPos_Sync_Interface "RackPosition Synchronization prototype kgt" /begin OUT_MEASUREMENT sRpSyncI_CalibAllowed_xdu8 /end OUT_MEASUREMENT /end FUNCTION
/begin FUNCTION RotorSpeed "Mess- und Applikationsgrößen RotorSpeed"
 /begin DEF_CHARACTERISTIC xRotSp_RotAccelerationLowFilterFact_XDU16 xRotSp_RotSpeedFilterFact_XDU16 /end DEF_CHARACTERISTIC
/end FUNCTION
/begin FUNCTION SCruiseActvJ "SCruiseActvJ"
 /begin DEF_CHARACTERISTIC mSCruise_ActvJMaxTrqVehSpd_XAU16 xSCruise_ActvJFacTrq_XAU16 xSCruise_ActvJFacVehSpd_XAU16 /end DEF_CHARACTERISTIC
 /begin IN_MEASUREMENT mSCruiseI_TorsBarTrq_xds16 vSCruiseI_AbsAvgVehSpd_xdu16 xSCruiseI_HandsOnFadrFac_xdu16 /end IN_MEASUREMENT
/end FUNCTION
/begin FUNCTION SCruiseActvJI "SCruiseActvJI" /begin OUT_MEASUREMENT mSCruiseI_NomActvJTrq_xds16 /end OUT_MEASUREMENT /end FUNCTION
/begin FUNCTION SCruiseController "SCruiseController" /begin IN_MEASUREMENT vSCruiseI_AbsAvgVehSpd_xdu16 /end IN_MEASUREMENT
 /begin OUT_MEASUREMENT mSCruise_DPart_xds16 mSCruise_IPart_xds16 mSCruise_PPart_xds16 mSCruise_TbtDeviation_xds16 /end OUT_MEASUREMENT
/end FUNCTION
/begin FUNCTION SCruiseControllerI "Smart Cruise Interface Controller - Interface" /begin OUT_MEASUREMENT mSCruiseI_MotTrq_xds16 /end OUT_MEASUREMENT /end FUNCTION
/begin FUNCTION SCruiseDampg "SCruiseDampg" /begin DEF_CHARACTERISTIC mSCruise_DampingTorque_XAU16 /end DEF_CHARACTERISTIC
 /begin IN_MEASUREMENT nSCruiseI_RotSpd_xds16 vSCruiseI_AbsAvgVehSpd_xdu16 xSCruiseI_HandsOnFadrFac_xdu16 /end IN_MEASUREMENT
/end FUNCTION
/begin FUNCTION SCruiseDampgI "SCruiseDampgI" /begin OUT_MEASUREMENT mSCruiseI_NomDampgTrq_xds16 /end OUT_MEASUREMENT /end FUNCTION
/begin FUNCTION SCruiseFader "SCruiseFader" /begin IN_MEASUREMENT vSCruiseI_AbsMaxSafeVehSpd_xdu16 /end IN_MEASUREMENT /end FUNCTION
/begin FUNCTION SCruiseFaderChk "Smart Cruise Fader Check" /begin OUT_MEASUREMENT fSCruiseFadr_MonSafeOk_xdb /end OUT_MEASUREMENT /end FUNCTION
/begin FUNCTION SCruiseFaderChkI "Smart Cruise Fader Check - Interface"
 /begin OUT_MEASUREMENT mSCruiseFadrI_MotTrq_xds16 sSCruiseFadrI_State_xdu8 xSCruiseFadrI_Prgs2SCI_xdu16 /end OUT_MEASUREMENT
/end FUNCTION
/begin FUNCTION SCruiseFaderDrvrIntvIndcn "SCruiseFaderDrvrIntvIndcn" /begin DEF_CHARACTERISTIC mSCruiseFadr_TrqThdEmgyEveIndcn_XAU16 /end DEF_CHARACTERISTIC /begin IN_MEASUREMENT vSCruiseI_AbsMaxSafeVehSpd_xdu16 /end IN_MEASUREMENT /end FUNCTION
/begin FUNCTION SCruiseFaderDrvrIntvIndcnI "SCruiseFaderDrvrIntvIndcnI" /begin OUT_MEASUREMENT fSCruiseFadrI_EmgyEveIndcn_xdb /end OUT_MEASUREMENT /end FUNCTION
/begin FUNCTION SCruiseFaderI "SCruiseFaderI" /begin OUT_MEASUREMENT sSCruiseFadrI_Reas_xdu8 /end OUT_MEASUREMENT /end FUNCTION
/begin FUNCTION SCruiseInpLimr "Smart Cruise Interface Limiter"
 /begin DEF_CHARACTERISTIC lSCruise_MaxNomRackPosn_XAU16 xSCruise_MaxRackSpdLimFact_XDU8 /end DEF_CHARACTERISTIC
 /begin IN_MEASUREMENT vSCruiseI_AbsAvgVehSpd_xdu16 /end IN_MEASUREMENT
 /begin OUT_MEASUREMENT vSCruise_NomRackSpd_xds32 /end OUT_MEASUREMENT
/end FUNCTION
/begin FUNCTION SCruiseInpLimrI "Smart Cruise Interface Limitation - Interface" /begin OUT_MEASUREMENT lSCruiseI_NomRackPosnLimd_xds32 /end OUT_MEASUREMENT /end FUNCTION
/begin FUNCTION SCruiseLimrCdng "SCruiseLimrCdng" /begin DEF_CHARACTERISTIC xSCruiseLimr_TbtGrdtFilFac_XDU16 /end DEF_CHARACTERISTIC /end FUNCTION
/begin FUNCTION SCruiseLimrCdngI "SCruiseLimrCdngI"
 /begin OUT_MEASUREMENT fSCruiseLimrI_ReqOff_xdb mSCruiseLimrI_GradTorsBarTrq_xds16 /end OUT_MEASUREMENT
/end FUNCTION
/begin FUNCTION SCruiseMaxRackSpd "SCruiseMaxRackSpd"
 /begin DEF_CHARACTERISTIC fSCruiseLimr_EnaDrvrIsIntractn4RackSpdLim_XDU8 fSCruiseLimr_EnaESS_XDU8 fSCruiseLimr_EnaExtReqESS_XDU8 fSCruiseLimr_OpnRackSpdLimAsym_XDB fScruiseLimr_DisableESSLimReset_XDU8 mSCruiseLimr_TbtDbnd4LoDrvr_XDU16 mSCruiseLimr_TbtDbndOpenLim_XAU16 mSCruiseLimr_TbtGradDbndCloseLim_XDU16 mSCruiseLimr_TbtGradDbnd_XAU16 mSCruiseLimr_TbtThdESS_XAU16 tSCruiseLimr_DetnDebESSHiDyn_XDU8 tSCruiseLimr_DetnDebESSThd_XDU8 tSCruiseLimr_LoDynPrecndnESS_XDU8 tSCruiseLimr_MaxDebExtReqESS_XDU8 tSCruiseLimr_MaxEnadESS_XDU8 tSCruiseLimr_MaxJImp_XDU8 tSCruiseLimr_MinJImp_XDU8 vSCruiseLimr_MaxRackSpdDrvrIsIntractn_XAU16 vSCruiseLimr_MaxRackSpdESS_XAU16 vSCruiseLimr_MaxRackSpdHandsFree_XAU16 vSCruiseLimr_MaxRackSpdHandsOnInc_XAU16 vSCruiseLimr_MaxRackSpdHandsOn_XAU16 vSCruiseLimr_MaxRackSpdPrkg_XAU16 vSCruiseLimr_MaxVehSpdESS_XDU8 vSCruiseLimr_MinVehSpdESS_XDU8 vSCruiseLimr_RackSpdThdESS_XAU16 xSCruiseLimr_AsymRackSpdLim_XAS16 xSCruiseLimr_MaxRackSpd4JImpFac_XDU8 xSCruiseLimr_MaxRackSpdOpenFac_XDU8 xSCruiseLimr_MaxRackSpdRedFac_XDU8 /end DEF_CHARACTERISTIC
 /begin IN_MEASUREMENT lApplI_RackPosition_xds16 vSCruiseI_AbsAvgVehSpd_xdu16 vSCruiseI_AbsMaxSafeVehSpd_xdu16 vSCruiseI_AbsMinSafeVehSpd_xdu16 /end IN_MEASUREMENT
 /begin OUT_MEASUREMENT fScruiseLimr_LoDrvrIntractn_xdu8 lSCruiseLimr_ReqdRackPosnLimd_xds32 sSCruiseLimr_StateESS_xdu8 xSCruiseLimr_DrvrIntractnCloseLim_xds8 xSCruiseLimr_DrvrIntractnOpenNegLim_xds8 xSCruiseLimr_DrvrIntractnOpenPosLim_xds8 zSCruiseLimr_CntrESS_xdu16 zSCruiseLimr_JImp_xds16 /end OUT_MEASUREMENT
/end FUNCTION
/begin FUNCTION SCruiseMaxRackSpdChkI "SCruiseMaxRackSpdChkI"
 /begin OUT_MEASUREMENT vSCruiseLimrI_NegRackSpdLim_xds16 vSCruiseLimrI_PosRackSpdLim_xds16 vSCruiseLimrI_RackSpdLim_xdu16 /end OUT_MEASUREMENT
/end FUNCTION
/begin FUNCTION SCruiseMaxRackSpdI "SCruiseMaxRackSpdI" /begin OUT_MEASUREMENT vSCruiseLimrI_RackSpdLim4Chk_xdu16 /end OUT_MEASUREMENT /end FUNCTION
/begin FUNCTION SCruiseNomDrvrTrqCalcn "SCruiseNomDrvrTrqCalcn"
 /begin DEF_CHARACTERISTIC mSCruise_SteerTorqueHandsFree_XAU16 mSCruise_SteerTorqueHandsOn_XAU16 /end DEF_CHARACTERISTIC
 /begin IN_MEASUREMENT lSCruiseI_RackPosn_xds16 vSCruiseI_AbsAvgVehSpd_xdu16 /end IN_MEASUREMENT
/end FUNCTION
/begin FUNCTION SCruiseNomDrvrTrqCalcnI "SCruiseNomDrvrTrqCalcn - interface" /begin OUT_MEASUREMENT lSCruiseI_RackPosnDelta_xds16 mSCruiseI_NomSteerTrq_xds16 /end OUT_MEASUREMENT /end FUNCTION
/begin FUNCTION SCruisePrimCtrlr "SCruisePrimCtrlr" /begin DEF_CHARACTERISTIC xSCruise_PPartRackSpdCtrlr_XAU16 /end DEF_CHARACTERISTIC
 /begin IN_MEASUREMENT lSCruiseI_RackPosnDelta_xds16 mSCruiseI_TorsBarTrq_xds16 vSCruiseI_AbsAvgVehSpd_xdu16 /end IN_MEASUREMENT
/end FUNCTION
/begin FUNCTION SCruisePrimCtrlrI "SCruisePrimCtrlrI" /begin OUT_MEASUREMENT mSCruiseI_NomPrimCtrlrTrq_xds16 /end OUT_MEASUREMENT /end FUNCTION
/begin FUNCTION SCruiseRackPosnFdFwdI "SCruiseRackPosnFdFwd - interface" /begin OUT_MEASUREMENT lSCruiseI_NomRackPosn_xds32 /end OUT_MEASUREMENT /end FUNCTION
/begin FUNCTION SCruiseRackSpdLimr "SCruiseRackSpdLimr" /begin IN_MEASUREMENT vSCruiseI_AbsMaxSafeVehSpd_xdu16 /end IN_MEASUREMENT /begin OUT_MEASUREMENT mSCruiseLimr_RackSpdCtrlrTrq_xds16 /end OUT_MEASUREMENT /end FUNCTION
/begin FUNCTION SCruiseRackSpdLimrChk "SCruiseRackSpdLimrChk" /begin DEF_CHARACTERISTIC mSCruiseLimr_MaxMotTrqHandsFree_XAU16 /end DEF_CHARACTERISTIC /begin IN_MEASUREMENT vSCruiseI_AbsMaxSafeVehSpd_xdu16 /end IN_MEASUREMENT /end FUNCTION
/begin FUNCTION SCruiseRackSpdLimrChkI "SCruiseRackSpdLimrChkI"
 /begin OUT_MEASUREMENT fSCruiseLimrI_MonSafeOk_xdb mSCruiseLimrI_MotTrq_xds16 sSCruiseLimrI_State_xdu8 /end OUT_MEASUREMENT
/end FUNCTION
/begin FUNCTION SCruiseSigPrcrCdng "SCruiseSigPrcrCdng"
 /begin DEF_CHARACTERISTIC lSCruise_SubRackPosn_XDS16 sSCruise_SubState_XDU8 xSCruise_MinRedLvlHandsFree_XDU8 /end DEF_CHARACTERISTIC
 /begin IN_MEASUREMENT vSCruiseI_AbsMaxSafeVehSpd_xdu16 /end IN_MEASUREMENT
/end FUNCTION
/begin FUNCTION SCruiseSigPrcrCdngI "SCruiseSigPrcrCdngI"
 /begin OUT_MEASUREMENT fSCruiseI_SigPrcrReqOff_xdu8 lSCruiseI_RackPosn_xds16 lSCruiseI_ReqdRackPosn_xds32 sSCruiseI_CnclCdn_xdu16 sSCruiseI_ReqdState_xdu8 vSCruiseI_AbsAvgVehSpd_xdu16 vSCruiseI_AbsMaxSafeVehSpd_xdu16 vSCruiseI_AbsMinSafeVehSpd_xdu16 /end OUT_MEASUREMENT
/end FUNCTION
/begin FUNCTION SCruiseState "Smart Cruise Interface Statemachine" /begin DEF_CHARACTERISTIC fSCruise_Enable_XDU8 xSCruise_HandsOnRampGrdt_XDU16 /end DEF_CHARACTERISTIC /end FUNCTION
/begin FUNCTION SCruiseStateI "Smart Cruise Interface Statemachine"
 /begin OUT_MEASUREMENT sSCruiseI_Mod_xdu8 sSCruiseI_State_xdu8 xSCruiseI_HandsOnFadrFac_xdu16 /end OUT_MEASUREMENT
/end FUNCTION
/begin RECORD_LAYOUT AblGLKFsw AXIS_PTS_X 1 SWORD INDEX_INCR DIRECT AXIS_PTS_Y 2 SWORD INDEX_INCR DIRECT FNC_VALUES 3 SWORD COLUMN_DIR DIRECT /end RECORD_LAYOUT
/begin RECORD_LAYOUT AblGLKFuw AXIS_PTS_X 1 UWORD INDEX_INCR DIRECT AXIS_PTS_Y 2 UWORD INDEX_INCR DIRECT FNC_VALUES 3 UWORD COLUMN_DIR DIRECT /end RECORD_LAYOUT
/begin RECORD_LAYOUT AblGLKLsw NO_AXIS_PTS_X 1 UWORD AXIS_PTS_X 2 SWORD INDEX_INCR DIRECT FNC_VALUES 3 SWORD COLUMN_DIR DIRECT /end RECORD_LAYOUT
/begin RECORD_LAYOUT AblGLKLuw NO_AXIS_PTS_X 1 UWORD AXIS_PTS_X 2 UWORD INDEX_INCR DIRECT FNC_VALUES 3 UWORD COLUMN_DIR DIRECT /end RECORD_LAYOUT
/begin RECORD_LAYOUT AblGLKWBsw FNC_VALUES 1 SWORD COLUMN_DIR DIRECT /end RECORD_LAYOUT
/begin RECORD_LAYOUT AblGLKWBub FNC_VALUES 1 UBYTE COLUMN_DIR DIRECT /end RECORD_LAYOUT
/begin RECORD_LAYOUT AblGLKWBuw FNC_VALUES 1 UWORD COLUMN_DIR DIRECT /end RECORD_LAYOUT
/begin RECORD_LAYOUT AblGLKWfl4 FNC_VALUES 1 FLOAT32_IEEE COLUMN_DIR DIRECT /end RECORD_LAYOUT
/begin RECORD_LAYOUT AblGLKWsw FNC_VALUES 1 SWORD COLUMN_DIR DIRECT /end RECORD_LAYOUT
/begin RECORD_LAYOUT AblGLKWub FNC_VALUES 1 UBYTE COLUMN_DIR DIRECT /end RECORD_LAYOUT
/begin RECORD_LAYOUT AblGLKWuw FNC_VALUES 1 UWORD COLUMN_DIR DIRECT /end RECORD_LAYOUT
/begin RECORD_LAYOUT AblGLSstuw AXIS_PTS_X 1 UWORD INDEX_INCR DIRECT /end RECORD_LAYOUT
/*********** End of merged COMPU_TAB blocks ***********/ /*********** Start of merged COMPU_VTAB blocks ***********/
/begin COMPU_VTAB AOC_FEATURES "" TAB_VERB 16 0 "PDC" 1 "PDC_Estimator" 2 "ANC" 3 "EAC" 4 "LXA" 5 "LDW" 6 "TSC" 7 "TSC_Estimator" 8 "DSR" 9 "DSR_Estimator" 10 "tbd_1" 11 "tbd_1_Estimator" 12 "tbd_2" 13 "tbd_2_Estimator" 14 "tbd_3" 15 "tbd_3_Estimator" DEFAULT_VALUE "undefined" /end COMPU_VTAB
/begin COMPU_VTAB AOC_FEAT_STATE "" TAB_VERB 6 0 "StatePassive" 1 "StateReqForActivation" 2 "StateRampIn" 3 "StateActive" 4 "StateRampOut" 5 "StateLocked" DEFAULT_VALUE "undefined" /end COMPU_VTAB
/begin COMPU_VTAB AUTOSAR_RTE_CompuMethods_RTE_Std_ReturnType_Enum_Values "Enum values for RTE_Std_ReturnType" TAB_VERB 34 0 "RTE_E_OK" 1 "RTE_E_INVALID" 64 "RTE_E_OK | RTE_E_MAX_AGE_EXCEEDED" 65 "RTE_E_INVALID | RTE_E_MAX_AGE_EXCEEDED" 128 "RTE_E_COM_STOPPED" 129 "RTE_E_TIMEOUT" 130 "RTE_E_LIMIT" 131 "RTE_E_NO_DATA" 132 "RTE_E_TRANSMIT_ACK" 133 "RTE_E_NEVER_RECEIVED" 134 "RTE_E_UNCONNECTED" 135 "RTE_E_IN_EXCLUSIVE_AREA" 136 "RTE_E_SEG_FAULT" 137 "RTE_E_OUT_OF_RANGE" 138 "RTE_E_SERIALIZATION_ERROR" 139 "RTE_E_SERIALIZATION_LIMIT" 140 "RTE_E_SOFT_TRANSFORMER_ERROR" 141 "RTE_E_COM_BUSY" 142 "RTE_E_RAM_UNCHANGED" 192 "RTE_E_COM_STOPPED | RTE_E_MAX_AGE_EXCEEDED" 193 "RTE_E_TIMEOUT | RTE_E_MAX_AGE_EXCEEDED" 194 "RTE_E_LIMIT | RTE_E_MAX_AGE_EXCEEDED" 195 "RTE_E_NO_DATA | RTE_E_MAX_AGE_EXCEEDED" 196 "RTE_E_TRANSMIT_ACK | RTE_E_MAX_AGE_EXCEEDED" 197 "RTE_E_NEVER_RECEIVED | RTE_E_MAX_AGE_EXCEEDED" 198 "RTE_E_UNCONNECTED | RTE_E_MAX_AGE_EXCEEDED" 199 "RTE_E_IN_EXCLUSIVE_AREA | RTE_E_MAX_AGE_EXCEEDED" 200 "RTE_E_SEG_FAULT | RTE_E_MAX_AGE_EXCEEDED" 201 "RTE_E_OUT_OF_RANGE | RTE_E_MAX_AGE_EXCEEDED" 202 "RTE_E_SERIALIZATION_ERROR | RTE_E_MAX_AGE_EXCEEDED" 203 "RTE_E_SERIALIZATION_LIMIT | RTE_E_MAX_AGE_EXCEEDED" 204 "RTE_E_SOFT_TRANSFORMER_ERROR | RTE_E_MAX_AGE_EXCEEDED" 205 "RTE_E_COM_BUSY | RTE_E_MAX_AGE_EXCEEDED" 206 "RTE_E_RAM_UNCHANGED | RTE_E_MAX_AGE_EXCEEDED" /end COMPU_VTAB
/begin COMPU_VTAB ECU_STATE "" TAB_VERB 9 0 "undefined" 1 "EcuInit" 2 "ApplicationInit" 3 "Normal" 4 "Production" 5 "FailOp" 6 "PostRun" 7 "Error" 8 "ApplicationOff" /end COMPU_VTAB
/begin COMPU_VTAB SCRUISE_DYNLIM_STATUS "" TAB_VERB 5 0 "NotLimited" 1 "PositiveLimited" 2 "NegativeLimited" 3 "Error" 255 "SNA" DEFAULT_VALUE "undefined" /end COMPU_VTAB
/begin COMPU_VTAB SCRUISE_FADR_STATE "" TAB_VERB 8 0 "SFC" 1 "SCI" 2 "SFC2SCI" 3 "SCI2SFC" 4 "EMGY" 5 "SCI2SFCPND" 6 "REPLCMT" 7 "ERR" DEFAULT_VALUE "undefined" /end COMPU_VTAB
/begin COMPU_VTAB SCRUISE_REQD_STATE "" TAB_VERB 6 0 "Inactv" 1 "HandsOn" 2 "HandsFree" 3 "Prkg" 4 "HandsOnInc" 255 "SNA" DEFAULT_VALUE "undefined" /end COMPU_VTAB
/begin COMPU_VTAB SCRUISE_STATE "" TAB_VERB 8 0 "Inin" 1 "NotAvl" 2 "Avl" 3 "FctCoReq" 4 "FadeIn" 5 "Actv" 6 "FadeOut" 255 "SNA" DEFAULT_VALUE "undefined" /end COMPU_VTAB
/begin COMPU_VTAB SCRUISE_STATE_ESS "" TAB_VERB 6 0 "Inactv" 1 "LoDynDetd" 2 "IncDynDet" 3 "HiDynDet" 4 "ChkExtReq" 5 "ESSActvt" DEFAULT_VALUE "undefined" /end COMPU_VTAB
/begin COMPU_VTAB SYSTEM_STATE "" TAB_VERB 12 0 "undefined" 1 "NMWait" 2 "KL30Wait" 3 "PreDrive" 4 "DriveDown" 5 "DriveUp" 6 "PostRun" 7 "Off" 8 "Error" 9 "Flash" 10 "LowVolt" 11 "LimpHome" DEFAULT_VALUE "undefined" /end COMPU_VTAB
/*********** End of merged COMPU_VTAB blocks ***********/
/end MODULE
/end PROJECT
