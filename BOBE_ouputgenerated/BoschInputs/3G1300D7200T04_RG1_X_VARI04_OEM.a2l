ASAP2_VERSION 1 70
/begin PROJECT _3G1_300 "varI04"
/begin HEADER "" VERSION "3G1_300_D_72_00_T04" PROJECT_NO _3G1_300 /end HEADER
/begin MODULE XCP_EPS_ECU "100FIT"
/begin MOD_COMMON "" BYTE_ORDER MSB_LAST ALIGNMENT_BYTE 1 ALIGNMENT_WORD 2 ALIGNMENT_LONG 4 ALIGNMENT_FLOAT32_IEEE 4 ALIGNMENT_FLOAT64_IEEE 8 /end MOD_COMMON
/*********** Start of merged CHARACTERISTIC blocks ***********/
/begin CHARACTERISTIC BSW_NO_CUTIN_TIMELIM_AU16 "Time-out zeit bis Fehler gesetzt wird wegen nicht einrampen aufgrund Spannung - mapped tAssCtrl_TenSecUnderVoltTimer_Timeout_XDU16" VALUE 0x6202 AblGLKWuw 60 TIMSEC_1000 0 60 FORMAT "%8.5" SYMBOL_LINK "tAssCtrl_TenSecUnderVoltTimer_Timeout_XDU16" 0 /end CHARACTERISTIC
/begin CHARACTERISTIC BSW_PHI_MAX_FZG_AI16 "max. Lenkhub bezogen auf kalibrierten LWS[mm] - mapped lEndStop_MaxSteerRange_XDU16" VALUE 0x610E AblGLKWuw 800 MM2HUB 0 1024 FORMAT "%8.4" SYMBOL_LINK "lEndStop_MaxSteerRange_XDU16" 0 /end CHARACTERISTIC
/begin CHARACTERISTIC BSW_SWS_KRUEMMUNG_FAS01_AU8 "Wechselt zwischen den Signalen PLA_QFK_KrSoll und PLA_QFK_KruemmSoll - mapped fEpsInI_PLA_QFK_Kruemmung_Fas01_XDU8" VALUE 0x63CC AblGLKWub 0 ZU0 0 1 SYMBOL_LINK "fEpsInI_PLA_QFK_Kruemmung_Fas01_XDU8" 0 /end CHARACTERISTIC
/begin CHARACTERISTIC BSW_SWS_KRUEMMUNG_FAS02_AU8 "Wechselt zwischen den Signalen AWV_QFK_KrSoll und AWV_QFK_KruemmSoll - mapped fEpsInI_AWV_QFK_Kruemmung_Fas02_XDU8" VALUE 0x63C9 AblGLKWub 0 ZU0 0 1 SYMBOL_LINK "fEpsInI_AWV_QFK_Kruemmung_Fas02_XDU8" 0 /end CHARACTERISTIC
/begin CHARACTERISTIC BSW_SWS_KRUEMMUNG_FAS03_AU8 "Wechselt zwischen den Signalen HCA_QFK_KrSoll und HCA_QFK_KruemmSoll - mapped fEpsInI_HCA_QFK_Kruemmung_Fas03_XDU8" VALUE 0x63CB AblGLKWub 0 ZU0 0 1 SYMBOL_LINK "fEpsInI_HCA_QFK_Kruemmung_Fas03_XDU8" 0 /end CHARACTERISTIC
/begin CHARACTERISTIC BSW_SWS_KRUEMMUNG_FAS04_AU8 "Wechselt zwischen den Signalen DSR_QFK_KrSoll und DSR_QFK_KruemmSoll - mapped fEpsInI_DSR_QFK_Kruemmung_Fas04_XDU8" VALUE 0x63CA AblGLKWub 0 ZU0 0 1 SYMBOL_LINK "fEpsInI_DSR_QFK_Kruemmung_Fas04_XDU8" 0 /end CHARACTERISTIC
/begin CHARACTERISTIC BSW_SWS_KRUEMMUNG_FAS05_AU8 "Wechselt zwischen den Signalen RHP_QFK_KrSoll und RHP_QFK_KruemmSoll - mapped fEpsInI_RHP_QFK_Kruemmung_Fas05_XDU8" VALUE 0x63CD AblGLKWub 0 ZU0 0 1 SYMBOL_LINK "fEpsInI_RHP_QFK_Kruemmung_Fas05_XDU8" 0 /end CHARACTERISTIC
/begin CHARACTERISTIC BSW_TRQ_MAXMOTOR_AU8 "Maximales Moment das der Motor stellen koennen darf. Hier ber kann der Motor der Mechanik angepasst werden - mapped mHwlWrapI_MaxMechAllowedTorque_XDF32" VALUE 0x6020 AblGLKWfl4 20 ZU0 1 20 SYMBOL_LINK "mHwlWrapI_MaxMechAllowedTorque_XDF32" 0 /end CHARACTERISTIC
/begin CHARACTERISTIC BSW_ULEIST_HIGH_LIM_AU16 "Obere Unterstuetzungsschwelle (Default 60%) fuer Fehlerhandling - mapped xLowVoltAssRed_AssistUpperLimit_XDU16" VALUE 0x8074 AblGLKWuw 1 RED_FACT 0 1 FORMAT "%8.4" SYMBOL_LINK "xLowVoltAssRed_AssistUpperLimit_XDU16" 0 /end CHARACTERISTIC
/begin CHARACTERISTIC BSW_ULEIST_HIGH_LIM_TIMELIM_AU16 "Entprellzeit Aktivierung UHigh_Error wenn Unterstuetzung zwischen BSW_ULEIST_LOW_LIM_AU16 und BSW_ULEIST_HIGH_LIM_AU16 liegt - mapped tLowVoltAssRed_UnderVoltageErrorFilterTimeHIGH_XDU16" VALUE 0x8028 AblGLKWuw 0 TIMMS 0 65000 SYMBOL_LINK "tLowVoltAssRed_UnderVoltageErrorFilterTimeHIGH_XDU16" 0 /end CHARACTERISTIC
/begin CHARACTERISTIC BSW_ULEIST_HIGH_TIMELIM_AU16 "Entprellzeit Aktivierung UHigh_Error wenn Unterstuetzung zwischen 20% und 60% liegt (Default) - mapped tLowVoltAssRed_UnderVoltageErrorFilterTimeHIGH_XDU16" VALUE 0x8028 AblGLKWuw 0 TIMMS 0 10000 FORMAT "%8.2" SYMBOL_LINK "tLowVoltAssRed_UnderVoltageErrorFilterTimeHIGH_XDU16" 0 /end CHARACTERISTIC
/begin CHARACTERISTIC BSW_ULEIST_LOW_LIM_AU16 "Untere Unterstuetzungsschwelle (Default 20%) fuer Fehlerhandling - mapped xLowVoltAssRed_AssistLowerLimit_XDU16" VALUE 0x80CC10 AblGLKWuw 0 RED_FACT 0 1 SYMBOL_LINK "xLowVoltAssRed_AssistLowerLimit_XDU16" 0 /end CHARACTERISTIC
/begin CHARACTERISTIC BSW_ULEIST_LOW_LIM_TIMELIM_AU16 "Entprellzeit Aktivierung ULow_Error wenn Unterstuetzung unter BSW_ULEIST_LOW_LIM_AU16 faellt - mapped tLowVoltAssRed_UnderVoltageErrorFilterTimeLOW_XDU16" VALUE 0x802A AblGLKWuw 0 TIMMS 0 65000 SYMBOL_LINK "tLowVoltAssRed_UnderVoltageErrorFilterTimeLOW_XDU16" 0 /end CHARACTERISTIC
/begin CHARACTERISTIC BSW_ULEIST_LOW_TIMELIM_AU16 "Entprellzeit Aktivierung ULow_Error wenn Unterstuetzung unter 20% faellt (Default) - mapped tLowVoltAssRed_UnderVoltageErrorFilterTimeLOW_XDU16" VALUE 0x802A AblGLKWuw 0 TIMMS 0 10000 FORMAT "%8.2" SYMBOL_LINK "tLowVoltAssRed_UnderVoltageErrorFilterTimeLOW_XDU16" 0 /end CHARACTERISTIC
/begin CHARACTERISTIC CHA_FAC_GRAD_TRANSITION_AU16 "Gradient zum Kennlinien ueberblenden - mapped xCharHdl_FadingGradient_XDU16" VALUE 0x62E2 AblGLKWuw 0.998047 GRAD_10MS 0.001953125 1 FORMAT "%8.6" SYMBOL_LINK "xCharHdl_FadingGradient_XDU16" 0 /end CHARACTERISTIC
/begin CHARACTERISTIC CHA_FAC_RET_AU8 "Entscheidungsschwelle zur alten oder zur neuen Kennlinie faden - mapped xCharHdl_FadingDirectionBorder_XDU16" VALUE 0x62E0 AblGLKWuw 1 RIGHTSH13NP 0 1 SYMBOL_LINK "xCharHdl_FadingDirectionBorder_XDU16" 0 /end CHARACTERISTIC
/begin CHARACTERISTIC DIA_STWARNUNGEID_AU8 "Kurzbeschreibung: [Aktivierungsstatus von Entwicklungsnachrichten]" VALUE 0x80CC33 AblGLKWub 0 ZU0 0 1 SYMBOL_LINK "yCustomerDataSupp_DevWarningsActive_XDU8" 0 /end CHARACTERISTIC
/begin CHARACTERISTIC EAF_FRQ_VFZGFILTER_KOEFF_AU16 "Filterfaktor fuer Fahrzeuggeschwindigkeit - mapped xEndStop_VehSpeedFiltFact_XDU16" VALUE 0x806E AblGLKWuw 100 FAC2FRQ 0.1 100 SYMBOL_LINK "xEndStop_VehSpeedFiltFact_XDU16" 0 /end CHARACTERISTIC
/begin CHARACTERISTIC EAF_PHI_EAF_PHIOFFSET_KLU16 "Dynamische Hubreduzierung abhaengig VFZ - mapped lEndStop_VehicleSpeedDepOffset_XAU16" CURVE 0x82A8 AblGLKLuw 1024 MM2HUB 0 1024 SYMBOL_LINK "lEndStop_VehicleSpeedDepOffset_XAU16" 0
 /begin AXIS_DESCR STD_AXIS eaf_vFzgHystFilt_mi16 VFZHIGH 5 0 327 FORMAT "%8.4" AXIS_PTS_REF EAF_V_FZG_EAF_PHIOFFSET_XI16 DEPOSIT ABSOLUTE /end AXIS_DESCR
/end CHARACTERISTIC
/begin CHARACTERISTIC EAF_PHV_BEGR_DYNEA_IN_AI16 "maximaler steigender Gradient fuer EndStop Verschiebung [degree/s] - mapped vEndStop_MaxEndStopOffsetGradRising_XDU16" VALUE 0x803C AblGLKWuw 1024 GRMM2HUB 0 1024 SYMBOL_LINK "vEndStop_MaxEndStopOffsetGradRising_XDU16" 0 /end CHARACTERISTIC
/begin CHARACTERISTIC EAF_PHV_BEGR_DYNEA_OUT_AI16 "maximaler fallender Gradient fuer EndStop Verschiebung [degree/s] - mapped vEndStop_MaxEndStopOffsetGradFalling_XDU16" VALUE 0x803A AblGLKWuw 1024 GRMM2HUB 0 1024 SYMBOL_LINK "vEndStop_MaxEndStopOffsetGradFalling_XDU16" 0 /end CHARACTERISTIC
/begin CHARACTERISTIC EAF_SWS_DYN_ANSCHLAG_AU8 "Dynamische Hubreduzierung abhaengig VFZ aktivieren - mapped fEndStop_EnableDynamicEndStop_XDU8" VALUE 0x80A5 AblGLKWub 1 ZU0 0 1 SYMBOL_LINK "fEndStop_EnableDynamicEndStop_XDU8" 0 /end CHARACTERISTIC
/begin CHARACTERISTIC EAF_SWS_VFZGFILTER_AU8 "function switch: 1 = Fahrzeuggeschwindigkeit aufbereiten an; 0 = ausschalten - mapped fEndStop_EnableVehSpeedFiltering_XDU8" VALUE 0x80A7 AblGLKWub 1 ZU0 0 1 SYMBOL_LINK "fEndStop_EnableVehSpeedFiltering_XDU8" 0 /end CHARACTERISTIC
/begin CHARACTERISTIC EAF_V_FZG_HYSTERESEBREITE_AI16 "Hysterebreite fuer Fahrzeuggeschwindigkeit - mapped vEndStop_HysteresisRange_XDU16" VALUE 0x6288 AblGLKWuw 327 VFZHIGH 0 327 SYMBOL_LINK "vEndStop_HysteresisRange_XDU16" 0 /end CHARACTERISTIC
/begin CHARACTERISTIC EPS_DQ_MRAMPE_EIN_MOTDREHZAHL_AU16 "Einschaltrampe Motorsollmoment bzgl. Motordrehzahl - mapped yAssCtrl_VehicleNotRunningGradient_XDU16" VALUE 0x6388 AblGLKWuw 0 RIGHTSH15NP_GRAD1S 0 65535 SYMBOL_LINK "yAssCtrl_VehicleNotRunningGradient_XDU16" 0 /end CHARACTERISTIC
/begin CHARACTERISTIC EPS_DQ_MRAMPE_EIN_VFZG_AU16 "Einschaltrampe Motorsollmoment bzgl. Fahrzeuggeschwindigkeit - mapped yAssCtrl_VehicleRunningGradient_XDU16" VALUE 0x638A AblGLKWuw 0 RIGHTSH15NP_GRAD1S 0 65535 SYMBOL_LINK "yAssCtrl_VehicleRunningGradient_XDU16" 0 /end CHARACTERISTIC
/begin CHARACTERISTIC EPS_DQ_RAMP_DOWN_MIN_AUTO_AU16 "Minimale Ramprate bei automatischer Motorabschaltung - mapped yAssCtrl_MinRampDownGradientAuto_XDU16" VALUE 0x60AC AblGLKWul 0 RIGHTSH15NP 9.1552734375e-005 0.00201416015625 FORMAT "%16.14" SYMBOL_LINK "yAssCtrl_MinRampDownGradientAuto_XDU16" 0 /end CHARACTERISTIC
/begin CHARACTERISTIC EPS_DQ_RAMP_DOWN_MIN_DRIVER_AU16 "Minimale Ramprate bei fahrerinitiiertem Eintreten der Ausschaltbedingungen - mapped yAssCtrl_MinRampDownGradientDriver_XDU16" VALUE 0x60B0 AblGLKWul 0 RIGHTSH15NP 9.1552734375e-005 0.00201416015625 FORMAT "%16.14" SYMBOL_LINK "yAssCtrl_MinRampDownGradientDriver_XDU16" 0 /end CHARACTERISTIC
/begin CHARACTERISTIC EPS_DT_RAMP_DOWN_AUTO_AU16 "Rampdauer Reduzierung Lenkunterstuetzung bei automatischer Motorabschaltung - mapped tAssCtrl_RampDownAuto_XDU16" VALUE 0x602C AblGLKWul 0 TIMSEC_1000 0 65.535 FORMAT "%13.10" SYMBOL_LINK "tAssCtrl_RampDownAuto_XDU16" 0 /end CHARACTERISTIC
/begin CHARACTERISTIC EPS_DT_RAMP_DOWN_DRIVER_AU16 "Rampdauer Reduzierung Lenkunterstuetzung bei fahrerinitiiertem Eintreten der Ausschaltbedingungen - mapped tAssCtrl_RampDownDriver_XDU16" VALUE 0x6030 AblGLKWul 0 TIMSEC_1000 0 65.535 FORMAT "%13.10" SYMBOL_LINK "tAssCtrl_RampDownDriver_XDU16" 0 /end CHARACTERISTIC
/begin CHARACTERISTIC EPS_N_MOT_DREHZAHL_AUS_AU16 "Motordrehzahl fuer den Wechsel aus dem Status EngineRunning oder EngineRunningStable in den Status EngineNotRunning - mapped nEngRn_EngineNotRunning_XDU16" VALUE 0x800E AblGLKWBuw 0 VENG 0 16383 FORMAT "%8.2" SYMBOL_LINK "nEngRn_EngineNotRunning_XDU16" 0 /end CHARACTERISTIC
/begin CHARACTERISTIC EPS_N_MOT_DREHZAHL_EIN_AU16 "Motordrehzahl fuer den Wechsel aus dem Status EngineNotRunning in den Status EngineRunning oder EngineRunningStable - mapped nEngRn_EngineRunning_XDU16" VALUE 0x8010 AblGLKWBuw 0 VENG 0 16383 SYMBOL_LINK "nEngRn_EngineRunning_XDU16" 0 /end CHARACTERISTIC
/begin CHARACTERISTIC EPS_PHV_LENKBEWEGUNG_LIMIT_AU16 "Lenkradgeschwindigkeitsschwelle Erkennung der Lenkbewegungen in CutOffWait - mapped yAssCtrl_EPS_PHV_LENKBEWEGUNG_LIMIT_XDU16" VALUE 0x60A8 AblGLKWul 0 SAS_8 0 180 FORMAT "%13.9" SYMBOL_LINK "yAssCtrl_EPS_PHV_LENKBEWEGUNG_LIMIT_XDU16" 0 /end CHARACTERISTIC
/begin CHARACTERISTIC EPS_TMR_CUTOFF_WAIT_AUTO_AU16 "Time-out Zeit fuer CutOffWait - mapped tAssCtrl_CutOffWait_TimeOut_XAU16" VALUE 0x602A AblGLKWuw 0 TIMSEC_1000 0 65535 FORMAT "%13.10" SYMBOL_LINK "tAssCtrl_CutOffWait_TimeOut_XAU16" 2 /end CHARACTERISTIC
/begin CHARACTERISTIC EPS_TMR_CUTOFF_WAIT_DRIVER_AU16 "Time-out Zeit fuer CutOffWait - mapped tAssCtrl_CutOffWait_TimeOut_XAU16" VALUE 0x6028 AblGLKWuw 0 TIMSEC_1000 0 65535 FORMAT "%13.10" SYMBOL_LINK "tAssCtrl_CutOffWait_TimeOut_XAU16" 0 /end CHARACTERISTIC
/begin CHARACTERISTIC EPS_TMR_LENKBEWEGUNG_AU16 "Time-out Zeit fuer FailSafeTimer - mapped tAssCtrl_StVFzg_FailSafeTimer_TimeOut_XDU16" VALUE 0x6200 AblGLKWuw 0 TIMS 0 3600 FORMAT "%6.1" SYMBOL_LINK "tAssCtrl_StVFzg_FailSafeTimer_TimeOut_XDU16" 0 /end CHARACTERISTIC
/begin CHARACTERISTIC EPS_U_BATSPANNUNG_EIN_AU16 "Minimalwert Spannung zum Einrampen der U-Leistung - mapped uAssCtrl_MinRampInBatteryVoltage_XDU16" VALUE 0x6258 AblGLKWuw 0 U64V 0 40 SYMBOL_LINK "uAssCtrl_MinRampInBatteryVoltage_XDU16" 0 /end CHARACTERISTIC
/begin CHARACTERISTIC EPS_V_FZG_AUS_AU16 "Grenzwert fuer Fahrzeug-Faehrt-Erkennung - mapped vAssCtrl_VehicleSpeedRampDown_XDU16" VALUE 0x626A AblGLKWuw 0 VFZHIGH 0 512 FORMAT "%8.4" SYMBOL_LINK "vAssCtrl_VehicleSpeedRampDown_XDU16" 0 /end CHARACTERISTIC
/begin CHARACTERISTIC EPS_V_FZG_EIN_AU16 "Grenzwert fuer Fahrzeug-Faehrt-Erkennung - mapped vAssCtrl_VehicleSpeedRampUp_XDU16" VALUE 0x626E AblGLKWuw 0 VFZHIGH 0 512 FORMAT "%8.4" SYMBOL_LINK "vAssCtrl_VehicleSpeedRampUp_XDU16" 0 /end CHARACTERISTIC
/begin CHARACTERISTIC EPS_V_FZG_RAMPRATE_AU16 "Geschwindigkeitsschwelle, bei der die Einramprate geaendert wird - mapped vAssCtrl_VehicleSpeedRampInThreshold_XDU16" VALUE 0x626C AblGLKWuw 512 VFZHIGH 0 512 SYMBOL_LINK "vAssCtrl_VehicleSpeedRampInThreshold_XDU16" 0 /end CHARACTERISTIC
/begin CHARACTERISTIC FGA_A_VGRADIENT_CU16 "Parameter fuer den Gradienten auf den die Fahrzeuggeschwindigkeit begrenzt wird - mapped vVehSp_MaxVehicleSpeedGradient_XDU8" VALUE 0x80CC2F AblGLKWub 0 VGRD_10MS_1S 0 398 FORMAT "%6.4" SYMBOL_LINK "vVehSp_MaxVehicleSpeedGradient_XDU8" 0 /end CHARACTERISTIC
/begin CHARACTERISTIC FGA_V_ERSATZ_CU16 "Parameter fuer den Ersatzwert der Fahrzeuggeschwindigkeit - mapped vVehSp_SubstituteSpeed_XDU16" VALUE 0x80CBE6 AblGLKWuw 50 VFZHIGH 0 511 SYMBOL_LINK "vVehSp_SubstituteSpeed_XDU16" 0 /end CHARACTERISTIC
/begin CHARACTERISTIC FGA_V_INIT_AU16 "Parameter fuer den Initialwert der Fahrzeuggeschwindigkeit - mapped vVehSp_AbsVehSpeedFiltInit_XDU16" VALUE 0x80CBDC AblGLKWuw 511 VFZHIGH 0 511 SYMBOL_LINK "vVehSp_AbsVehSpeedFiltInit_XDU16" 0 /end CHARACTERISTIC
/begin CHARACTERISTIC LKU_FAC_KLV_AUTO_AI16 "Charisma Auto: Faktorisierung der Assist-Kennlinien in y-Richtung (Motormoment) - mapped xBci_AssistPostscaleFactorAuto_XDU16" VALUE 0x804C AblGLKWuw 1 RIGHTSH13NP 0.5 1.5 SYMBOL_LINK "xBci_AssistPostscaleFactorAuto_XDU16" 0 /end CHARACTERISTIC
/begin CHARACTERISTIC LKU_FAC_KLV_DYN_AI16 "Charisma Dynamic: Faktorisierung der Assist-Kennlinien in y-Richtung (Motormoment) - mapped xBci_AssistPostscaleFactorDyn_XDU16" VALUE 0x804E AblGLKWuw 1 RIGHTSH13NP 0.5 1.5 SYMBOL_LINK "xBci_AssistPostscaleFactorDyn_XDU16" 0 /end CHARACTERISTIC
/begin CHARACTERISTIC LKU_FAC_KLV_KOM_AI16 "Charisma Komfort: Faktorisierung der Assist-Kennlinien in y-Richtung (Motormoment) - mapped xBci_AssistPostscaleFactorKomf_XDU16" VALUE 0x8050 AblGLKWuw 1 RIGHTSH13NP 0.5 1.5 SYMBOL_LINK "xBci_AssistPostscaleFactorKomf_XDU16" 0 /end CHARACTERISTIC
/begin CHARACTERISTIC LKU_FAC_TRQ_AUTO_AI16 "Charisma Auto: Faktorisierung der Assist-Kennlinien in X-Richtung (Drehstabmoment) - mapped xBci_AssistPrescaleFactorAuto_XDU16" VALUE 0x8052 AblGLKWuw 1 RIGHTSH13NP 0.5 1.5 SYMBOL_LINK "xBci_AssistPrescaleFactorAuto_XDU16" 0 /end CHARACTERISTIC
/begin CHARACTERISTIC LKU_FAC_TRQ_DYN_AI16 "Charisma Dynamik: Faktorisierung der Assist-Kennlinien in X-Richtung (Drehstabmoment) - mapped xBci_AssistPrescaleFactorDyn_XDU16" VALUE 0x8054 AblGLKWuw 1 RIGHTSH13NP 0.5 1.5 SYMBOL_LINK "xBci_AssistPrescaleFactorDyn_XDU16" 0 /end CHARACTERISTIC
/begin CHARACTERISTIC LKU_FAC_TRQ_KOM_AI16 "Charisma Komfort: Faktorisierung der Assist-Kennlinien in X-Richtung (Drehstabmoment) - mapped xBci_AssistPrescaleFactorKomf_XDU16" VALUE 0x8056 AblGLKWuw 1 RIGHTSH13NP 0.5 1.5 SYMBOL_LINK "xBci_AssistPrescaleFactorKomf_XDU16" 0 /end CHARACTERISTIC
/begin CHARACTERISTIC LKU_F_LOOKUP_V1_AUTO_KLU16 "Motormoment abhaengig vom Handmoment bei Geschwindigkeit v0 - mapped mBci_V0AssistCurveAuto_XAU16" CURVE 0x80B0 AblGLKWBuw 41055 NM2N 0 20000 FORMAT "%8.5" SYMBOL_LINK "mBci_V0AssistCurveAuto_XAU16" 0
 /begin AXIS_DESCR COM_AXIS matAbsTorsionBarTorque_xdu16 TBTHIGH 10 0 20 AXIS_PTS_REF LKU_F_LOOKUP_V1_XI16 DEPOSIT ABSOLUTE /end AXIS_DESCR
/end CHARACTERISTIC
/begin CHARACTERISTIC LKU_F_LOOKUP_V1_DYN_KLU16 "Motormoment abhaengig vom Handmoment bei Geschwindigkeit v0 - mapped mBci_V0AssistCurveDyn_XAU16" CURVE 0x80C4 AblGLKWBuw 41055 NM2N 0 20000 FORMAT "%8.5" SYMBOL_LINK "mBci_V0AssistCurveDyn_XAU16" 0
 /begin AXIS_DESCR COM_AXIS matAbsTorsionBarTorque_xdu16 TBTHIGH 10 0 20 AXIS_PTS_REF LKU_F_LOOKUP_V1_XI16 DEPOSIT ABSOLUTE /end AXIS_DESCR
/end CHARACTERISTIC
/begin CHARACTERISTIC LKU_F_LOOKUP_V1_KOM_KLU16 "Motormoment abhaengig vom Handmoment bei Geschwindigkeit v0 - mapped mBci_V0AssistCurveKomf_XAU16" CURVE 0x80D8 AblGLKWBuw 41055 NM2N 0 20000 FORMAT "%8.5" SYMBOL_LINK "mBci_V0AssistCurveKomf_XAU16" 0
 /begin AXIS_DESCR COM_AXIS matAbsTorsionBarTorque_xdu16 TBTHIGH 10 0 20 AXIS_PTS_REF LKU_F_LOOKUP_V1_XI16 DEPOSIT ABSOLUTE /end AXIS_DESCR
/end CHARACTERISTIC
/begin CHARACTERISTIC LKU_F_LOOKUP_V2_AUTO_KLU16 "Motormoment abhaengig vom Handmoment bei Geschwindigkeit v1 - mapped mBci_V1AssistCurveAuto_XAU16" CURVE 0x80EC AblGLKWBuw 41055 NM2N 0 20000 FORMAT "%8.5" SYMBOL_LINK "mBci_V1AssistCurveAuto_XAU16" 0
 /begin AXIS_DESCR COM_AXIS matAbsTorsionBarTorque_xdu16 TBTHIGH 10 0 20 AXIS_PTS_REF LKU_F_LOOKUP_V2_XI16 DEPOSIT ABSOLUTE /end AXIS_DESCR
/end CHARACTERISTIC
/begin CHARACTERISTIC LKU_F_LOOKUP_V2_DYN_KLU16 "Motormoment abhaengig vom Handmoment bei Geschwindigkeit v1 - mapped mBci_V1AssistCurveDyn_XAU16" CURVE 0x8100 AblGLKWBuw 41055 NM2N 0 20000 FORMAT "%8.5" SYMBOL_LINK "mBci_V1AssistCurveDyn_XAU16" 0
 /begin AXIS_DESCR COM_AXIS matAbsTorsionBarTorque_xdu16 TBTHIGH 10 0 20 AXIS_PTS_REF LKU_F_LOOKUP_V2_XI16 DEPOSIT ABSOLUTE /end AXIS_DESCR
/end CHARACTERISTIC
/begin CHARACTERISTIC LKU_F_LOOKUP_V2_KOM_KLU16 "Motormoment abhaengig vom Handmoment bei Geschwindigkeit v1 - mapped mBci_V1AssistCurveKomf_XAU16" CURVE 0x8114 AblGLKWBuw 41055 NM2N 0 20000 FORMAT "%8.5" SYMBOL_LINK "mBci_V1AssistCurveKomf_XAU16" 0
 /begin AXIS_DESCR COM_AXIS matAbsTorsionBarTorque_xdu16 TBTHIGH 10 0 20 AXIS_PTS_REF LKU_F_LOOKUP_V2_XI16 DEPOSIT ABSOLUTE /end AXIS_DESCR
/end CHARACTERISTIC
/begin CHARACTERISTIC LKU_F_LOOKUP_V3_AUTO_KLU16 "Motormoment abhaengig vom Handmoment bei Geschwindigkeit v2 - mapped mBci_V2AssistCurveAuto_XAU16" CURVE 0x8128 AblGLKWBuw 41055 NM2N 0 20000 FORMAT "%8.5" SYMBOL_LINK "mBci_V2AssistCurveAuto_XAU16" 0
 /begin AXIS_DESCR COM_AXIS matAbsTorsionBarTorque_xdu16 TBTHIGH 10 0 20 AXIS_PTS_REF LKU_F_LOOKUP_V3_XI16 DEPOSIT ABSOLUTE /end AXIS_DESCR
/end CHARACTERISTIC
/begin CHARACTERISTIC LKU_F_LOOKUP_V3_DYN_KLU16 "Motormoment abhaengig vom Handmoment bei Geschwindigkeit v2 - mapped mBci_V2AssistCurveDyn_XAU16" CURVE 0x813C AblGLKWBuw 41055 NM2N 0 20000 FORMAT "%8.5" SYMBOL_LINK "mBci_V2AssistCurveDyn_XAU16" 0
 /begin AXIS_DESCR COM_AXIS matAbsTorsionBarTorque_xdu16 TBTHIGH 10 0 20 AXIS_PTS_REF LKU_F_LOOKUP_V3_XI16 DEPOSIT ABSOLUTE /end AXIS_DESCR
/end CHARACTERISTIC
/begin CHARACTERISTIC LKU_F_LOOKUP_V3_KOM_KLU16 "Motormoment abhaengig vom Handmoment bei Geschwindigkeit v2 - mapped mBci_V2AssistCurveKomf_XAU16" CURVE 0x8150 AblGLKWBuw 41055 NM2N 0 20000 FORMAT "%8.5" SYMBOL_LINK "mBci_V2AssistCurveKomf_XAU16" 0
 /begin AXIS_DESCR COM_AXIS matAbsTorsionBarTorque_xdu16 TBTHIGH 10 0 20 AXIS_PTS_REF LKU_F_LOOKUP_V3_XI16 DEPOSIT ABSOLUTE /end AXIS_DESCR
/end CHARACTERISTIC
/begin CHARACTERISTIC LKU_F_LOOKUP_V4_AUTO_KLU16 "Motormoment abhaengig vom Handmoment bei Geschwindigkeit v3 - mapped mBci_V3AssistCurveAuto_XAU16" CURVE 0x8164 AblGLKWBuw 41055 NM2N 0 20000 FORMAT "%8.5" SYMBOL_LINK "mBci_V3AssistCurveAuto_XAU16" 0
 /begin AXIS_DESCR COM_AXIS matAbsTorsionBarTorque_xdu16 TBTHIGH 10 0 20 AXIS_PTS_REF LKU_F_LOOKUP_V4_XI16 DEPOSIT ABSOLUTE /end AXIS_DESCR
/end CHARACTERISTIC
/begin CHARACTERISTIC LKU_F_LOOKUP_V4_DYN_KLU16 "Motormoment abhaengig vom Handmoment bei Geschwindigkeit v3 - mapped mBci_V3AssistCurveDyn_XAU16" CURVE 0x8178 AblGLKWBuw 41055 NM2N 0 20000 FORMAT "%8.5" SYMBOL_LINK "mBci_V3AssistCurveDyn_XAU16" 0
 /begin AXIS_DESCR COM_AXIS matAbsTorsionBarTorque_xdu16 TBTHIGH 10 0 20 AXIS_PTS_REF LKU_F_LOOKUP_V4_XI16 DEPOSIT ABSOLUTE /end AXIS_DESCR
/end CHARACTERISTIC
/begin CHARACTERISTIC LKU_F_LOOKUP_V4_KOM_KLU16 "Motormoment abhaengig vom Handmoment bei Geschwindigkeit v3 - mapped mBci_V3AssistCurveKomf_XAU16" CURVE 0x818C AblGLKWBuw 41055 NM2N 0 20000 FORMAT "%8.5" SYMBOL_LINK "mBci_V3AssistCurveKomf_XAU16" 0
 /begin AXIS_DESCR COM_AXIS matAbsTorsionBarTorque_xdu16 TBTHIGH 10 0 20 AXIS_PTS_REF LKU_F_LOOKUP_V4_XI16 DEPOSIT ABSOLUTE /end AXIS_DESCR
/end CHARACTERISTIC
/begin CHARACTERISTIC LKU_F_LOOKUP_V5_AUTO_KLU16 "Motormoment abhaengig vom Handmoment bei Geschwindigkeit v4 - mapped mBci_V4AssistCurveAuto_XAU16" CURVE 0x81A0 AblGLKWBuw 41055 NM2N 0 20000 FORMAT "%8.5" SYMBOL_LINK "mBci_V4AssistCurveAuto_XAU16" 0
 /begin AXIS_DESCR COM_AXIS matAbsTorsionBarTorque_xdu16 TBTHIGH 10 0 20 AXIS_PTS_REF LKU_F_LOOKUP_V5_XI16 DEPOSIT ABSOLUTE /end AXIS_DESCR
/end CHARACTERISTIC
/begin CHARACTERISTIC LKU_F_LOOKUP_V5_DYN_KLU16 "Motormoment abhaengig vom Handmoment bei Geschwindigkeit v4 - mapped mBci_V4AssistCurveDyn_XAU16" CURVE 0x81B4 AblGLKWBuw 41055 NM2N 0 20000 FORMAT "%8.5" SYMBOL_LINK "mBci_V4AssistCurveDyn_XAU16" 0
 /begin AXIS_DESCR COM_AXIS matAbsTorsionBarTorque_xdu16 TBTHIGH 10 0 20 AXIS_PTS_REF LKU_F_LOOKUP_V5_XI16 DEPOSIT ABSOLUTE /end AXIS_DESCR
/end CHARACTERISTIC
/begin CHARACTERISTIC LKU_F_LOOKUP_V5_KOM_KLU16 "Motormoment abhaengig vom Handmoment bei Geschwindigkeit v4 - mapped mBci_V4AssistCurveKomf_XAU16" CURVE 0x81C8 AblGLKWBuw 41055 NM2N 0 20000 FORMAT "%8.5" SYMBOL_LINK "mBci_V4AssistCurveKomf_XAU16" 0
 /begin AXIS_DESCR COM_AXIS matAbsTorsionBarTorque_xdu16 TBTHIGH 10 0 20 AXIS_PTS_REF LKU_F_LOOKUP_V5_XI16 DEPOSIT ABSOLUTE /end AXIS_DESCR
/end CHARACTERISTIC
/begin CHARACTERISTIC LKU_F_LOOKUP_V6_AUTO_KLU16 "Motormoment abhaengig vom Handmoment bei Geschwindigkeit v5 - mapped mBci_V5AssistCurveAuto_XAU16" CURVE 0x81DC AblGLKWBuw 41055 NM2N 0 20000 FORMAT "%8.5" SYMBOL_LINK "mBci_V5AssistCurveAuto_XAU16" 0
 /begin AXIS_DESCR COM_AXIS matAbsTorsionBarTorque_xdu16 TBTHIGH 10 0 20 AXIS_PTS_REF LKU_F_LOOKUP_V6_XI16 DEPOSIT ABSOLUTE /end AXIS_DESCR
/end CHARACTERISTIC
/begin CHARACTERISTIC LKU_F_LOOKUP_V6_DYN_KLU16 "Motormoment abhaengig vom Handmoment bei Geschwindigkeit v5 - mapped mBci_V5AssistCurveDyn_XAU16" CURVE 0x81F0 AblGLKWBuw 41055 NM2N 0 20000 FORMAT "%8.5" SYMBOL_LINK "mBci_V5AssistCurveDyn_XAU16" 0
 /begin AXIS_DESCR COM_AXIS matAbsTorsionBarTorque_xdu16 TBTHIGH 10 0 20 AXIS_PTS_REF LKU_F_LOOKUP_V6_XI16 DEPOSIT ABSOLUTE /end AXIS_DESCR
/end CHARACTERISTIC
/begin CHARACTERISTIC LKU_F_LOOKUP_V6_KOM_KLU16 "Motormoment abhaengig vom Handmoment bei Geschwindigkeit v5 - mapped mBci_V5AssistCurveKomf_XAU16" CURVE 0x8204 AblGLKWBuw 41055 NM2N 0 20000 FORMAT "%8.5" SYMBOL_LINK "mBci_V5AssistCurveKomf_XAU16" 0
 /begin AXIS_DESCR COM_AXIS matAbsTorsionBarTorque_xdu16 TBTHIGH 10 0 20 AXIS_PTS_REF LKU_F_LOOKUP_V6_XI16 DEPOSIT ABSOLUTE /end AXIS_DESCR
/end CHARACTERISTIC
/begin CHARACTERISTIC ROU_CNT_IND_AU8 "Anzahl der Indexmarkenueberlenkungen - mapped zDthrCtrl_IDScnt_XDU8" VALUE 0x6446 AblGLKWub 250 ZU0 0 250 SYMBOL_LINK "zDthrCtrl_IDScnt_XDU8" 0 /end CHARACTERISTIC
/begin CHARACTERISTIC ROU_F_ZAHNST_MITF_AU16 "Grenzewert fuer Zahnstangenkraft bei Mittenhalt - mapped kDthrCtrl_MidhRackforceMax_XDU16" VALUE 0x60E4 AblGLKWuw 20000 PDC_FRACK 0 20000 SYMBOL_LINK "kDthrCtrl_MidhRackforceMax_XDU16" 0 /end CHARACTERISTIC
/begin CHARACTERISTIC ROU_I_CALIBRANGE_AU8 "Kurzbeschreibung: [Entfernungsbereich (+-) um die mechanische Mitte, innerhalb dessen der Kalibrierungsoffset zulaessig ist.]" VALUE 0x80D1B2 AblGLKWuw 0 DEGREE2MM 0 60 SYMBOL_LINK "wRpSync_MaxRotorAngleForCalib_XDU16" 0 /end CHARACTERISTIC
/begin CHARACTERISTIC ROU_PHA_IND_AU16 "Lenkwinkelbeschleunigung bei Index anlernen - mapped aDthrCtrl_IDAngleAcc_XDU16" VALUE 0x60C8 AblGLKWuw 9900 SAA 100 10000 FORMAT "%8.2" SYMBOL_LINK "aDthrCtrl_IDAngleAcc_XDU16" 0 /end CHARACTERISTIC
/begin CHARACTERISTIC ROU_PHA_MIT_AU16 "Lenkwinkelbeschleunigung bei Mittenhalt - mapped aDthrCtrl_MidhAngleacc_XDU16" VALUE 0x60CA AblGLKWuw 65499 SAA 1 65500 FORMAT "%8.2" SYMBOL_LINK "aDthrCtrl_MidhAngleacc_XDU16" 0 /end CHARACTERISTIC
/begin CHARACTERISTIC ROU_PHA_SWEA_AU16 "Lenkwinkelbeschleunigung fuer Anderungen der Verfahrgeschwindigkeit bei der Endanschlagserkennung - mapped aDthrCtrl_ESLRackAccel_XDU16" VALUE 0x60C6 AblGLKWuw 0 RACKACC128 15 250 FORMAT "%.15" SYMBOL_LINK "aDthrCtrl_ESLRackAccel_XDU16" 0 /end CHARACTERISTIC
/begin CHARACTERISTIC ROU_PHI_BALANCERANGE_AU8 "Winkelbereich (+-) um die mechanische Mitte, innerhalb dessen ein Winkel der Lenkradwaage zulaessig ist.\\nBeispiel: Winkelbereich -60 degree  und +60 degree  -> =120\\n - mapped wRpSync_RotAngRange4CalibJob_XDU16 " VALUE 0x62BC AblGLKWuw 0 ANGLE_1 0 700 SYMBOL_LINK "wRpSync_RotAngRange4CalibJob_XDU16" 0 /end CHARACTERISTIC
/begin CHARACTERISTIC ROU_PHI_INDSUCH_AU8 "Winkelsuchbereich (+-) der Indexmarke um die Startposition. Beispiel: -45 degree  und +45 degree  -> =45 - mapped wDthrCtrl_IDFAngle_XDU16" VALUE 0x62A4 AblGLKWuw 0 SA 0 180 SYMBOL_LINK "wDthrCtrl_IDFAngle_XDU16" 0 /end CHARACTERISTIC
/begin CHARACTERISTIC ROU_PHI_IND_AU8 "Mit Zielgeschwindigkeit zu ueberlenkender Bereich - mapped wDthrCtrl_IDSAngle_XDU16" VALUE 0x62AA AblGLKWuw 0 SA 0 180 SYMBOL_LINK "wDthrCtrl_IDSAngle_XDU16" 0 /end CHARACTERISTIC
/begin CHARACTERISTIC ROU_PHI_SWEASTART_AU8 "Lenkwinkelamplitude beim Index anlernen - mapped wDthrCtrl_IDFAngle_XDU16" VALUE 0x62A4 AblGLKWuw 95.0256 SA 4.987531 100.0131 EXTENDED_LIMITS 5 100 SYMBOL_LINK "wDthrCtrl_IDFAngle_XDU16" 0 /end CHARACTERISTIC
/begin CHARACTERISTIC ROU_PHV_INDSUCH_AU16 "Lenkwinkelgeschwindigkeit bei Index anlernen (10ms Abtastung) - mapped vDthrCtrl_IDFAngleSpeed_XDU16" VALUE 0x627C AblGLKWuw 500 SAS 0 500 SYMBOL_LINK "vDthrCtrl_IDFAngleSpeed_XDU16" 0 /end CHARACTERISTIC
/begin CHARACTERISTIC ROU_PHV_IND_AU16 "Lenkwinkelgeschwindigkeit beim Index anlernen - mapped vDthrCtrl_IDSAngleSpeed_XDU16" VALUE 0x627E AblGLKWuw 500 SAS 0 500 SYMBOL_LINK "vDthrCtrl_IDSAngleSpeed_XDU16" 0 /end CHARACTERISTIC
/begin CHARACTERISTIC ROU_PHV_MIT_AU16 "Lenkwinkelgeschwindigkeit bei Mittenhalt - mapped vDthrCtrl_MidhAngleSpeed_XDU16" VALUE 0x6284 AblGLKWuw 30000 SAS 0 30000 SYMBOL_LINK "vDthrCtrl_MidhAngleSpeed_XDU16" 0 /end CHARACTERISTIC
/begin CHARACTERISTIC ROU_PHV_SWEAHIGH_AU16 "Lenkwinkelgeschwindigkeit fuer schnelle Verfahrgeschwindigkeit (Endanschlagserkennung) - mapped vDthrCtrl_ESLRackSpeed_XDU16" VALUE 0x627A AblGLKWuw 333 GRMM2HUB 35 454 FORMAT "%6.4" SYMBOL_LINK "vDthrCtrl_ESLRackSpeed_XDU16" 0 /end CHARACTERISTIC
/begin CHARACTERISTIC ROU_PHV_SWEALEARN_AU8 "max. Lenkwinkelgeschwindigkeit im Endanschlag waehrend des Anlernvorgangs - mapped vDthrCtrl_EslLockSpeedTresh_XDU8" VALUE 0x6420 AblGLKWub 0 GRMM2HUB 0 4 FORMAT "%6.4" SYMBOL_LINK "vDthrCtrl_EslLockSpeedTresh_XDU8" 0 /end CHARACTERISTIC
/begin CHARACTERISTIC ROU_PHV_SWEALOW_AU16 "Lenkwinkelgeschwindigkeit fuer langsame Verfahrgeschwindigkeit (Endanschlagserkennung) - mapped vDthrCtrl_ESLLockSpeed_XDU16" VALUE 0x6276 AblGLKWuw 30 GRMM2HUB 0 90 FORMAT "%6.4" SYMBOL_LINK "vDthrCtrl_ESLLockSpeed_XDU16" 0 /end CHARACTERISTIC
/begin CHARACTERISTIC ROU_TRQ_HAND_ABBMAX_AU8 "Wert fuer das Abbruchkriterium  Handlenkmoment - mapped mDthrCtrl_HandTorqueMax_XDU16" VALUE 0x6136 AblGLKWuw 60 TBTHIGH 0 60 SYMBOL_LINK "mDthrCtrl_HandTorqueMax_XDU16" 0 /end CHARACTERISTIC
/begin CHARACTERISTIC ROU_TRQ_SWEAHAND_AU8 "Einlernbedingung: Minimales Handmoment - mapped mEndStop_uTBTLearn_XDU16" VALUE 0x6152 AblGLKWuw 15 TBTHIGH 0 15 SYMBOL_LINK "mEndStop_uTBTLearn_XDU16" 0 /end CHARACTERISTIC
/begin CHARACTERISTIC ROU_T_FZAHN_ABBMAX_AU16 "Wert fuer das Abbruchkriterium Zeitspanne Zahnstangekraft - mapped tDthrCtrl_MidhMaxRackforceTime_XDU16" VALUE 0x6210 AblGLKWuw 0 TIMMS 10 30000 SYMBOL_LINK "tDthrCtrl_MidhMaxRackforceTime_XDU16" 0 /end CHARACTERISTIC
/begin CHARACTERISTIC ROU_V_SWEA_CALIB_PLAUSI_AU8 "Schwelle Fahrzeuggeschwindigkeit, oberhalb der nicht kalibriert werden kann - mapped vRpSync_MaxCalibVehicleSpeed_XDU16" VALUE 0x80CBDA AblGLKWuw 255 VFZHIGH 0 255 FORMAT "%6.2" SYMBOL_LINK "vRpSync_MaxCalibVehicleSpeed_XDU16" 0 /end CHARACTERISTIC
/begin CHARACTERISTIC SAC_FAC_D_FAKTOR_KLU16 "Tabellenwert der Kennlinie fuer die Beeinflussung der D-Anteile - mapped xSacHndl_DPartsFactor_XAU16" CURVE 0x6C1C AblGLKLuw 1 RIGHTSH14NP 0 1 FORMAT "%8.4" SYMBOL_LINK "xSacHndl_DPartsFactor_XAU16" 0
 /begin AXIS_DESCR STD_AXIS sac_FDFactorSac_mi16 FRACK 6 0 65535 FORMAT "%8.5" DEPOSIT ABSOLUTE /end AXIS_DESCR
/end CHARACTERISTIC
/begin CHARACTERISTIC SAC_FAC_F_N_UEL_D_FAKTOR_AU8 "Faktor auf die ueberlenkbare Kraft, um die Berechnung der Summe der QFK-Teilkraefte anzupassen - mapped fSacHndl_UseNoOvstForce4DParts_XDU8" VALUE 0x63D5 AblGLKWub 1 ZU0 0 1 SYMBOL_LINK "fSacHndl_UseNoOvstForce4DParts_XDU8" 0 /end CHARACTERISTIC
/begin CHARACTERISTIC SAC_FAC_F_SOLL_D_FAKTOR_AU8 "Faktor auf die Soll-Kraft, um die Berechnung der Summe der QFK-Teilkraefte anzupassen - mapped fSacHndl_UseOvstForce4DParts_XDU8" VALUE 0x63D6 AblGLKWub 1 ZU0 0 1 SYMBOL_LINK "fSacHndl_UseOvstForce4DParts_XDU8" 0 /end CHARACTERISTIC
/begin CHARACTERISTIC SAC_FAC_F_VIB_D_FAKTOR_AU8 "Faktor auf die Vibrationskraft, um die Berechnung der Summe der QFK-Teilkraefte anzupassen - mapped fSacHndl_UseVibrationForce4DParts_XDU8" VALUE 0x63D7 AblGLKWub 1 ZU0 0 1 SYMBOL_LINK "fSacHndl_UseVibrationForce4DParts_XDU8" 0 /end CHARACTERISTIC
/begin CHARACTERISTIC SAC_FAC_NEG_GRAD_D_FAKTOR_AU16 "Positiver Gradient mit dem sichdas Signal sac_facDFactorSac_mu16 aendern darf - mapped xSacHndl_FallingFactGrad4DParts_XDU16" VALUE 0x6340 AblGLKWuw 1 RIGHTSH14NP 0.0001 1 FORMAT "%6.2" SYMBOL_LINK "xSacHndl_FallingFactGrad4DParts_XDU16" 0 /end CHARACTERISTIC
/begin CHARACTERISTIC SAC_FAC_POS_GRAD_D_FAKTOR_AU16 "Positiver Gradient mit dem sichdas Signal sac_facDFactorSac_mu16 aendern darf - mapped xSacHndl_RisingFactGrad4DParts_XDU16" VALUE 0x6342 AblGLKWuw 1 RIGHTSH14NP 0.0001 1 FORMAT "%6.2" SYMBOL_LINK "xSacHndl_RisingFactGrad4DParts_XDU16" 0 /end CHARACTERISTIC
/begin CHARACTERISTIC UNT_FAC_BATTAB_AU16 "Stromgradientfaktor bei erkanntem BattAb - mapped xLowVoltAssRed_CurrentGradientFactorBattAb_XDU16" VALUE 0x6328 AblGLKWuw 1 RSH15GRAD2FACTGRAD 0 1 SYMBOL_LINK "xLowVoltAssRed_CurrentGradientFactorBattAb_XDU16" 0 /end CHARACTERISTIC
/begin CHARACTERISTIC UNT_FAC_FSOLL_BATTAB_AU16 "Unterstuetzungsfaktor bei erkanntem BattAb - mapped xLowVoltAssRed_AssistFactorBattAb_XDU16" VALUE 0x6314 AblGLKWuw 1 RED_FACT 0 1 SYMBOL_LINK "xLowVoltAssRed_AssistFactorBattAb_XDU16" 0 /end CHARACTERISTIC
/begin CHARACTERISTIC UNT_FAC_FSOLL_GEN_KLU16 "Unterstuetzungsfaktor generatorischer Betrieb abhaengig von Versorgungsspannung - mapped xLowVoltAssRed_UnderVoltageAssistFactorGen_XAU16" CURVE 0x6B20 AblGLKLuw 1 RED_FACT 0 1 FORMAT "%8.4" SYMBOL_LINK "xLowVoltAssRed_UnderVoltageAssistFactorGen_XAU16" 0
 /begin AXIS_DESCR STD_AXIS bsw_uBatt_mu16 U64V 3 0 33 FORMAT "%8.5" DEPOSIT ABSOLUTE /end AXIS_DESCR
/end CHARACTERISTIC
/begin CHARACTERISTIC UNT_FAC_FSOLL_KLU16 "Unterstuetzungsfaktor abhaengig von Versorgungsspannung - mapped xLowVoltAssRed_UnderVoltageAssistFactor_XAU16" CURVE 0x6B40 AblGLKLuw 1 RED_FACT 0 1 FORMAT "%8.4" SYMBOL_LINK "xLowVoltAssRed_UnderVoltageAssistFactor_XAU16" 0
 /begin AXIS_DESCR STD_AXIS bsw_uBatt_mu16 U64V 4 0 33 FORMAT "%8.5" DEPOSIT ABSOLUTE /end AXIS_DESCR
/end CHARACTERISTIC
/begin CHARACTERISTIC UNT_FAC_FSOLL_START_KLU16 "Unterstuetzungsfaktor Wiederstart abhaengig von Versorgungsspannung - mapped xLowVoltAssRed_UnderVoltageAssistFactorReStart_XAU16" CURVE 0x6B30 AblGLKLuw 1 RED_FACT 0 1 FORMAT "%8.4" SYMBOL_LINK "xLowVoltAssRed_UnderVoltageAssistFactorReStart_XAU16" 0
 /begin AXIS_DESCR STD_AXIS bsw_uBatt_mu16 U64V 3 0 33 FORMAT "%8.5" DEPOSIT ABSOLUTE /end AXIS_DESCR
/end CHARACTERISTIC
/begin CHARACTERISTIC UNT_FAC_FSOLL_SUP_DEF2_AU16 "Reduktionswert fuer Unterstuetzungsleistung bei erkanntem Defekt an der Spannungsversorgung bei Zustand 2" VALUE 0x631A AblGLKWuw 1 RED_FACT 0 1 SYMBOL_LINK "xLowVoltAssRed_AssistFactorSupVoltDefCondTwo_XDU16" 0 /end CHARACTERISTIC
/begin CHARACTERISTIC UNT_FAC_FSOLL_SUP_DEF4_AU16 "Reduktionswert fuer Unterstuetzungsleistung bei erkanntem Defekt an der Spannungsversorgung bei Zustand 4" VALUE 0x6318 AblGLKWuw 1 RED_FACT 0 1 SYMBOL_LINK "xLowVoltAssRed_AssistFactorSupVoltDefCondFour_XDU16" 0 /end CHARACTERISTIC
/begin CHARACTERISTIC UNT_FAC_FSOLL_SUP_DEF5_AU16 "Reduktionswert fuer Unterstuetzungsleistung bei erkanntem Defekt an der Spannungsversorgung bei Zustand 5 oder Zustand 7" VALUE 0x6316 AblGLKWuw 1 RED_FACT 0 1 SYMBOL_LINK "xLowVoltAssRed_AssistFactorSupVoltDefCondFive_XDU16" 0 /end CHARACTERISTIC
/begin CHARACTERISTIC UNT_FAC_ISOLL_BATTAB_AU16 "Stromfaktor bei erkanntem BattAb - mapped xLowVoltAssRed_CurrentFactorBattAb_XDU16" VALUE 0x631E AblGLKWuw 1 RED_FACT 0 1 SYMBOL_LINK "xLowVoltAssRed_CurrentFactorBattAb_XDU16" 0 /end CHARACTERISTIC
/begin CHARACTERISTIC UNT_FAC_ISOLL_GEN_KLU16 "Stromfaktor im Generatorbetrieb in Abhaengigkeit der Versorgungsspannung" CURVE 0x6B54 AblGLKLuw 1 RED_FACT 0 1 FORMAT "%8.4" SYMBOL_LINK "xLowVoltAssRed_UnderVoltageCurrentFactorGen_XAU16" 0
 /begin AXIS_DESCR STD_AXIS bsw_uBatt_mu16 U64V 3 0 33 FORMAT "%8.5" DEPOSIT ABSOLUTE /end AXIS_DESCR
/end CHARACTERISTIC
/begin CHARACTERISTIC UNT_FAC_ISOLL_GRAD_KLU16 "Stromgradientfaktor abhaengig von Versorgungsspannung - mapped xLowVoltAssRed_UnderVoltageCurrentGradientFactor_XAU16" CURVE 0x6B98 AblGLKLuw 1 RED_FACT 0 1 FORMAT "%8.4" SYMBOL_LINK "xLowVoltAssRed_UnderVoltageCurrentGradientFactor_XAU16" 0
 /begin AXIS_DESCR STD_AXIS bsw_uBatt_mu16 U64V 4 0 33 FORMAT "%8.5" DEPOSIT ABSOLUTE /end AXIS_DESCR
/end CHARACTERISTIC
/begin CHARACTERISTIC UNT_FAC_ISOLL_GRAD_START_KLU16 "Stromgradientfaktor Wiederstart abhaengig von Versorgungsspannung - mapped xLowVoltAssRed_UnderVoltageCurrentGradientFactorReStart_XAU16" CURVE 0x6B88 AblGLKLuw 1 RED_FACT 0 1 FORMAT "%8.4" SYMBOL_LINK "xLowVoltAssRed_UnderVoltageCurrentGradientFactorReStart_XAU16" 0
 /begin AXIS_DESCR STD_AXIS bsw_uBatt_mu16 U64V 3 0 33 FORMAT "%8.5" DEPOSIT ABSOLUTE /end AXIS_DESCR
/end CHARACTERISTIC
/begin CHARACTERISTIC UNT_FAC_ISOLL_GRAD_SUP_DEF2_AU16 "Stromgradientenreduktionswert bei erkanntem Defekt an der Spannungsversorgung bei Zustand 2" VALUE 0x632E AblGLKWuw 1 RSH15GRAD2FACTGRAD 0 1 SYMBOL_LINK "xLowVoltAssRed_CurrentGradientFactorSupVoltDefCondTwo_XDU16" 0 /end CHARACTERISTIC
/begin CHARACTERISTIC UNT_FAC_ISOLL_GRAD_SUP_DEF4_AU16 "Stromgradientenreduktionswert bei erkanntem Defekt an der Spannungsversorgung bei Zustand 4" VALUE 0x632C AblGLKWuw 1 RSH15GRAD2FACTGRAD 0 1 SYMBOL_LINK "xLowVoltAssRed_CurrentGradientFactorSupVoltDefCondFour_XDU16" 0 /end CHARACTERISTIC
/begin CHARACTERISTIC UNT_FAC_ISOLL_GRAD_SUP_DEF5_AU16 "Stromgradientenreduktionswert bei erkanntem Defekt an der Spannungsversorgung bei Zustand 5 oder Zustand 7" VALUE 0x632A AblGLKWuw 1 RSH15GRAD2FACTGRAD 0 1 SYMBOL_LINK "xLowVoltAssRed_CurrentGradientFactorSupVoltDefCondFive_XDU16" 0 /end CHARACTERISTIC
/begin CHARACTERISTIC UNT_FAC_ISOLL_KLU16 "Stromfaktor abhaengig von Versorgungsspannung - mapped xLowVoltAssRed_UnderVoltageCurrentFactor_XAU16" CURVE 0x6B74 AblGLKLuw 1 RED_FACT 0 1 FORMAT "%8.4" SYMBOL_LINK "xLowVoltAssRed_UnderVoltageCurrentFactor_XAU16" 0
 /begin AXIS_DESCR STD_AXIS bsw_uBatt_mu16 U64V 4 0 33 FORMAT "%8.5" DEPOSIT ABSOLUTE /end AXIS_DESCR
/end CHARACTERISTIC
/begin CHARACTERISTIC UNT_FAC_ISOLL_START_KLU16 "Stromfaktor Wiederstart abhaengig von Versorgungsspannung - mapped xLowVoltAssRed_UnderVoltageCurrentFactorReStart_XAU16" CURVE 0x6B64 AblGLKLuw 1 RED_FACT 0 1 FORMAT "%8.4" SYMBOL_LINK "xLowVoltAssRed_UnderVoltageCurrentFactorReStart_XAU16" 0
 /begin AXIS_DESCR STD_AXIS bsw_uBatt_mu16 U64V 3 0 33 FORMAT "%8.5" DEPOSIT ABSOLUTE /end AXIS_DESCR
/end CHARACTERISTIC
/begin CHARACTERISTIC UNT_FAC_ISOLL_SUP_DEF2_AU16 "Stromreduktionswert bei erkanntem Defekt an der Spannungsversorgung bei Zustand 2 - mapped xLowVoltAssRed_CurrentFactorSupVoltDefCondTwo_XDU16" VALUE 0x6324 AblGLKWuw 1 RED_FACT 0 1 SYMBOL_LINK "xLowVoltAssRed_CurrentFactorSupVoltDefCondTwo_XDU16" 0 /end CHARACTERISTIC
/begin CHARACTERISTIC UNT_FAC_ISOLL_SUP_DEF4_AU16 "Stromreduktionswert bei erkanntem Defekt an der Spannungsversorgung bei Zustand 4" VALUE 0x6322 AblGLKWuw 1 RED_FACT 0 1 SYMBOL_LINK "xLowVoltAssRed_CurrentFactorSupVoltDefCondFour_XDU16" 0 /end CHARACTERISTIC
/begin CHARACTERISTIC UNT_FAC_ISOLL_SUP_DEF5_AU16 "Stromreduktionswert bei erkanntem Defekt an der Spannungsversorgung bei Zustand 5 oder Zustand 7 - mapped xLowVoltAssRed_CurrentFactorSupVoltDefCondFive_XDU16" VALUE 0x6320 AblGLKWuw 1 RED_FACT 0 1 SYMBOL_LINK "xLowVoltAssRed_CurrentFactorSupVoltDefCondFive_XDU16" 0 /end CHARACTERISTIC
/begin CHARACTERISTIC UNT_INCR_RAMPE_AU16 "Positiver Gradient des Unterstuetzungsfaktors - mapped xLowVoltAssRed_PosGradAssistFactor_XDU16" VALUE 0x8090 AblGLKWuw 1 RSH15GRAD2FACTGRAD 0 1 SYMBOL_LINK "xLowVoltAssRed_PosGradAssistFactor_XDU16" 0 /end CHARACTERISTIC
/begin CHARACTERISTIC UNT_INCR_RAMPE_FLACH_AU16 "Positiver Gradient des Stromgradientfaktors - mapped xLowVoltAssRed_PosGradCurrentGradientFactor_XDU16" VALUE 0x8098 AblGLKWuw 1 RSH15GRAD2FACTGRAD 0 1 SYMBOL_LINK "xLowVoltAssRed_PosGradCurrentGradientFactor_XDU16" 0 /end CHARACTERISTIC
/begin CHARACTERISTIC UNT_INCR_RAMPE_F_START_AU16 "Reduktionsgradient (steigend/fallend) des Unterstuetzungsfaktors bei Wiederstart - mapped xLowVoltAssRed_GradAssistFactorReStart_XDU16" VALUE 0x807E AblGLKWuw 1 RSH15GRAD2FACTGRAD 0 1 SYMBOL_LINK "xLowVoltAssRed_GradAssistFactorReStart_XDU16" 0 /end CHARACTERISTIC
/begin CHARACTERISTIC UNT_INCR_RAMPE_I_AU16 "Positiver Gradient des Stromfaktors - mapped xLowVoltAssRed_PosGradCurrentFactor_XDU16" VALUE 0x8094 AblGLKWuw 1 RSH15GRAD2FACTGRAD 0 1 SYMBOL_LINK "xLowVoltAssRed_PosGradCurrentFactor_XDU16" 0 /end CHARACTERISTIC
/begin CHARACTERISTIC UNT_INCR_RAMPE_I_GRAD_START_AU16 "Reduktionsgradient (steigend/fallend) des Stromgradientfaktors bei Wiederstart - mapped xLowVoltAssRed_GradCurrentGradientFactorReStart_XDU16" VALUE 0x8082 AblGLKWuw 1 RSH15GRAD2FACTGRAD 0 1 SYMBOL_LINK "xLowVoltAssRed_GradCurrentGradientFactorReStart_XDU16" 0 /end CHARACTERISTIC
/begin CHARACTERISTIC UNT_INCR_RAMPE_I_START_AU16 "Reduktionsgradient (steigend/fallend) des Stromfaktors bei Wiederstart - mapped xLowVoltAssRed_GradCurrentFactorReStart_XDU16" VALUE 0x8080 AblGLKWuw 1 RSH15GRAD2FACTGRAD 0 1 SYMBOL_LINK "xLowVoltAssRed_GradCurrentFactorReStart_XDU16" 0 /end CHARACTERISTIC
/begin CHARACTERISTIC UNT_I_HI_REDUCTION_NVEV_C_CU8 "Max current for NVEM error level 4,5,7 to FF conditions" VALUE 0x60DE AblGLKWuw 500 SM_I 0 500 SYMBOL_LINK "iLowVoltAssRed_NVEMErrorLevelMaxBattCurrent_XDU16" 0 /end CHARACTERISTIC
/begin CHARACTERISTIC UNT_I_MAX_AU16 "Maximal zulaessiger Strom - mapped iLowVoltAssRed_MaxCurrent_XDU16" VALUE 0x60DC AblGLKWuw 500 SM_I 0 500 SYMBOL_LINK "iLowVoltAssRed_MaxCurrent_XDU16" 0 /end CHARACTERISTIC
/begin CHARACTERISTIC UNT_I_SM_REDUCTION_NVEV_CU8 "Max current for BattAb and NVEM error level 2 conditions" VALUE 0x80D160 AblGLKWuw 500 SM_I 0 500 SYMBOL_LINK "iLowVoltAssRed_BattAbNVEM2MaxBattCurrent_XDU16" 0 /end CHARACTERISTIC
/begin CHARACTERISTIC UNT_POS_GRAD_I_MAX_AU16 "Maximal zulaessiger Stromgradient - mapped to yLowVoltAssRed_MaxCurrentGradient_XDU16" VALUE 0x639C __UWORD_S 0 SM_I_S 100 65535 FORMAT "%.15" SYMBOL_LINK "yLowVoltAssRed_MaxCurrentGradient_XDU16" 0 /end CHARACTERISTIC
/begin CHARACTERISTIC UNT_SWS_VFZG_AUSBLEND_AU8 "Fahrzeuggeschwindigkeitsabhaengige Ausblendung der Reduktion ueber Versorgungsspannung (1=aktiv, 0=inaktiv) - mapped fLowVoltAssRed_HideVehSpeedDepVoltRed_XDB" VALUE 0x63CF AblGLKWub 1 ZU0 0 1 SYMBOL_LINK "fLowVoltAssRed_HideVehSpeedDepVoltRed_XDB" 0 /end CHARACTERISTIC
/begin CHARACTERISTIC UNT_VFZG_AUSBLEND_AU16 "Schwelle fuer Fahrzeug faehrt - mapped vLowVoltAssRed_VehicleRunningBorder_XDU16" VALUE 0x80CBD4 AblGLKWuw 500 VFZHIGH 0 500 SYMBOL_LINK "vLowVoltAssRed_VehicleRunningBorder_XDU16" 0 /end CHARACTERISTIC
/begin CHARACTERISTIC UNT_ZUENDUNG_EPR_AU16 "Nachlaufzeit fuer Erststart und Wiederstart - mapped tLowVoltAssRed_EngineStartPostRunTime_XDU16" VALUE 0x621E AblGLKWuw 10000 TIMMS 1 10000 SYMBOL_LINK "tLowVoltAssRed_EngineStartPostRunTime_XDU16" 0 /end CHARACTERISTIC
/begin CHARACTERISTIC UNT_ZUENDUNG_MAX_EPR_AU16 "Maximale Dauer des Erststarts - mapped tLowVoltAssRed_EngineStartMaxTime_XDU16" VALUE 0x621C AblGLKWuw 65534 TIMMS 1 65535 SYMBOL_LINK "tLowVoltAssRed_EngineStartMaxTime_XDU16" 0 /end CHARACTERISTIC
/begin CHARACTERISTIC fSacHndl_DisableMonitoring_XDU8 "0 und 1 =SAC ï¿½berwachung an, 2=SAC ï¿½berwachung aus" VALUE 0x63D3 AblGLKWub 10.00 ZU0 0.00 10.00 FORMAT "%5.2" /end CHARACTERISTIC
/begin CHARACTERISTIC fSacHndl_EnableVibration_XDU8 "0  =SAC Vibrations ï¿½berwachung aus, 1=SAC Vibration ï¿½berwachung an" VALUE 0x63D4 AblGLKWub 10.00 ZU0 0.00 10.00 FORMAT "%5.2" /end CHARACTERISTIC
/begin CHARACTERISTIC fSacHndl_UseNoOvstForce4DParts_XDU8 "Nicht Ã¼berlenkbare Kraft fÃ¼r D-Anteils Faktor berÃ¼cksichtigen" VALUE 0x63D5 AblGLKWub 1.000 ZU0 0.00 1.000 FORMAT "%5.3" /end CHARACTERISTIC
/begin CHARACTERISTIC fSacHndl_UseOvstForce4DParts_XDU8 "Ã¼berlenkbare Kraft fÃ¼r D-Anteils Faktor berÃ¼cksichtigen" VALUE 0x63D6 AblGLKWub 1.000 ZU0 0.00 1.000 FORMAT "%5.3" /end CHARACTERISTIC
/begin CHARACTERISTIC fSacHndl_UseVibrationForce4DParts_XDU8 "Vibrationskraftausgang fÃ¼r D-Anteils Faktor berÃ¼cksichtigen" VALUE 0x63D7 AblGLKWub 1.000 ZU0 0.00 1.000 FORMAT "%5.3" /end CHARACTERISTIC
/begin CHARACTERISTIC fSigCond_UseTBTBandstop_XDU8 "1 = Bandsperre für komp. TBT an, 0 = Bandstop aus" VALUE 0x63E1 AblGLKWub 1.000 ZU0 0.00 1.000 FORMAT "%5.3" /end CHARACTERISTIC
/begin CHARACTERISTIC fSmtActrRPC_EnableEmergencyTraject_XDB "SmtActrRPC Schalter fuer FollowTrajectory Feature" VALUE 0x63E2 AblGLKWub 1.000 BIT 0.00 1.000 FORMAT "%5.3" /end CHARACTERISTIC
/begin CHARACTERISTIC fSmtActrRPC_EnableXcpActvSw_XDB "SmtActrRPC Xcp Request Aktivierung (1=Xcp Test aktiv, 0=Xcp Test inaktiv)" VALUE 0x63E3 AblGLKWub 1.000 BIT 0.00 1.000 FORMAT "%5.3" /end CHARACTERISTIC
/begin CHARACTERISTIC fSmtActrRPC_XCPSetPolynomParamsInvalid_XDB "SmtActrRPC Xcp angefordertes Polynom ungueltig setzen" VALUE 0x63E4 AblGLKWub 1.000 BIT 0.00 1.000 FORMAT "%5.3" /end CHARACTERISTIC
/begin CHARACTERISTIC fSmtActrRPC_XCPSetTargetRackposInvalid_XDB "SmtActrRPC Xcp angeforderte Zahnstangenposition ungueltig setzen" VALUE 0x63E5 AblGLKWub 1.000 BIT 0.00 1.000 FORMAT "%5.3" /end CHARACTERISTIC
/begin CHARACTERISTIC fSteerCtrl_DeactivateDPartAtEndstop_XDU16 "deactivate D-part (due to assistance torque) at EndStop in case of NO chattering" VALUE 0x60D2 AblGLKWuw 1.000000 ZU0 0.00 1.000000 FORMAT "%8.6" /end CHARACTERISTIC
/begin CHARACTERISTIC fSteerCtrl_NoRotSpDoffLockstop_XDU8 "RotorSpeed Independent Doffset enable at endstop" VALUE 0x63E6 AblGLKWub 1.000 ZU0 0.00 1.000 FORMAT "%5.3" /end CHARACTERISTIC
/begin CHARACTERISTIC fTsc_Use_GradXtplTBT_XDU8 "mApplI_GradTorsionBarTorque_xds16 = (0:mTsc_FiltGradTBT_xds16, 1:mTsc_FiltGradXtplTBT_xds16)" VALUE 0x63F1 AblGLKWub 1.000 ZU0 0.00 1.000 FORMAT "%5.3" /end CHARACTERISTIC
/begin CHARACTERISTIC fWlc_DevWarningsActive_XDU8 "Abschalten XCPFLASH und Warnlampe" VALUE 0x63F3 AblGLKWub 1.000 ZU0 0.00 1.000 FORMAT "%5.3" /end CHARACTERISTIC
/begin CHARACTERISTIC lSmtActrRPC_XCPAisStgRackPosnFr_XDS16 "XCP - Angeforderte Zahnstangenposition vorne" VALUE 0x6124 AblGLKWsw 255.5787 FACT_0039 -127.7874 127.7913 FORMAT "%8.4" /end CHARACTERISTIC
/begin CHARACTERISTIC lSmtActrRPC_XCPSmartActPolynomCoeff1_XDS32 "XCP - SmartActuator FollowTrajectory polynom Coefficient 1" VALUE 0x6018 AblGLKWsl 511.999999881 RIGHTSH23NP -256.000000000 255.999999881 FORMAT "%13.9" /end CHARACTERISTIC
/begin CHARACTERISTIC lSmtActrRPC_XCPSmartActPolynomCoeff2_XDS32 "XCP - SmartActuator FollowTrajectory polynom Coefficient 2" VALUE 0x601C AblGLKWsl 511.999999881 RIGHTSH23NP -256.000000000 255.999999881 FORMAT "%13.9" /end CHARACTERISTIC
/begin CHARACTERISTIC mSteerCtrlDFadingV0_XAU16 "D-Fading factor depending on calculated absolute motor torque.NOTE: X-Input for these curves shall be the absolute value of the calculated MMOT" CURVE 0x8370 AblGLKLuw 25.00000 MMOT 0.00 25.00000 FORMAT "%8.5"
 /begin AXIS_DESCR STD_AXIS mSteerCtrlAbsAtRawD_xdu16 MMOT 8 0.00 25.00000 FORMAT "%8.5" DEPOSIT ABSOLUTE /end AXIS_DESCR
/end CHARACTERISTIC
/begin CHARACTERISTIC mSteerCtrlDFadingV1_XAU16 "D-Fading factor depending on calculated absolute motor torque.NOTE: X-Input for these curves shall be the absolute value of the calculated MMOT" CURVE 0x8394 AblGLKLuw 25.00000 MMOT 0.00 25.00000 FORMAT "%8.5"
 /begin AXIS_DESCR STD_AXIS mSteerCtrlAbsAtRawD_xdu16 MMOT 8 0.00 25.00000 FORMAT "%8.5" DEPOSIT ABSOLUTE /end AXIS_DESCR
/end CHARACTERISTIC
/begin CHARACTERISTIC mSteerCtrlDFadingV2_XAU16 "D-Fading factor depending on calculated absolute motor torque.NOTE: X-Input for these curves shall be the absolute value of the calculated MMOT" CURVE 0x83B8 AblGLKLuw 25.00000 MMOT 0.00 25.00000 FORMAT "%8.5"
 /begin AXIS_DESCR STD_AXIS mSteerCtrlAbsAtRawD_xdu16 MMOT 8 0.00 25.00000 FORMAT "%8.5" DEPOSIT ABSOLUTE /end AXIS_DESCR
/end CHARACTERISTIC
/begin CHARACTERISTIC mSteerCtrlDFadingV3_XAU16 "D-Fading factor depending on calculated absolute motor torque.NOTE: X-Input for these curves shall be the absolute value of the calculated MMOT" CURVE 0x83DC AblGLKLuw 25.00000 MMOT 0.00 25.00000 FORMAT "%8.5"
 /begin AXIS_DESCR STD_AXIS mSteerCtrlAbsAtRawD_xdu16 MMOT 8 0.00 25.00000 FORMAT "%8.5" DEPOSIT ABSOLUTE /end AXIS_DESCR
/end CHARACTERISTIC
/begin CHARACTERISTIC mSteerCtrlDFadingV4_XAU16 "D-Fading factor depending on calculated absolute motor torque.NOTE: X-Input for these curves shall be the absolute value of the calculated MMOT" CURVE 0x8400 AblGLKLuw 25.00000 MMOT 0.00 25.00000 FORMAT "%8.5"
 /begin AXIS_DESCR STD_AXIS mSteerCtrlAbsAtRawD_xdu16 MMOT 8 0.00 25.00000 FORMAT "%8.5" DEPOSIT ABSOLUTE /end AXIS_DESCR
/end CHARACTERISTIC
/begin CHARACTERISTIC mSteerCtrlDOffsetFadingV0_XAU16 "D-Offset Fading factor depending on calculated absolute motor torque.NOTE: X-Input for these curves shall be the absolute value of the calculated MMOT" CURVE 0x8424 AblGLKLuw 25.00000 MMOT 0.00 25.00000 FORMAT "%8.5"
 /begin AXIS_DESCR STD_AXIS mSteerCtrlAbsStRawDOffset_xdu16 MMOT 8 0.00 25.00000 FORMAT "%8.5" DEPOSIT ABSOLUTE /end AXIS_DESCR
/end CHARACTERISTIC
/begin CHARACTERISTIC mSteerCtrlDOffsetFadingV1_XAU16 "D-Offset Fading factor depending on calculated absolute motor torque.NOTE: X-Input for these curves shall be the absolute value of the calculated MMOT" CURVE 0x8448 AblGLKLuw 25.00000 MMOT 0.00 25.00000 FORMAT "%8.5"
 /begin AXIS_DESCR STD_AXIS mSteerCtrlAbsStRawDOffset_xdu16 MMOT 8 0.00 25.00000 FORMAT "%8.5" DEPOSIT ABSOLUTE /end AXIS_DESCR
/end CHARACTERISTIC
/begin CHARACTERISTIC mSteerCtrlDOffsetFadingV2_XAU16 "D-Offset Fading factor depending on calculated absolute motor torque.NOTE: X-Input for these curves shall be the absolute value of the calculated MMOT" CURVE 0x846C AblGLKLuw 25.00000 MMOT 0.00 25.00000 FORMAT "%8.5"
 /begin AXIS_DESCR STD_AXIS mSteerCtrlAbsStRawDOffset_xdu16 MMOT 8 0.00 25.00000 FORMAT "%8.5" DEPOSIT ABSOLUTE /end AXIS_DESCR
/end CHARACTERISTIC
/begin CHARACTERISTIC mSteerCtrlDOffsetFadingV3_XAU16 "D-Offset Fading factor depending on calculated absolute motor torque.NOTE: X-Input for these curves shall be the absolute value of the calculated MMOT" CURVE 0x8490 AblGLKLuw 25.00000 MMOT 0.00 25.00000 FORMAT "%8.5"
 /begin AXIS_DESCR STD_AXIS mSteerCtrlAbsStRawDOffset_xdu16 MMOT 8 0.00 25.00000 FORMAT "%8.5" DEPOSIT ABSOLUTE /end AXIS_DESCR
/end CHARACTERISTIC
/begin CHARACTERISTIC mSteerCtrlDOffsetFadingV4_XAU16 "D-Offset Fading factor depending on calculated absolute motor torque.NOTE: X-Input for these curves shall be the absolute value of the calculated MMOT" CURVE 0x84B4 AblGLKLuw 25.00000 MMOT 0.00 25.00000 FORMAT "%8.5"
 /begin AXIS_DESCR STD_AXIS mSteerCtrlAbsStRawDOffset_xdu16 MMOT 8 0.00 25.00000 FORMAT "%8.5" DEPOSIT ABSOLUTE /end AXIS_DESCR
/end CHARACTERISTIC
/begin CHARACTERISTIC mSteerCtrl_DOffsetDeadband_XDU16 "dead band D-part offset (due to TorsionBarTorqueGradient)" VALUE 0x61AC AblGLKWuw 2.000000 MMOT 0.00 2.000000 FORMAT "%8.6" /end CHARACTERISTIC
/begin CHARACTERISTIC mTsc_DeadZoneExtrapolGrad_XAU16 "fahrzeuggeschwindigkeitsanhï¿½ngige Extrapolations-TBTdiff-Deadzone" CURVE 0x67A8 AblGLKLuw 0.09960938 TORGRAD 0.00 0.09960938 FORMAT "%9.7"
 /begin AXIS_DESCR STD_AXIS vTsc_AbsVehicleSpeedFilt4Interpol_xdu16 VFZHIGH 4 0.00 255.0000 FORMAT "%8.4" DEPOSIT ABSOLUTE /end AXIS_DESCR
/end CHARACTERISTIC
/begin CHARACTERISTIC mTsc_HysteresisTBT_XAU16 "DeadZone TBT Grad: characteristic field dependent on VehicleSpeed and RotorSpeed" MAP 0x67BC AblGLKFuw 0.09960938 TBTHIGH 0.00 0.09960938 FORMAT "%9.7"
 /begin AXIS_DESCR STD_AXIS vTsc_AbsVehicleSpeedFilt4Interpol_xdu16 VFZHIGH 3 0.00 500.0000 FORMAT "%8.4" DEPOSIT ABSOLUTE /end AXIS_DESCR
 /begin AXIS_DESCR STD_AXIS nApplI_AbsRotorSpeedFilt_xdu16 VROT 4 0.00 13000. FORMAT "%3.0" DEPOSIT ABSOLUTE /end AXIS_DESCR
/end CHARACTERISTIC
/begin CHARACTERISTIC mtrcMaxTorGradVehicleMoving_XDU16 "max. Momentengradient wenn Fahrzeug fährt oder bei Fehler Fahrzeuggeschwindigkeit" VALUE 0x61B2 AblGLKWuw 2.499023 TORGRAD 0.0009765625 2.500000 FORMAT "%8.6" /end CHARACTERISTIC
/begin CHARACTERISTIC mtrcMaxTorGradVehicleStanding_XDU16 "max. Momentengradient wenn Fahrzeug steht" VALUE 0x61B4 AblGLKWuw 2.499023 TORGRAD 0.0009765625 2.500000 FORMAT "%8.6" /end CHARACTERISTIC
/begin CHARACTERISTIC nCurrCon_n4IsdLow_GAS16 "Rotation speed as x-axis for the interpolation of the controller parameters in the d-current-controller if v_Fzg lower than vCurrCon_IsxKxVioVehSwitch_GDU16" VAL_BLK 0x4610 rlValuesw 10000 NO_UNIT 0 10000 NUMBER 5 /end CHARACTERISTIC
/begin CHARACTERISTIC nCurrCon_n4Isd_GAS16 "Rotation speed as x-axis for the interpolation of the controller parameters in the d-current-controller if v_Fzg higher than vCurrCon_IsxKxVioVehSwitch_GDU16" VAL_BLK 0x4604 rlValuesw 10000 NO_UNIT 0 10000 NUMBER 5 /end CHARACTERISTIC
/begin CHARACTERISTIC nCurrCon_n4IsqLow_GAS16 "Rotation speed as x-axis for the interpolation of the controller parameters in the q-current-controller if v_Fzg lower than vCurrCon_IsxKxVioVehSwitch_GDU16" VAL_BLK 0x4628 rlValuesw 10000 NO_UNIT 0 10000 NUMBER 5 /end CHARACTERISTIC
/begin CHARACTERISTIC nCurrCon_n4Isq_GAS16 "Rotation speed as x-axis for the interpolation of the controller parameters in the q-current-controller if v_Fzg higher than vCurrCon_IsxKxVioVehSwitch_GDU16" VAL_BLK 0x461C rlValuesw 10000 NO_UNIT 0 10000 NUMBER 5 /end CHARACTERISTIC
/begin CHARACTERISTIC sSmtActrRPC_XCPAisLvlStgRackPosnFr_XDU8 "XCP - Level Zahnstangenpositionsregelung vorne" VALUE 0x6403 AblGLKWub 15.00 ZU0 0.00 15.00 FORMAT "%5.2" /end CHARACTERISTIC
/begin CHARACTERISTIC tSmtActrRPC_CmftFadeOutTiForEmergencyTrajectAndKLA_XDU16 "SCruise fade out Zeit fuer Haltefunktion / KLA und FollowTrajectory Feature" VALUE 0x6238 AblGLKWuw 6.199000 TIMSEC_1000 0.001000000 6.200000 FORMAT "%8.6" /end CHARACTERISTIC
/begin CHARACTERISTIC tSmtActrRPC_EmergencyTrajectDuration_XDU16 "FollowTrajectory Dauer Phase 1: Regelung auf Polynom, nach dieser Zeit erfolgt Halten letzter Wert" VALUE 0x623A AblGLKWuw 3999.000 TIMMS 1.000000 4000.000 FORMAT "%8.3" /end CHARACTERISTIC
/begin CHARACTERISTIC tSmtActrRPC_EmergencyTrajectFutureOffset_XDS16 "Zeit Offset fuer FollowTrajectory" VALUE 0x623C AblGLKWsw 4000.000 TIMMS -2000.000 2000.000 FORMAT "%8.3" /end CHARACTERISTIC
/begin CHARACTERISTIC tSmtActrRPC_EmgyTrajArrSteps_XDU16 "Zeitschrittgroesse der Datenpunkte fuer Array fuer FollowTrajectory" VALUE 0x623E AblGLKWuw 1000.000 TIMMS 0.00 1000.000 FORMAT "%8.3" /end CHARACTERISTIC
/begin CHARACTERISTIC tTsc_SystemDelay_us_XDU16 "System Delay Zeit" VALUE 0x624E AblGLKWuw 10000.00 TIMUS 0.00 10000.00 FORMAT "%8.2" /end CHARACTERISTIC
/begin CHARACTERISTIC vSmtActrRPC_MaxVehSpeedParkingMode_XDU16 "maximale Fahrzeuggeschwindigkeit des Parking Mode" VALUE 0x6298 AblGLKWuw 250.0000 VFZHIGH 0.00 250.0000 FORMAT "%8.4" /end CHARACTERISTIC
/begin CHARACTERISTIC vSteerCtrl_MaxVehSpeedRedDueChatter_XDU16 "maximum vehicle speed to 'SetTorqueRedLevel' due to chattering" VALUE 0x629A AblGLKWuw 255.0000 VFZHIGH 0.00 255.0000 FORMAT "%8.4" /end CHARACTERISTIC
/begin CHARACTERISTIC vTsc_SubstituteSpeed_XDU16 "substitute value for vehicle speed interpolation" VALUE 0x629E AblGLKWuw 500.0000 VFZHIGH 0.00 500.0000 FORMAT "%8.4" /end CHARACTERISTIC
/begin CHARACTERISTIC vTsc_VehicleSpeedHysteresis_XDU16 "Vehicle Speed hysteresis for switching the delay selector" VALUE 0x62A0 AblGLKWuw 15.00000 VFZHIGH 0.00 15.00000 FORMAT "%8.5" /end CHARACTERISTIC
/begin CHARACTERISTIC vTsc_VehicleSpeedLimit4LowSample_XDU16 "Speed limit to change the sample points to calculate the grad" VALUE 0x62A2 AblGLKWuw 500.0000 VFZHIGH 0.00 500.0000 FORMAT "%8.4" /end CHARACTERISTIC
/begin CHARACTERISTIC xCurrCon_IsdKiLow_GAS16 "I-part d-current-controller if v_Fzg lower than vCurrCon_IsxKxVioVehSwitch_GDU16" VAL_BLK 0x4640 rlValuesw 20000 NO_UNIT 0 20000 NUMBER 5 /end CHARACTERISTIC
/begin CHARACTERISTIC xCurrCon_IsdKi_GAS16 "I-part d-current-controller if v_Fzg higher than vCurrCon_IsxKxVioVehSwitch_GDU16" VAL_BLK 0x4634 rlValuesw 20000 NO_UNIT 0 20000 NUMBER 5 /end CHARACTERISTIC
/begin CHARACTERISTIC xCurrCon_IsdKpLow_GAS16 "P-part d-current-controller if v_Fzg lower than vCurrCon_IsxKxVioVehSwitch_GDU16" VAL_BLK 0x4658 rlValuesw 20000 NO_UNIT 0 20000 NUMBER 5 /end CHARACTERISTIC
/begin CHARACTERISTIC xCurrCon_IsdKp_GAS16 "P-part d-current-controller if v_Fzg higher than vCurrCon_IsxKxVioVehSwitch_GDU16" VAL_BLK 0x464C rlValuesw 20000 NO_UNIT 0 20000 NUMBER 5 /end CHARACTERISTIC
/begin CHARACTERISTIC xCurrCon_IsdKvLow_GAS16 "pre-control d-current-controller if v_Fzg lower than vCurrCon_IsxKxVioVehSwitch_GDU16" VAL_BLK 0x4670 rlValuesw 20000 NO_UNIT 0 20000 NUMBER 5 /end CHARACTERISTIC
/begin CHARACTERISTIC xCurrCon_IsdKv_GAS16 "pre-control d-current-controller if v_Fzg higher than vCurrCon_IsxKxVioVehSwitch_GDU16" VAL_BLK 0x4664 rlValuesw 20000 NO_UNIT 0 20000 NUMBER 5 /end CHARACTERISTIC
/begin CHARACTERISTIC xCurrCon_IsqKiLow_GAS16 "I-part q-current-controller if v_Fzg lower than vCurrCon_IsxKxVioVehSwitch_GDU16" VAL_BLK 0x4688 rlValuesw 20000 NO_UNIT 0 20000 NUMBER 5 /end CHARACTERISTIC
/begin CHARACTERISTIC xCurrCon_IsqKi_GAS16 "I-part q-current-controller if v_Fzg higher than vCurrCon_IsxKxVioVehSwitch_GDU16" VAL_BLK 0x467C rlValuesw 20000 NO_UNIT 0 20000 NUMBER 5 /end CHARACTERISTIC
/begin CHARACTERISTIC xCurrCon_IsqKpLow_GAS16 "P-part q-current-controller if v_Fzg lower than vCurrCon_IsxKxVioVehSwitch_GDU16" VAL_BLK 0x46A0 rlValuesw 20000 NO_UNIT 0 20000 NUMBER 5 /end CHARACTERISTIC
/begin CHARACTERISTIC xCurrCon_IsqKp_GAS16 "P-part q-current-controller if v_Fzg higher than vCurrCon_IsxKxVioVehSwitch_GDU16" VAL_BLK 0x4694 rlValuesw 20000 NO_UNIT 0 20000 NUMBER 5 /end CHARACTERISTIC
/begin CHARACTERISTIC xCurrCon_IsqKvLow_GAS16 "pre-control q-current-controller if v_Fzg lower than vCurrCon_IsxKxVioVehSwitch_GDU16" VAL_BLK 0x46B8 rlValuesw 20000 NO_UNIT 0 20000 NUMBER 5 /end CHARACTERISTIC
/begin CHARACTERISTIC xCurrCon_IsqKv_GAS16 "pre-control q-current-controller if v_Fzg higher than vCurrCon_IsxKxVioVehSwitch_GDU16" VAL_BLK 0x46AC rlValuesw 20000 NO_UNIT 0 20000 NUMBER 5 /end CHARACTERISTIC
/begin CHARACTERISTIC xSacHndl_DPartsFactor_XAU16 "Faktor auf D-Anteile abhÃ¤ngig von QFK Kraft" CURVE 0x6C1C AblGLKLuw 1.000000 RIGHTSH14NP 0.00 1.000000 FORMAT "%8.6"
 /begin AXIS_DESCR STD_AXIS kSacHndl_AbsRackForce4DPartsFact_xdu16 FRACK 6 0.00 30000.00 FORMAT "%8.2" DEPOSIT ABSOLUTE /end AXIS_DESCR
/end CHARACTERISTIC
/begin CHARACTERISTIC xSacHndl_FallingFactGrad4DParts_XDU16 "fallende Gradientenbegrenzung fÃ¼r D-Anteilsfaktor pro 1 ms" VALUE 0x6340 AblGLKWuw 0.9998779 RIGHTSH14NP 0.0001220703 1.000000 FORMAT "%8.6" /end CHARACTERISTIC
/begin CHARACTERISTIC xSacHndl_RisingFactGrad4DParts_XDU16 "steigende Gradientenbegrenzung fÃ¼r D-Anteilsfaktor pro 1 ms" VALUE 0x6342 AblGLKWuw 0.9998779 RIGHTSH14NP 0.0001220703 1.000000 FORMAT "%8.6" /end CHARACTERISTIC
/begin CHARACTERISTIC xSigCond_Bandsperre_A2_XDF32 "Parameter Bandsperre A2" VALUE 0x6098 AblGLKWfl4 18.0000000 ZU0 -9.00000000 9.00000000 FORMAT "%10.8" /end CHARACTERISTIC
/begin CHARACTERISTIC xSigCond_Bandsperre_A3_XDF32 "Parameter Bandsperre A3" VALUE 0x609C AblGLKWfl4 18.0000000 ZU0 -9.00000000 9.00000000 FORMAT "%10.8" /end CHARACTERISTIC
/begin CHARACTERISTIC xSigCond_Bandsperre_B2_XDF32 "Parameter Bandsperre B2" VALUE 0x60A0 AblGLKWfl4 18.0000000 ZU0 -9.00000000 9.00000000 FORMAT "%10.8" /end CHARACTERISTIC
/begin CHARACTERISTIC xSigCond_Bandsperre_S1_XDF32 "Parameter Bandsperre S1" VALUE 0x60A4 AblGLKWfl4 18.0000000 ZU0 -9.00000000 9.00000000 FORMAT "%10.8" /end CHARACTERISTIC
/begin CHARACTERISTIC xSigCond_BandstopFact_XAU16 "TBT Bandsperrengewichtungsfaktor" CURVE 0x6D14 AblGLKLuw 1.000000 RIGHTSH10NP 0.00 1.000000 FORMAT "%8.6"
 /begin AXIS_DESCR STD_AXIS vApplI_AbsSteeringAngleSpeed_xdu16 SAS_8 3 0.00 1000.000 FORMAT "%8.3" DEPOSIT ABSOLUTE /end AXIS_DESCR
/end CHARACTERISTIC
/begin CHARACTERISTIC xSigCond_CompTorqueFilterFactor_XAU16 "Faktor für PT1-Filter für Fahrerhandmoment" CURVE 0x6D24 AblGLKLuw 0.9990234 RIGHTSH10NP 0.0009765625 1.000000 FORMAT "%8.6"
 /begin AXIS_DESCR STD_AXIS vApplI_AbsVehicleSpeedFilt_xdu16 VFZHIGH 4 0.00 250.0000 FORMAT "%8.4" DEPOSIT ABSOLUTE /end AXIS_DESCR
/end CHARACTERISTIC
/begin CHARACTERISTIC xSmtActrRPC_EmergencyTrajectCorrFact_XAU16 "Korrekturfaktor auf die angeforderte Zahnstangenposition HandsFree FollowTrajectory" MAP 0x70C0 AblGLKFuw 1.989990 RIGHTSH15NP 0.00 1.989990 FORMAT "%8.6"
 /begin AXIS_DESCR STD_AXIS vApplI_AbsSafeVehicleSpeed_xdu16 VFZHIGH 7 0.00 500.0000 FORMAT "%8.4" DEPOSIT ABSOLUTE /end AXIS_DESCR
 /begin AXIS_DESCR STD_AXIS tSmtActrRPC_EmergencyTrajectTimer_xdu16 TIMMS 6 0.00 3000.000 FORMAT "%8.3" DEPOSIT ABSOLUTE /end AXIS_DESCR
/end CHARACTERISTIC
/begin CHARACTERISTIC xSteerCtrlDFactAuto_XDU16 "D-Factor Auto" VALUE 0x635C AblGLKWuw 2.000000 RIGHTSH14NP 0.00 2.000000 FORMAT "%8.6" /end CHARACTERISTIC
/begin CHARACTERISTIC xSteerCtrlDFactDyn_XDU16 "D-Factor Dynamic" VALUE 0x635E AblGLKWuw 2.000000 RIGHTSH14NP 0.00 2.000000 FORMAT "%8.6" /end CHARACTERISTIC
/begin CHARACTERISTIC xSteerCtrlDFactKom_XDU16 "D-Factor Komfort" VALUE 0x6360 AblGLKWuw 2.000000 RIGHTSH14NP 0.00 2.000000 FORMAT "%8.6" /end CHARACTERISTIC
/begin CHARACTERISTIC xSteerCtrlDOffsetFactAuto_XDU16 "D-Offset Factor Auto" VALUE 0x6362 AblGLKWuw 2.000000 RIGHTSH14NP 0.00 2.000000 FORMAT "%8.6" /end CHARACTERISTIC
/begin CHARACTERISTIC xSteerCtrlDOffsetFactDyn_XDU16 "D-Offset Factor Dynamic" VALUE 0x6364 AblGLKWuw 2.000000 RIGHTSH14NP 0.00 2.000000 FORMAT "%8.6" /end CHARACTERISTIC
/begin CHARACTERISTIC xSteerCtrlDOffsetFactKom_XDU16 "D-Offset Factor Komfort" VALUE 0x6366 AblGLKWuw 2.000000 RIGHTSH14NP 0.00 2.000000 FORMAT "%8.6" /end CHARACTERISTIC
/begin CHARACTERISTIC xSteerCtrlV0DOffsetFactor_XAU16 "d-offset factor depending on steering angle speed v0" CURVE 0x6D7C AblGLKLuw 24.50000 DFACTHIGH 0.5000000 25.00000 FORMAT "%8.5"
 /begin AXIS_DESCR STD_AXIS nApplI_AbsRotorSpeedFilt_xdu16 VROT 10 0.00 13000. FORMAT "%3.0" DEPOSIT ABSOLUTE /end AXIS_DESCR
/end CHARACTERISTIC
/begin CHARACTERISTIC xSteerCtrlV0DPartFactor_XAU16 "d-part factor depending on steering angle speed v0" CURVE 0x6DA8 AblGLKLuw 24.50000 DFACTHIGH 0.5000000 25.00000 FORMAT "%8.5"
 /begin AXIS_DESCR STD_AXIS nApplI_AbsRotorSpeedFilt_xdu16 VROT 10 0.00 13000. FORMAT "%3.0" DEPOSIT ABSOLUTE /end AXIS_DESCR
/end CHARACTERISTIC
/begin CHARACTERISTIC xSteerCtrlV1DOffsetFactor_XAU16 "d-offset factor depending on steering angle speed v1" CURVE 0x6DD4 AblGLKLuw 24.50000 DFACTHIGH 0.5000000 25.00000 FORMAT "%8.5"
 /begin AXIS_DESCR STD_AXIS nApplI_AbsRotorSpeedFilt_xdu16 VROT 10 0.00 13000. FORMAT "%3.0" DEPOSIT ABSOLUTE /end AXIS_DESCR
/end CHARACTERISTIC
/begin CHARACTERISTIC xSteerCtrlV1DPartFactor_XAU16 "d-part factor depending on steering angle speed v1" CURVE 0x6E00 AblGLKLuw 24.50000 DFACTHIGH 0.5000000 25.00000 FORMAT "%8.5"
 /begin AXIS_DESCR STD_AXIS nApplI_AbsRotorSpeedFilt_xdu16 VROT 10 0.00 13000. FORMAT "%3.0" DEPOSIT ABSOLUTE /end AXIS_DESCR
/end CHARACTERISTIC
/begin CHARACTERISTIC xSteerCtrlV2DOffsetFactor_XAU16 "d-offset factor depending on steering angle speed v2" CURVE 0x6E2C AblGLKLuw 24.50000 DFACTHIGH 0.5000000 25.00000 FORMAT "%8.5"
 /begin AXIS_DESCR STD_AXIS nApplI_AbsRotorSpeedFilt_xdu16 VROT 10 0.00 13000. FORMAT "%3.0" DEPOSIT ABSOLUTE /end AXIS_DESCR
/end CHARACTERISTIC
/begin CHARACTERISTIC xSteerCtrlV2DPartFactor_XAU16 "d-part factor depending on steering angle speed v2" CURVE 0x6E58 AblGLKLuw 24.50000 DFACTHIGH 0.5000000 25.00000 FORMAT "%8.5"
 /begin AXIS_DESCR STD_AXIS nApplI_AbsRotorSpeedFilt_xdu16 VROT 10 0.00 13000. FORMAT "%3.0" DEPOSIT ABSOLUTE /end AXIS_DESCR
/end CHARACTERISTIC
/begin CHARACTERISTIC xSteerCtrlV3DOffsetFactor_XAU16 "d-offset factor depending on steering angle speed v3" CURVE 0x6E84 AblGLKLuw 24.50000 DFACTHIGH 0.5000000 25.00000 FORMAT "%8.5"
 /begin AXIS_DESCR STD_AXIS nApplI_AbsRotorSpeedFilt_xdu16 VROT 10 0.00 13000. FORMAT "%3.0" DEPOSIT ABSOLUTE /end AXIS_DESCR
/end CHARACTERISTIC
/begin CHARACTERISTIC xSteerCtrlV3DPartFactor_XAU16 "d-part factor depending on steering angle speed v3" CURVE 0x6EB0 AblGLKLuw 24.50000 DFACTHIGH 0.5000000 25.00000 FORMAT "%8.5"
 /begin AXIS_DESCR STD_AXIS nApplI_AbsRotorSpeedFilt_xdu16 VROT 10 0.00 13000. FORMAT "%3.0" DEPOSIT ABSOLUTE /end AXIS_DESCR
/end CHARACTERISTIC
/begin CHARACTERISTIC xSteerCtrl_ChatterReduction_XAU16 "reduction level in dependency of chatter cycles counter" CURVE 0x6EDC AblGLKLuw 1.000000 RIGHTSH15NP 0.00 1.000000 FORMAT "%8.6"
 /begin AXIS_DESCR STD_AXIS zcrChatterPeriodsCount_xdu8 ZU0 4 0.00 255.0 FORMAT "%5.1" DEPOSIT ABSOLUTE /end AXIS_DESCR
/end CHARACTERISTIC
/begin CHARACTERISTIC xSteerCtrl_DOffsetFactorEndStop_XAU16 "fahrzeuggeschwindigkeitsanhängiger D-Offset-Faktor am Endanschlag (unabhaengig RotorSpeed)" CURVE 0x6EF0 AblGLKLuw 5.000000 DFACTHIGH 0.00 5.000000 FORMAT "%8.6"
 /begin AXIS_DESCR STD_AXIS vSteerCtrl_AbsVehicleSpeedFilt4Interpol_xdu16 VFZHIGH 4 0.00 255.0000 FORMAT "%8.4" DEPOSIT ABSOLUTE /end AXIS_DESCR
/end CHARACTERISTIC
/begin CHARACTERISTIC xSteerCtrl_SubstDOffsetFactChatter_XDU16 "substitute value of D-part offset factor (due to TorsionBarTorqueGradient) if chattering is detected" VALUE 0x6368 AblGLKWuw 25.00000 DFACTHIGH 0.00 25.00000 FORMAT "%8.5" /end CHARACTERISTIC
/begin CHARACTERISTIC xSteerCtrl_SubstDPartFactChatter_XDU16 "substitute value of D-part factor (due to assistance torque) if chattering is detected" VALUE 0x636A AblGLKWuw 25.00000 DFACTHIGH 0.00 25.00000 FORMAT "%8.5" /end CHARACTERISTIC
/begin CHARACTERISTIC xTsc_ExtrapolFactor_XAU16 "fahrzeuggeschwindigkeitsanhï¿½ngiger Extrapolations-Faktor" CURVE 0x6FA4 AblGLKLuw 1.000000 DFACTHIGH 0.00 1.000000 FORMAT "%8.6"
 /begin AXIS_DESCR STD_AXIS vTsc_AbsVehicleSpeedFilt4Interpol_xdu16 VFZHIGH 4 0.00 255.0000 FORMAT "%8.4" DEPOSIT ABSOLUTE /end AXIS_DESCR
/end CHARACTERISTIC
/begin CHARACTERISTIC xTsc_PT1tauGradTBT_XAU16 "fahrzeuggeschwindigkeitsanhï¿½ngige PT1 Filterkonstante GradTBT" CURVE 0x6FB8 AblGLKLuw 1.000000 RIGHTSH10NP 0.00 1.000000 FORMAT "%8.6"
 /begin AXIS_DESCR STD_AXIS vTsc_AbsVehicleSpeedFilt4Interpol_xdu16 VFZHIGH 4 0.00 255.0000 FORMAT "%8.4" DEPOSIT ABSOLUTE /end AXIS_DESCR
/end CHARACTERISTIC
/begin CHARACTERISTIC xTsc_SubstExtrapolFactChatter_XDU16 "substitute value of Extrapol factor if chattering is detected" VALUE 0x637C AblGLKWuw 1.000000 DFACTHIGH 0.00 1.000000 FORMAT "%8.6" /end CHARACTERISTIC
/begin CHARACTERISTIC ySmtActrRPC_DeactivateRackposCtrl_XDU8 "Deaktivierungsschalter fuer SmartActuator RackPositionControl" VALUE 0x643C AblGLKWub 1.000 ZU0 0.00 1.000 FORMAT "%5.3" /end CHARACTERISTIC
/begin CHARACTERISTIC ySmtActrRPC_EnaDTCsBitmask_XDU8 "Bitmaske, um das Setzen der projektspezifischen SCruise DTCs zu aktivieren (Bit gesetzt = DTC aktiviert). Bit 0: DTC_SMTACTRRPC_EMERGENCY_MODE, Bit 1: DTC_SMTACTRRPC_INPUT_ERROR, Bit 2: DTC_SMTACTRRPC_INTERNAL_ERROR, Bit 3: DTC_SMTACTRRPC_CHECK_ERROR" VALUE 0x643D AblGLKWub 15.00 ZU0 0.00 15.00 FORMAT "%5.2" /end CHARACTERISTIC
/begin CHARACTERISTIC ySmtActrRPC_SCruiseCnclCndForDTCBitmask_XDU32 "Bits fuer SCruise CancelConditions, die als Setzbedingung fuer DTC DTC_SMTACTRRPC_INTERNAL_ERROR betrachtet werden." VALUE 0x60B8 AblGLKWul 524287.000000 ZU0 0.00 524287.000000 FORMAT "%13.6" /end CHARACTERISTIC
/begin CHARACTERISTIC zSteerCtrlInterpolCharSelect_XAU16 "selection of vehicle speed dependent characteristic curves" VAL_BLK 0x600C AblGLKWBuw 500.0000 VFZHIGH 0.00 500.0000 FORMAT "%8.4" NUMBER 4 /end CHARACTERISTIC
/begin CHARACTERISTIC zSteerCtrlVehSpeedsForDFading_XAU16 "selection of vehicle speed dependent D-fading curves" VAL_BLK 0x855C AblGLKWBuw 500.0000 VFZHIGH 0.00 500.0000 FORMAT "%8.4" NUMBER 5 /end CHARACTERISTIC
/begin CHARACTERISTIC zSteerCtrlVehSpeedsForDOffsetFading_XAU16 "selection of vehicle speed dependent D-Offset fading curves" VAL_BLK 0x8568 AblGLKWBuw 500.0000 VFZHIGH 0.00 500.0000 FORMAT "%8.4" NUMBER 5 /end CHARACTERISTIC
/begin CHARACTERISTIC zSteerCtrl_ChatteringDetected_XDU8 "chatter periods counter threshold to detect chattering (shall be identically to zcrMinChatterPeriodsCountDelayed_XDU8)" VALUE 0x644F AblGLKWub 30.00 ZU0 0.00 30.00 FORMAT "%5.2" /end CHARACTERISTIC
/begin CHARACTERISTIC zTsc_ChatteringDetected_XDU8 "chatter periods counter threshold to detect chattering (like zSteerCtrl_ChatteringDetected_XDU8 and zcrMinChatterPeriodsCountDelayed_XDU8)" VALUE 0x6450 AblGLKWub 30.00 ZU0 0.00 30.00 FORMAT "%5.2" /end CHARACTERISTIC
/begin CHARACTERISTIC zTsc_TBTDiffDelaySelector_XAU8 "Time difference for calculate gradient" VAL_BLK 0x80CC24 AblGLKWBub 7.000 ZU0 0.00 7.000 FORMAT "%5.3" NUMBER 2 /end CHARACTERISTIC
/*********** End of merged CHARACTERISTIC blocks ***********/ /*********** Start of merged AXIS_PTS blocks ***********/
/begin AXIS_PTS EAF_V_FZG_EAF_PHIOFFSET_XI16 "x Stuetzstellen fuer lEndStop_VehicleSpeedDepOffset_xdu16 " 0x82AA eaf_vFzgHystFilt_mi16 AblGLSstuw 327 VFZHIGH 5 0 327 FORMAT "%8.4" DEPOSIT ABSOLUTE SYMBOL_LINK "lEndStop_VehicleSpeedDepOffset_XAU16" 2 /end AXIS_PTS
/begin AXIS_PTS LKU_F_LOOKUP_V1_XI16 "X-Array fuer V0 Kennlinie" 0x8230 matAbsTorsionBarTorque_xdu16 AblGLSstuw 20 TBTHIGH 10 0 20 DEPOSIT ABSOLUTE SYMBOL_LINK "mBci_V0TbtArray_XAU16" 0 /end AXIS_PTS
/begin AXIS_PTS LKU_F_LOOKUP_V2_XI16 "X-Array fuer V1 Kennlinie" 0x8244 matAbsTorsionBarTorque_xdu16 AblGLSstuw 20 TBTHIGH 10 0 20 DEPOSIT ABSOLUTE SYMBOL_LINK "mBci_V1TbtArray_XAU16" 0 /end AXIS_PTS
/begin AXIS_PTS LKU_F_LOOKUP_V3_XI16 "X-Array fuer V2 Kennlinie" 0x8258 matAbsTorsionBarTorque_xdu16 AblGLSstuw 20 TBTHIGH 10 0 20 DEPOSIT ABSOLUTE SYMBOL_LINK "mBci_V2TbtArray_XAU16" 0 /end AXIS_PTS
/begin AXIS_PTS LKU_F_LOOKUP_V4_XI16 "X-Array fuer V3 Kennlinie" 0x826C matAbsTorsionBarTorque_xdu16 AblGLSstuw 20 TBTHIGH 10 0 20 DEPOSIT ABSOLUTE SYMBOL_LINK "mBci_V3TbtArray_XAU16" 0 /end AXIS_PTS
/begin AXIS_PTS LKU_F_LOOKUP_V5_XI16 "X-Array fuer V4 Kennlinie" 0x8280 matAbsTorsionBarTorque_xdu16 AblGLSstuw 20 TBTHIGH 10 0 20 DEPOSIT ABSOLUTE SYMBOL_LINK "mBci_V4TbtArray_XAU16" 0 /end AXIS_PTS
/begin AXIS_PTS LKU_F_LOOKUP_V6_XI16 "X-Array fuer V5 Kennlinie" 0x8294 matAbsTorsionBarTorque_xdu16 AblGLSstuw 20 TBTHIGH 10 0 20 DEPOSIT ABSOLUTE SYMBOL_LINK "mBci_V5TbtArray_XAU16" 0 /end AXIS_PTS
/*********** End of merged AXIS_PTS blocks ***********/ /*********** Start of merged MEASUREMENT blocks ***********/
/begin MEASUREMENT ApplI_EcuState_error "variable for the error state of ECU" UBYTE ECU_STATE 0 0 0 8 ECU_ADDRESS 0xFE9F8D99 SYMBOL_LINK "sApplI_EcuState_xdu8" 0 /end MEASUREMENT
/begin MEASUREMENT ApplI_HWLMaxUsableTorque "It will give the maximum usuable torque" FLOAT32_IEEE ZU0 0 0 -20 20 ECU_ADDRESS 0xFEE9AE94 SYMBOL_LINK "mApplI_HWLMaxUsableTorque_xdf32" 0 /end MEASUREMENT
/begin MEASUREMENT BSW_PHI_OFFSET_IDX_GERADEAUS_AI16 "Kalibrieroffset auf Index bezogen" SWORD ROT2SA 0 0 -32768 32768 ECU_ADDRESS 0xFE9F8B10 SYMBOL_LINK "wRpSync_CalibCtrlOffsetCalibIdx_xds16" 0 /end MEASUREMENT
/begin MEASUREMENT LKU_VFZG_1_AU16 "geschwindigkeitsabhaengige BasicSteerTorque-Kennlinienauswahl" UWORD VFZHIGH 0 0 0 500 ECU_ADDRESS 0x8224 SYMBOL_LINK "zBci_AssistCurveSelect_XAU16" 0 /end MEASUREMENT
/begin MEASUREMENT LKU_VFZG_2_AU16 "geschwindigkeitsabhaengige BasicSteerTorque-Kennlinienauswahl" UWORD VFZHIGH 0 0 0 500 ECU_ADDRESS 0x8226 SYMBOL_LINK "zBci_AssistCurveSelect_XAU16" 2 /end MEASUREMENT
/begin MEASUREMENT LKU_VFZG_3_AU16 "geschwindigkeitsabhaengige BasicSteerTorque-Kennlinienauswahl" UWORD VFZHIGH 0 0 0 500 ECU_ADDRESS 0x8228 SYMBOL_LINK "zBci_AssistCurveSelect_XAU16" 4 /end MEASUREMENT
/begin MEASUREMENT LKU_VFZG_4_AU16 "geschwindigkeitsabhaengige BasicSteerTorque-Kennlinienauswahl" UWORD VFZHIGH 0 0 0 500 ECU_ADDRESS 0x822A SYMBOL_LINK "zBci_AssistCurveSelect_XAU16" 6 /end MEASUREMENT
/begin MEASUREMENT LKU_VFZG_5_AU16 "geschwindigkeitsabhaengige BasicSteerTorque-Kennlinienauswahl" UWORD VFZHIGH 0 0 0 500 ECU_ADDRESS 0x822C SYMBOL_LINK "zBci_AssistCurveSelect_XAU16" 8 /end MEASUREMENT
/begin MEASUREMENT LKU_VFZG_6_AU16 "geschwindigkeitsabhaengige BasicSteerTorque-Kennlinienauswahl" UWORD VFZHIGH 0 0 0 500 ECU_ADDRESS 0x822E SYMBOL_LINK "zBci_AssistCurveSelect_XAU16" 10 /end MEASUREMENT
/begin MEASUREMENT ROU_PHI_CALIBRANGE_AU8 "Winkelbereich (+-) um die mechanische Mitte, innerhalb dessen ein Kalibrierungsoffsetwinkel zulaessig ist.\\nBeispiel:\\nWinkelbereich -20 degree  und +20 degree  -> =40\\n - mapped with wRpSync_MaxRotorAngleForCalib_XDU16" UBYTE ROU_PHI_CALIBRANGE_AU8.CONVERSIONV 0 0 0 60 FORMAT "%6.2" /begin VIRTUAL basm_MaxRotAngForCalib_mu16 /end VIRTUAL /end MEASUREMENT
/begin MEASUREMENT ROU_PHI_REGDIF_ABBMAX_AU8 "Wert fuer das Abbruchkriterium  LW Regelabweichung - mapped with lDthrCtrl_RackPosDiffMax_XDU16" UBYTE ROU_PHI_REGDIF_ABBMAX_AU8.CONVERSIONV 0 0 0 60 FORMAT "%6.5" /begin VIRTUAL basm_RackPosDiffMax_mu16 /end VIRTUAL /end MEASUREMENT
/begin MEASUREMENT ROU_R_SWEAMOT_AU8 "Verhaeltnis aus maximalen Motormoment und min. erforderlichen Motormoment zur Erkennung des Softwareendanschlags - mapped mEndStop_uMotorTorque_XDU16 and ApplI_HWLMaxUsableTorque" FLOAT32_IEEE RATIOMaxT2EndStopT 0 0 0 200 FORMAT "%4.1" /begin VIRTUAL mEndStop_uMotorTorque_XDU16 ApplI_HWLMaxUsableTorque /end VIRTUAL /end MEASUREMENT
/begin MEASUREMENT Rou_CalStatus "" UBYTE ZU0 1 100 0 3 FORMAT "%3.1" ECU_ADDRESS 0xFE9F8EB2 SYMBOL_LINK "sRpSync_CalibState_xdu8" 0 /end MEASUREMENT
/begin MEASUREMENT Rou_Calib "Status of calibration" UBYTE Rou_Calib.Conversion 0 0 0 1 FORMAT "%6.2" /begin VIRTUAL Rou_CalStatus /end VIRTUAL /end MEASUREMENT
/begin MEASUREMENT Rou_Init "Status of SA init" UBYTE Rou_Init.Conversion 0 0 0 1 FORMAT "%6.2" /begin VIRTUAL sApplI_SteeringAngleLinState_xdu8 /end VIRTUAL /end MEASUREMENT
/begin MEASUREMENT Rou_SWEA "Status of EndStop learning" UBYTE Rou_SWEA.Conversion 0 0 0 1 FORMAT "%6.2" /begin VIRTUAL bsw_ILearnSeaLeft_mu16 bsw_ILearnSeaRight_mu16 /end VIRTUAL /end MEASUREMENT
/begin MEASUREMENT VehicleRunning_State "It will tell Vehicle State(0 = stop; 1 = Moving) - mapped sApplI_VehicleRunning_xdu8" UBYTE ZU0 0 0 0 1 ECU_ADDRESS 0xFE9F8DA3 SYMBOL_LINK "sApplI_VehicleRunning_xdu8" 0 /end MEASUREMENT
/begin MEASUREMENT VehicleSpeed_State "It will tell VehicleSpeed State(1 = valid; 0 = invalid or substitute speed) - mapped sApplI_VehicleSpeedState_xdu8" UBYTE ZU0 0 0 0 1 ECU_ADDRESS 0xFE9F8DA4 SYMBOL_LINK "sApplI_VehicleSpeedState_xdu8" 0 /end MEASUREMENT
/begin MEASUREMENT ars_phiRitzelSum_mi16 "korrigierter Lenkwinkel - mapped wApplI_SteeringAngle_xds16" SWORD SA_10 1 100 -1000 1000 FORMAT "%8.3" ECU_ADDRESS 0xFE9F8AD0 SYMBOL_LINK "wApplI_SteeringAngle_xds16" 0 /end MEASUREMENT
/begin MEASUREMENT asc_fSoll_mi16 " mapped to kBbaAscInI_RackForce_xds16" SWORD FRACK 1 100 -32768 32767 FORMAT "%6.4" ECU_ADDRESS 0xFE9F87E2 SYMBOL_LINK "kBbaAscInI_RackForce_xds16" 0 /end MEASUREMENT
/begin MEASUREMENT asc_facReduzlku_mu16 "Autosar-Software-Interface actual assist reduction factor - mapped xBbaAscInI_AscAssistRedFactor_xdu16" UWORD RIGHTSH14NP 1 100 0 3.999939 FORMAT "%8.6" ECU_ADDRESS 0xFE9F8B4C SYMBOL_LINK "xBbaAscInI_AscAssistRedFactor_xdu16" 0 /end MEASUREMENT
/begin MEASUREMENT asc_facReduztrq_mu16 "Autosar-Software-Interface actual torsion bar torque reduction factor - mapped xBbaAscInI_AscToBaToRedFactor_xdu16" UWORD RIGHTSH14NP 1 100 0 3.999939 FORMAT "%8.6" ECU_ADDRESS 0xFE9F8B4E SYMBOL_LINK "xBbaAscInI_AscToBaToRedFactor_xdu16" 0 /end MEASUREMENT
/begin MEASUREMENT bas_WakeupCondition_mu8 "Wake up condition and current state of the wake up sources - mapped sHwlI_WakeUpCondition_gde" UBYTE ZU0 1 100 0 255 ECU_ADDRESS 0xFEEA3570 SYMBOL_LINK "sHwlI_WakeUpCondition_gde" 0 /end MEASUREMENT
/begin MEASUREMENT bas_customercoding1_mu32 "Customer coding1  mapped -yeeVehCustomCod1_xdu32" ULONG ZU0 0 0 0 4294967295 ECU_ADDRESS 0xFE9F8698 SYMBOL_LINK "yeeVehCustomCod1_xdu32" 0 /end MEASUREMENT
/begin MEASUREMENT bas_customercoding2_mu32 "Customer Coding2 - mapped yCustomerDataSupp_ActivatedAdaptations_xdu32" ULONG ZU0 0 0 0 4294967295 ECU_ADDRESS 0xFE9F8630 SYMBOL_LINK "yCustomerDataSupp_ActivatedAdaptations_xdu32" 0 /end MEASUREMENT
/begin MEASUREMENT bas_state4AscDsa_mu8 "Status von SAC an ASC DSA - mapped sBbaSacInI_State4AscDsa_xdu8" UBYTE ZU0 0 0 0 255 ECU_ADDRESS 0xFE9F8DD2 SYMBOL_LINK "sBbaSacInI_State4AscDsa_xdu8" 0 /end MEASUREMENT
/begin MEASUREMENT bas_state4AscTsc_mu8 "Status von SAC an ASC TSC - mapped sBbaSacInI_State4AscTsc_xdu8" UBYTE ZU0 0 0 0 255 ECU_ADDRESS 0xFE9F8DD3 SYMBOL_LINK "sBbaSacInI_State4AscTsc_xdu8" 0 /end MEASUREMENT
/begin MEASUREMENT basm_ChkHandsOnTrq_mu16 "mapped with mDthrCtrl_CheckHandsOnTorqLim_XDU16" UWORD TBTHIGH 0 0 0.5 12 FORMAT "%4.5" ECU_ADDRESS 0x80CB90 SYMBOL_LINK "mDthrCtrl_CheckHandsOnTorqLim_XDU16" 0 /end MEASUREMENT
/begin MEASUREMENT basm_LimMotTorq_mu32 "mapped with mHwlI_LimitedMotorTorque_gdf32" FLOAT32_IEEE TORQ_REAL 0 0 -12 12 ECU_ADDRESS 0xFEEA30CC SYMBOL_LINK "mHwlI_LimitedMotorTorque_gdf32" 0 /end MEASUREMENT
/begin MEASUREMENT basm_MaxRotAngForCalib_mu16 "mapped with wRpSync_MaxRotorAngleForCalib_XDU16" UWORD SA 0 0 0 1000 FORMAT "%6.2" ECU_ADDRESS 0x80D1B2 SYMBOL_LINK "wRpSync_MaxRotorAngleForCalib_XDU16" 0 /end MEASUREMENT
/begin MEASUREMENT basm_MaxVehicleSpeedGradient_mu8 "mapped with vVehSp_MaxVehicleSpeedGradient_XDU8" UBYTE VFZHIGH 0 0 0 3.984 ECU_ADDRESS 0x80CC2F SYMBOL_LINK "vVehSp_MaxVehicleSpeedGradient_XDU8" 0 /end MEASUREMENT
/begin MEASUREMENT basm_MotTorqThreshold_mu16 "mapped with mDthrCtrl_MotTorqThresholdEsUds_XDU16" UWORD MMOT 0 0 0 6 ECU_ADDRESS 0x6138 SYMBOL_LINK "mDthrCtrl_MotTorqThresholdEsUds_XDU16" 0 /end MEASUREMENT
/begin MEASUREMENT basm_RackPosDiffMax_mu16 "mapped with lDthrCtrl_RackPosDiffMax_XDU16" UWORD RACKPOS128 0 0 0 100 ECU_ADDRESS 0x60FE SYMBOL_LINK "lDthrCtrl_RackPosDiffMax_XDU16" 0 /end MEASUREMENT
/begin MEASUREMENT basm_RotAngRange4CalibJob_mu16 "mapped wRpSync_RotAngRange4CalibJob_XDU16" UWORD ANGLE_1 0 0 0 16000 ECU_ADDRESS 0x62BC SYMBOL_LINK "wRpSync_RotAngRange4CalibJob_XDU16" 0 /end MEASUREMENT
/begin MEASUREMENT bsw_ILearnSeaLeft_mu16 " - mapped sEndStopI_LearnStatLeft_xdu8" UBYTE ZU0 0 0 0 2 ECU_ADDRESS 0xFE9F8E0B SYMBOL_LINK "sEndStopI_LearnStatLeft_xdu8" 0 /end MEASUREMENT
/begin MEASUREMENT bsw_ILearnSeaRight_mu16 " - mapped sEndStopI_LearnStatRight_xdu8" UBYTE ZU0 0 0 0 2 ECU_ADDRESS 0xFE9F8E0C SYMBOL_LINK "sEndStopI_LearnStatRight_xdu8" 0 /end MEASUREMENT
/begin MEASUREMENT bsw_fSollLimMtl_mi16 "limited motor torque by motortorquelimiter- mapped to mMotTorLimI_ValidatedMotorTorque_xds16" SWORD NM2N_GEARSIGN 0 0 -32844 32844 ECU_ADDRESS 0xFE9F8918 SYMBOL_LINK "mMotTorLimI_ValidatedMotorTorque_xds16" 0 /end MEASUREMENT
/begin MEASUREMENT bsw_iBat_mi16 "HW LIB: Batterie Strom ohne Prozessor Strom - mapped iApplI_BatteryCurrent_xds16" SWORD SM_I 1 100 -150 150 ECU_ADDRESS 0xFEE9AECC SYMBOL_LINK "iApplI_BatteryCurrent_xds16" 0 /end MEASUREMENT
/begin MEASUREMENT bsw_iKlemme30_mi16 " - mapped iApplI_BatteryCurrent_xds16" SWORD SM_I 1 100 -150 150 ECU_ADDRESS 0xFEE9AECC SYMBOL_LINK "iApplI_BatteryCurrent_xds16" 0 /end MEASUREMENT
/begin MEASUREMENT bsw_levelAssist_mu8 "Moegliches Unterstuetzungsniveau 0% bis 100 % - mapped xWlcI_ReductionLevel_xdu16" UWORD RSH15 1 100 0 100 ECU_ADDRESS 0xFE9F8C1A SYMBOL_LINK "xWlcI_ReductionLevel_xdu16" 0 /end MEASUREMENT
/begin MEASUREMENT bsw_mskStatusbits01_mu32 "Autosar Statusbitleiste 1 - mapped yBbaAscOut_mskStatusbits01_xdu32" ULONG ZU0 1 100 0 4294967295 ECU_ADDRESS 0xFE9F8610 SYMBOL_LINK "yBbaAscOut_mskStatusbits01_xdu32" 0 /end MEASUREMENT
/begin MEASUREMENT bsw_mskStatusbits02_mu32 "Autosar Statusbitleiste 2 - mapped yBbaAscOut_mskStatusbits02_xdu32" ULONG ZU0 1 100 0 4294967295 ECU_ADDRESS 0xFE9F8614 SYMBOL_LINK "yBbaAscOut_mskStatusbits02_xdu32" 0 /end MEASUREMENT
/begin MEASUREMENT bsw_nMotor_mi16 "Gefilterte Rotorgeschwindigkeit - mapped to nApplI_RotorSpeedFilt_xds16" SWORD VROT 1 100 -13000 13000 FORMAT "%6.4" ECU_ADDRESS 0xFE9F89A0 SYMBOL_LINK "nApplI_RotorSpeedFilt_xds16" 0 /end MEASUREMENT
/begin MEASUREMENT bsw_nivUnterstuetzungReq_mu16 "This signal is responsible for Current steering assistance demanded by the steering system (quotient of actual engine set point torque / maximum possible engine set point torque. Unterstuetzungsleistung - mapped xWlcI_ReductionLevel_xdu16" UWORD RIGHTSH15NP 0 0 0 1 FORMAT "%8.6" ECU_ADDRESS 0xFE9F8C1A SYMBOL_LINK "xWlcI_ReductionLevel_xdu16" 0 /end MEASUREMENT
/begin MEASUREMENT bsw_phiRitzelInput_mi32 "realer (i-variaber korrigierter) Ritzelwinkel - mapped wRackPoI_PinionAngleReal_xds16" SWORD SA_10 1 100 -1000 1000 ECU_ADDRESS 0xFE9F8AE6 SYMBOL_LINK "wRackPoI_PinionAngleReal_xds16" 0 /end MEASUREMENT
/begin MEASUREMENT bsw_phiRitzelMotor_mi16 "Motorlage aus Motorlagesensor - mapped wApplI_RelRotorPosition_xdu16" UWORD ROTPOS 1 100 0 512 ECU_ADDRESS 0xFEE9AF28 SYMBOL_LINK "wApplI_RelRotorPosition_xdu16" 0 /end MEASUREMENT
/begin MEASUREMENT fSacHndlI_SacDeactivated_xdu8 "Flag: 1 = Freischnitt deaktiviert, Flag:0 = Freischnit aktiviert" UBYTE ZU0 1 100 0.00 1.000 FORMAT "%5.3" ECU_ADDRESS 0xFE9F8D5E /end MEASUREMENT
/begin MEASUREMENT fSacHndl_CheckVibration_xdu8 "Check Vibration" UBYTE ZU0 1 100 0.00 1.000 FORMAT "%5.3" ECU_ADDRESS 0xFE9F8D5F /end MEASUREMENT
/begin MEASUREMENT fSacHndl_PlausiSacDeactivated_xdu8 "Flag: 1 = SAC-Deaktivierung durch Plausi-Ausfall , Flag 0 = SAC-Deaktivierung/Aktivierung unabhï¿½ngig von Plausi" UBYTE ZU0 1 100 0.00 1.000 FORMAT "%5.3" ECU_ADDRESS 0xFE9F8D62 /end MEASUREMENT
/begin MEASUREMENT fSmtActrRPCCheckI_ReqdRackPosnMonSafeOK_xdb "Safety Status angeforderte, interpolierte Zahnstangenposition (1- OK, sonst ERROR)" UWORD STATUS 1 100 0.00 1.000 FORMAT "%5.3" BIT_MASK 0x1 ECU_ADDRESS 0xFE9F8D72 /end MEASUREMENT
/begin MEASUREMENT fSmtActrRPCCheckI_ReqdStateMonSafeOK_xdb "Safety Status des angefordertern Modus (1- OK, sonst ERROR)" UWORD STATUS 1 100 0.00 1.000 FORMAT "%5.3" BIT_MASK 0x1 ECU_ADDRESS 0xFE9F8D73 /end MEASUREMENT
/begin MEASUREMENT fSmtActrRPCCheckI_RotPosArrayMonSafeOK_xdb "Safety Status des Emergency Trajectory Array (1- OK, sonst ERROR)" UWORD STATUS 1 100 0.00 1.000 FORMAT "%5.3" BIT_MASK 0x1 ECU_ADDRESS 0xFE9F8D74 /end MEASUREMENT
/begin MEASUREMENT fSmtActrRPCCheckI_SelQFKMonSafeOK_xdb "Safety Status des EPS_SelQFK (1- OK, sonst ERROR)" UWORD STATUS 1 100 0.00 1.000 FORMAT "%5.3" BIT_MASK 0x1 ECU_ADDRESS 0xFE9F8D75 /end MEASUREMENT
/begin MEASUREMENT fTscI_Use_GradXtplTBT_xdb "mApplI_GradTorsionBarTorque_xds16 = (0:mTsc_FiltGradTBT_xds16, 1:mTsc_FiltGradXtplTBT_xds16)" UBYTE STATUS 1 100 0.00 1.000 FORMAT "%5.3" BIT_MASK 0x1 ECU_ADDRESS 0xFE9F8D81 /end MEASUREMENT
/begin MEASUREMENT kSacHndl_AbsRackForce4DPartsFact_xdu16 "aufbereitete QFK Zahnstangenkraft fÃ¼r Faktorkennlinie" UWORD FRACK 1 100 0.00 65535.00 FORMAT "%8.2" ECU_ADDRESS 0xFE9F87EE /end MEASUREMENT
/begin MEASUREMENT kSacHndl_CalcVibrationRackForce_xds16 "Berechnet Vibrationskraft" SWORD FRACK 1 100 -32768.00 32767.00 FORMAT "%8.2" ECU_ADDRESS 0xFE9F87F0 /end MEASUREMENT
/begin MEASUREMENT lEpsInI_SCruiseReqdRackPosn_xds32 "SCruise angeforderte Zahnstangenposition" SLONG RACKPOS256 1 100 -127.789062500 127.792968750 FORMAT "%13.9" ECU_ADDRESS 0xFE9F843C /end MEASUREMENT
/begin MEASUREMENT lSmtActrRPCCheck_ReqdRackPosnCalc_xdf32 "Berechnete angeforderte Zahnstangenposition der Check Komponente" FLOAT32_IEEE ZU0 1 100 -127.787400 127.791300 FORMAT "%10.6" ECU_ADDRESS 0xFE9F8460 /end MEASUREMENT
/begin MEASUREMENT lSmtActrRPCI_SCruiseReqdRackPosn4Check_xdf32 "SCruise angeforderte Zahnstangenposition vor Check" FLOAT32_IEEE ZU0 1 100 -127.787400 127.791300 FORMAT "%10.6" ECU_ADDRESS 0xFE9F8464 /end MEASUREMENT
/begin MEASUREMENT mApplI_GradTorsionBarTorque_xds16 "HW LIB: Drehmomentgradient" SWORD TORGRAD 1 100 -25.00000 25.00000 FORMAT "%8.5" ECU_ADDRESS 0xFE9F887A /end MEASUREMENT
/begin MEASUREMENT mApplI_RequestedMotorTorque_xds16 "Angefordertes Motormoment" SWORD MMOT 1 100 -12.00000 12.00000 FORMAT "%8.5" ECU_ADDRESS 0xFEE9AED8 /end MEASUREMENT
/begin MEASUREMENT mApplI_TorsionBarTorque_xds16 "HW LIB: Drehstabmoment" SWORD TBTHIGH 1 100 -25.00000 25.00000 FORMAT "%8.5" ECU_ADDRESS 0xFEE9AEDC /end MEASUREMENT
/begin MEASUREMENT mSCruiseI_MotTrq_xds16 "MotorTorque requested by the SCruiseController" SWORD MMOT 1 100 -12.00000 12.00000 FORMAT "%8.5" ECU_ADDRESS 0xFE9F8954 /end MEASUREMENT
/begin MEASUREMENT mSacHndlI_YawTorqueRequest_xds16 "Giermomentenanforderung an die Bremse " SWORD TRQ2 1 100 -2500.000 2500.000 FORMAT "%8.3" ECU_ADDRESS 0xFE9F8932 /end MEASUREMENT
/begin MEASUREMENT mSacHndl_MMotOffsetGearSignQHM_xds32 "Berechnetes Offset Motor Torque QPR mit GearSign" SLONG MMOT 1 100 -12.0000000000 12.0000000000 FORMAT "%13.10" ECU_ADDRESS 0xFE9F84AC /end MEASUREMENT
/begin MEASUREMENT mSacHndl_MMotOffsetGearSignQPR_xds32 "Berechnetes Offset Motor Torque QPR mit GearSign" SLONG MMOT 1 100 -12.0000000000 12.0000000000 FORMAT "%13.10" ECU_ADDRESS 0xFE9F84B0 /end MEASUREMENT
/begin MEASUREMENT mSacHndl_MotorTorqueOffsetQHM_xds32 "Berechnetes Offset Motor Torque QHM" SLONG RIGHTSH24NP 1 100 -12.0000000000 12.0000000000 FORMAT "%13.10" ECU_ADDRESS 0xFE9F84B4 /end MEASUREMENT
/begin MEASUREMENT mSacHndl_MotorTorqueOffsetQPR_xds32 "Berechnetes Offset Motor Torque QPR" SLONG RIGHTSH24NP 1 100 -12.0000000000 12.0000000000 FORMAT "%13.10" ECU_ADDRESS 0xFE9F84B8 /end MEASUREMENT
/begin MEASUREMENT mSigCondI_BandPT1TBT_xds16 "Drehstabmoment mit Bandfilter und PT1 gefiltert" SWORD TBTHIGH 1 100 -25.00000 25.00000 FORMAT "%8.5" ECU_ADDRESS 0xFE9F8962 /end MEASUREMENT
/begin MEASUREMENT mSigCondI_BandStopTBT_xds16 "Drehstabmoment mit Bandfilter" SWORD TBTHIGH 1 100 -25.00000 25.00000 FORMAT "%8.5" ECU_ADDRESS 0xFE9F8964 /end MEASUREMENT
/begin MEASUREMENT mSigCondI_CondTorsionBarTorque_xds16 "Drehstabmoment mit Bandfilter, PT1 gefiltert und Trägheitskompensiert" SWORD TBTHIGH 1 100 -25.00000 25.00000 FORMAT "%8.5" ECU_ADDRESS 0xFE9F8966 /end MEASUREMENT
/begin MEASUREMENT mSteerCtrlAbsAtRawD_xdu16 "Absolute Raw D-part calculated out of the assistance torque" UWORD MMOT 1 100 0.00 25.00000 FORMAT "%8.5" ECU_ADDRESS 0xFE9F878A /end MEASUREMENT
/begin MEASUREMENT mSteerCtrlAbsStRawDOffset_xdu16 "Absolute Raw D offset calculated out of GradTorsionBarTorque" UWORD MMOT 1 100 0.00 25.00000 FORMAT "%8.5" ECU_ADDRESS 0xFE9F878C /end MEASUREMENT
/begin MEASUREMENT mSteerCtrlAtRawD_xds32 "Raw D-part calculated out of the assistance torque" SLONG MMOT 1 100 -25.0000000000 25.0000000000 FORMAT "%13.10" ECU_ADDRESS 0xFE9F8408 /end MEASUREMENT
/begin MEASUREMENT mSteerCtrlDFadingXAxis_xau16 "x-node of interpolated characteristic curve (D Fading Torque)" UWORD MMOT 1 100 0.00 25.00000 FORMAT "%8.5" ECU_ADDRESS 0xFE9F9118 MATRIX_DIM 8 1 1 /end MEASUREMENT
/begin MEASUREMENT mSteerCtrlDFadingYAxis_xau16 "y-node of interpolated characteristic curve (D Fading-factor)" UWORD MMOT 1 100 0.00 25.00000 FORMAT "%8.5" ECU_ADDRESS 0xFE9F9128 MATRIX_DIM 8 1 1 /end MEASUREMENT
/begin MEASUREMENT mSteerCtrlDOffsetFadingXAxis_xau16 "x-node of interpolated characteristic curve (DOffset Fading Torque)" UWORD MMOT 1 100 0.00 25.00000 FORMAT "%8.5" ECU_ADDRESS 0xFE9F9138 MATRIX_DIM 8 1 1 /end MEASUREMENT
/begin MEASUREMENT mSteerCtrlDOffsetFadingYAxis_xau16 "y-node of interpolated characteristic curve (DOffset Fading-factor)" UWORD MMOT 1 100 0.00 25.00000 FORMAT "%8.5" ECU_ADDRESS 0xFE9F9148 MATRIX_DIM 8 1 1 /end MEASUREMENT
/begin MEASUREMENT mSteerCtrlStRawDOffset_xds32 "Raw D offset calculated out of GradTorsionBarTorque" SLONG MMOT 1 100 -25.0000000000 25.0000000000 FORMAT "%13.10" ECU_ADDRESS 0xFE9F840C /end MEASUREMENT
/begin MEASUREMENT mSteerCtrl_DOffset_xds16 "D-part offset calculated out of GradTorsionBarTorque" SWORD MMOT 1 100 -8.000000 8.000000 FORMAT "%8.6" ECU_ADDRESS 0xFE9F8790 /end MEASUREMENT
/begin MEASUREMENT mSteerCtrl_DPart_xds16 "D-part calculated out of the assistance torque" SWORD MMOT 1 100 -8.000000 8.000000 FORMAT "%8.6" ECU_ADDRESS 0xFE9F8792 /end MEASUREMENT
/begin MEASUREMENT mTscI_ExtrapolTBT_xds16 "Extrapoliertes Drehstabmoment" SWORD TBTHIGH 1 100 -25.00000 25.00000 FORMAT "%8.5" ECU_ADDRESS 0xFE9F8980 /end MEASUREMENT
/begin MEASUREMENT mTscI_HysteresisTBT_xdu16 "HysteresisTBT: DeadZone TBT Grad" UWORD TBTHIGH 1 100 0.00 0.09960938 FORMAT "%9.7" ECU_ADDRESS 0xFE9F8982 /end MEASUREMENT
/begin MEASUREMENT mTscI_TorsionBarTorque_xds16 "Drehstabmoment" SWORD TBTHIGH 1 100 -25.00000 25.00000 FORMAT "%8.5" ECU_ADDRESS 0xFE9F8984 /end MEASUREMENT
/begin MEASUREMENT mTsc_DeadZoneExtrapolGrad_xdu16 "fahrzeuggeschwindigkeitsanhï¿½ngige Extrapolations-TBTdiff-Deadzone" UWORD TORGRAD 1 100 0.00 5.000000 FORMAT "%8.6" ECU_ADDRESS 0xFE9F8988 /end MEASUREMENT
/begin MEASUREMENT mTsc_FiltGradTBT_xds16 "Gradient HwlTBT" SWORD TORGRAD 1 100 -25.00000 25.00000 FORMAT "%8.5" ECU_ADDRESS 0xFE9F8992 /end MEASUREMENT
/begin MEASUREMENT mTsc_FiltGradXtplTBT_xds16 "Gradient Extrapolierte TBT" SWORD TORGRAD 1 100 -25.00000 25.00000 FORMAT "%8.5" ECU_ADDRESS 0xFE9F8994 /end MEASUREMENT
/begin MEASUREMENT mTsc_HystTorsionBarTorque_xds16 "TBT nach Hysteresefilter" SWORD TBTHIGH 1 100 -25.00000 25.00000 FORMAT "%8.5" ECU_ADDRESS 0xFE9F879C /end MEASUREMENT
/begin MEASUREMENT mTsc_HystXtplTorsionBarTorque_xds16 "Extrapolierte TBT nach Hysteresefilter" SWORD TBTHIGH 1 100 -25.00000 25.00000 FORMAT "%8.5" ECU_ADDRESS 0xFE9F879E /end MEASUREMENT
/begin MEASUREMENT nTsf_AbsRotorSpeed_xdu16 "Absolutwert von Rotorspeed" UWORD VROT 1 100 0.00 13000. FORMAT "%3.0" ECU_ADDRESS 0xFE9F89C2 /end MEASUREMENT
/begin MEASUREMENT sEpsInI_SCruiseReqdState_xdu8 "SCruise angeforderter Status: 0=Off, 1=HandsOn, 2=HandsFree, 3=Parking" UBYTE ZU0 1 100 0.00 4.000 FORMAT "%5.3" ECU_ADDRESS 0xFE9F8E45 /end MEASUREMENT
/begin MEASUREMENT sSacHndlI_Fas01StateStateQfkPla_xdu8 "Status FAS01 / PLA im QFK" UBYTE ZU0 1 100 0.00 255.0 FORMAT "%5.1" ECU_ADDRESS 0xFE9F8EC9 /end MEASUREMENT
/begin MEASUREMENT sSacHndlI_Fas02StateStateQfkAwv_xdu8 "Status FAS02 / AWV im QFK" UBYTE ZU0 1 100 0.00 255.0 FORMAT "%5.1" ECU_ADDRESS 0xFE9F8ECA /end MEASUREMENT
/begin MEASUREMENT sSacHndlI_Fas03StateStateQfkHca_xdu8 "Status FAS03 / HCA im QFK" UBYTE ZU0 1 100 0.00 255.0 FORMAT "%5.1" ECU_ADDRESS 0xFE9F8ECB /end MEASUREMENT
/begin MEASUREMENT sSacHndlI_Fas04StateStateQfkDsr_xdu8 "Status FAS04 / DSR im QFK" UBYTE ZU0 1 100 0.00 255.0 FORMAT "%5.1" ECU_ADDRESS 0xFE9F8ECC /end MEASUREMENT
/begin MEASUREMENT sSmtActrRPCCheck_EpsSelQFKCalc_xdu8 "Diverse Berechnung SelQFK" UBYTE ZU0 1 100 0.00 15.00 FORMAT "%5.2" ECU_ADDRESS 0xFE9F8EE6 /end MEASUREMENT
/begin MEASUREMENT sSmtActrRPCI_EpsSelQFK4Check_xdu8 "Modus RackPositionController - EPS_SelQFK" UBYTE ZU0 1 100 0.00 15.00 FORMAT "%5.2" ECU_ADDRESS 0xFE9F8EE9 /end MEASUREMENT
/begin MEASUREMENT sSmtActrRPCI_EpsSelQFK_xdu8 "Modus RackPositionController" UBYTE ZU0 1 100 0.00 15.00 FORMAT "%5.2" ECU_ADDRESS 0xFE9F8EEA /end MEASUREMENT
/begin MEASUREMENT sSmtActrRPCI_SCruiseReqdState4Check_xdu8 "SCruise angeforderter Status: 0=Off, 1=HandsOn, 2=HandsFree, 3=Parking, 4=HandsOnInc" UBYTE ZU0 1 100 0.00 4.000 FORMAT "%5.3" ECU_ADDRESS 0xFE9F8EEB /end MEASUREMENT
/begin MEASUREMENT tEpsInI_SCruiseCmftFadeOutTi_xdu16 "SCruise fade out Zeit fuer comfort fading (SFC<=SCI)" UWORD TIMSEC_1000 1 100 0.001000000 6.200000 FORMAT "%8.6" ECU_ADDRESS 0xFE9F8A10 /end MEASUREMENT
/begin MEASUREMENT tSmtActrRPC_EmergencyTrajectTimer_xdu16 "Timer Emergency Trajectory" UWORD TIMMS 1 100 0.00 60000.00 FORMAT "%8.2" ECU_ADDRESS 0xFE9F8A38 /end MEASUREMENT
/begin MEASUREMENT tTaskCtrlSupp_1msGrossExTim_xdu16 "Gross execution time of 1ms chain" UWORD TIMUS 1 100 0.00 2000.000 FORMAT "%8.3" ECU_ADDRESS 0xFEE9AF14 /end MEASUREMENT
/begin MEASUREMENT tTaskCtrlSupp_HWLibStarttime_xdu16 "HWLibStartTime" UWORD TIMUS 1 100 0.00 2000.000 FORMAT "%8.3" ECU_ADDRESS 0xFEE9AF16 /end MEASUREMENT
/begin MEASUREMENT tTscI_GradTBTST_xdu16 "Delta T der TBT SampleTime" UWORD TIMUS 1 100 0.00 65535.00 FORMAT "%8.2" ECU_ADDRESS 0xFE9F8A3E /end MEASUREMENT
/begin MEASUREMENT tTsc_GradSysT_TBTST_us_xdu16 "Alter des Handmomentensignals" UWORD TIMUS 1 100 0.00 65535.00 FORMAT "%8.2" ECU_ADDRESS 0xFE9F8A44 /end MEASUREMENT
/begin MEASUREMENT vSteerCtrl_AbsVehicleSpeedFilt4Interpol_xdu16 "SteerCtrl: abs. vehicle speed: processed for interpolation" UWORD VFZHIGH 1 100 0.00 500.0000 FORMAT "%8.4" ECU_ADDRESS 0xFE9F8A9E /end MEASUREMENT
/begin MEASUREMENT vTsc_AbsVehicleSpeedFilt4Interpol_xdu16 "SteerCtrl: abs. vehicle speed: processed for interpolation" UWORD VFZHIGH 1 100 0.00 500.0000 FORMAT "%8.4" ECU_ADDRESS 0xFE9F8AA0 /end MEASUREMENT
/begin MEASUREMENT vVehSpI_AbsMaxSafeVehSpd_xdu16 "Maximum vehicle speed. Goal: actual speed over ground <= AbsMaxSafeVehSpd." UWORD VFZHIGH 1 100 0.00 500.0000 FORMAT "%8.4" ECU_ADDRESS 0xFE9F8AA6 /end MEASUREMENT
/begin MEASUREMENT wSCruiseI_RotPosArrayEmgyTraj_xas16 "Emergency Trajectoy Rotor Position Array" SWORD ANGLE_1 1 100 -32000.00 32000.00 FORMAT "%8.2" ECU_ADDRESS 0xFE9F9440 MATRIX_DIM 7 1 1 /end MEASUREMENT
/begin MEASUREMENT wSmtActrRPCI_RotPosArrayEmgyTraj4Check_xas16 "Emergency Trajectoy Rotor Position Array for check" SWORD ANGLE_1 1 100 -32000.00 32000.00 FORMAT "%8.2" ECU_ADDRESS 0xFE9F9460 MATRIX_DIM 7 1 1 /end MEASUREMENT
/begin MEASUREMENT wSmtActrRPC_CenterOffsetComp_xds32 "Berechnete Center Offset Kompensation" SLONG ANGLE_1 1 100 -32000.0000000 32000.0000000 FORMAT "%13.7" ECU_ADDRESS 0xFE9F85B8 /end MEASUREMENT
/begin MEASUREMENT xSacHndlI_ActualRackForce_xds16 "Ist-Kraft QFK" SWORD DIV1PRZ 1 100 -32768.00 32767.00 FORMAT "%8.2" ECU_ADDRESS 0xFE9F8BD6 /end MEASUREMENT
/begin MEASUREMENT xSacHndlI_DPartsFactor_xdu16 "Faktor auf D-Anteile bei QFK AktivitÃ¤t" UWORD RIGHTSH14NP 1 100 0.00 1.000000 FORMAT "%8.6" ECU_ADDRESS 0xFE9F8BD8 /end MEASUREMENT
/begin MEASUREMENT xSteerCtrlDOffsetXAxis_xau16 "x-node of interpolated characteristic curve (rotor speed)" UWORD VROT 1 100 0.00 13000. FORMAT "%3.0" ECU_ADDRESS 0xFE9F93BC MATRIX_DIM 10 1 1 /end MEASUREMENT
/begin MEASUREMENT xSteerCtrlDOffsetYAxis_xau16 "y-node of interpolated characteristic curve (D-Offset)" UWORD DFACTHIGH 1 100 0.5000000 25.00000 FORMAT "%8.5" ECU_ADDRESS 0xFE9F93D0 MATRIX_DIM 10 1 1 /end MEASUREMENT
/begin MEASUREMENT xSteerCtrlDPartFactorXAxis_xau16 "x-node of interpolated characteristic curve (rotor speed)" UWORD VROT 1 100 0.00 13000. FORMAT "%3.0" ECU_ADDRESS 0xFE9F93E4 MATRIX_DIM 10 1 1 /end MEASUREMENT
/begin MEASUREMENT xSteerCtrlDPartFactorYAxis_xau16 "y-node of interpolated characteristic curve (D-factor)" UWORD DFACTHIGH 1 100 0.5000000 25.00000 FORMAT "%8.5" ECU_ADDRESS 0xFE9F93F8 MATRIX_DIM 10 1 1 /end MEASUREMENT
/begin MEASUREMENT xTscI_PT1tauGradTBT_xdu16 "fahrzeuggeschwindigkeitsanhängige PT1 Filterkonstante GradTBT" UWORD RIGHTSH10NP 1 100 0.00 1.000000 FORMAT "%8.6" ECU_ADDRESS 0xFE9F8C14 /end MEASUREMENT
/begin MEASUREMENT xTsc_ExtrapolFactor_xdu16 "fahrzeuggeschwindigkeitsanhï¿½ngiger Extrapolations-Faktor" UWORD DFACTHIGH 1 100 0.00 1.000000 FORMAT "%8.6" ECU_ADDRESS 0xFE9F8C16 /end MEASUREMENT
/begin MEASUREMENT xWlcI_ReductionLevel_xdu16 "Unterstuetzungsleistung" UWORD RIGHTSH15NP 1 100 0.00 1.000000 FORMAT "%8.6" ECU_ADDRESS 0xFE9F8C1A /end MEASUREMENT
/begin MEASUREMENT xtcActualTorqueRedLevel_xau16 "aktuelle Reduktion kanalweise" UWORD RIGHTSH15NP 1 100 0.00 1.000000 FORMAT "%8.6" ECU_ADDRESS 0xFE9F9484 MATRIX_DIM 7 1 1 /end MEASUREMENT
/begin MEASUREMENT ySmtActrRPC_ErrorReasonBitmask_xdu8 "Bitmaske fuer Fehlergrund: Bit 0: AisStg, Bit 1: AisStStg, Bit 2: AisLvlStg, Bit 3: OEM Lib (SAC) deaktiviert, Bit 4: Park limits ueberschritten, Bit 5: HandsFree limits ueberschritten" UBYTE STATUS 1 100 0.00 63.00 FORMAT "%5.2" ECU_ADDRESS 0xFE9F8F9F /end MEASUREMENT
/begin COMPU_METHOD ANGLE_1 "" RAT_FUNC "%6.2" "°" COEFFS 0 1 0 0 0 1 /end COMPU_METHOD
/begin COMPU_METHOD BIT "" RAT_FUNC "%6.2" "Bitanzeige" COEFFS 0 1 0 0 0 1 /end COMPU_METHOD
/begin COMPU_METHOD DEGREE2MM "degree to mm" RAT_FUNC "%6.3" "mm" COEFFS 0 360000 0 0 0 2325 /end COMPU_METHOD
/begin COMPU_METHOD DFACTHIGH "" RAT_FUNC "%6.5" "ms" COEFFS 0 1024 0 0 0 1 /end COMPU_METHOD
/begin COMPU_METHOD DIV1PRZ "" RAT_FUNC "%6.2" "%" COEFFS 0 1 0 0 0 1 /end COMPU_METHOD
/begin COMPU_METHOD ECU_STATE "" TAB_VERB "%6.3" "Status" COMPU_TAB_REF ECU_STATE /end COMPU_METHOD
/begin COMPU_METHOD FAC2FRQ "Faktor to  frequency [Hz] for 1ms task functions" FORM "%3.1" "Hz"
 /begin FORMULA "X1 / (4096 * 6.283 * 0.001)" FORMULA_INV "X1 * ( 4096 * 6.283 * 0.001) " /end FORMULA
/end COMPU_METHOD
/begin COMPU_METHOD FACT_0039 "" RAT_FUNC "%6.4" "mm" COEFFS 0 256.410256410256 -2 0 0 1 /end COMPU_METHOD
/begin COMPU_METHOD FRACK "" RAT_FUNC "%6.2" "N" COEFFS 0 1 0 0 0 1 /end COMPU_METHOD
/begin COMPU_METHOD GRAD_10MS "" RAT_FUNC "%6.5" "1/10ms" COEFFS 0 8192 0 0 0 1 /end COMPU_METHOD
/begin COMPU_METHOD GRMM2HUB "MM/ms to Grad/s" FORM "%9.7" "Grad/s"
 /begin FORMULA "X1 * (10*6.050420168/128)" FORMULA_INV "X1 * 128 / (10*6.050420168)" /end FORMULA
/end COMPU_METHOD
/begin COMPU_METHOD MM2HUB "MM2HUB" FORM "%6.5" "Grad" /begin FORMULA "X1 * 360 / 7424" FORMULA_INV "X1 * 7424 / 360" /end FORMULA /end COMPU_METHOD
/begin COMPU_METHOD MMOT "" RAT_FUNC "%6.5" "Nm" COEFFS 0 1024 0 0 0 1 /end COMPU_METHOD
/begin COMPU_METHOD NM2N "Nm to N " FORM "%6.5" "N" /begin FORMULA "X1 * 2737 / 1024" FORMULA_INV "X1 * 1024 / 2737" /end FORMULA /end COMPU_METHOD
/begin COMPU_METHOD NM2N_GEARSIGN "Nm to N - gearsign removed" FORM "%6.5" "N" /begin FORMULA "X1 * 2737 / 1024" FORMULA_INV "X1 * 1024 / 2737" /end FORMULA /end COMPU_METHOD
/begin COMPU_METHOD NO_UNIT "no physical assignment" RAT_FUNC "%4.5" "-" COEFFS 0 1.0 0.0 0 0 1 /end COMPU_METHOD
/begin COMPU_METHOD PDC_FRACK "" RAT_FUNC "%6.3" "N" COEFFS 0 2 0 0 0 1 /end COMPU_METHOD
/begin COMPU_METHOD RACKACC128 "" RAT_FUNC "%6.4" "mm/s²" COEFFS 0 128 0 0 0 1 /end COMPU_METHOD
/begin COMPU_METHOD RACKPOS128 "" RAT_FUNC "%6.4" "mm" COEFFS 0 128 0 0 0 1 /end COMPU_METHOD
/begin COMPU_METHOD RACKPOS256 "" RAT_FUNC "%6.4" "mm" COEFFS 0 256 0 0 0 1 /end COMPU_METHOD
/begin COMPU_METHOD RAD_STAND "" RAT_FUNC "%6.5" "m" COEFFS 0 1111 0 0 0 1 /end COMPU_METHOD
/begin COMPU_METHOD RATIOMaxT2EndStopT "Ratio between HwLib Max Torque and min EndStopTorque in percent" FORM "%3.1" "%" /begin FORMULA "(X1/X2)*100" /end FORMULA /end COMPU_METHOD
/begin COMPU_METHOD RED_FACT "" RAT_FUNC "%6.4" "-" COEFFS 0 32768 0 0 0 1 /end COMPU_METHOD
/begin COMPU_METHOD RIGHTSH10NP "" RAT_FUNC "%6.5" "" COEFFS 0 1024 0 0 0 1 /end COMPU_METHOD
/begin COMPU_METHOD RIGHTSH10NP_1MS "" RAT_FUNC "%6.5" "1/1ms" COEFFS 0 1024 0 0 0 1 /end COMPU_METHOD
/begin COMPU_METHOD RIGHTSH13NP "" RAT_FUNC "%6.5" "1" COEFFS 0 8192 0 0 0 1 /end COMPU_METHOD
/begin COMPU_METHOD RIGHTSH14NP "" RAT_FUNC "%7.6" "" COEFFS 0 16384 0 0 0 1 /end COMPU_METHOD
/begin COMPU_METHOD RIGHTSH15NP "" RAT_FUNC "%7.6" "" COEFFS 0 32768 0 0 0 1 /end COMPU_METHOD
/begin COMPU_METHOD RIGHTSH15NP2N "RIGHTSH15NP to N " FORM "%6.5" "N" /begin FORMULA "X1 * 2737 / 32768" FORMULA_INV "X1 * 32768 / 2737" /end FORMULA /end COMPU_METHOD
/begin COMPU_METHOD RIGHTSH15NP_1MS "" RAT_FUNC "%7.6" "1/1ms" COEFFS 0 32768 0 0 0 1 /end COMPU_METHOD
/begin COMPU_METHOD RIGHTSH15NP_GRAD1S "" RAT_FUNC "%7.6" "%/s" COEFFS 0 0.32768 0 0 0 1 /end COMPU_METHOD
/begin COMPU_METHOD RIGHTSH16NP "" RAT_FUNC "%7.6" "" COEFFS 0 65536 0 0 0 1 /end COMPU_METHOD
/begin COMPU_METHOD RIGHTSH20NP "" RAT_FUNC "%9.8" "" COEFFS 0 1048576 0 0 0 1 /end COMPU_METHOD
/begin COMPU_METHOD RIGHTSH21NP "" RAT_FUNC "%9.8" "" COEFFS 0 2097152 0 0 0 1 /end COMPU_METHOD
/begin COMPU_METHOD RIGHTSH23NP "" RAT_FUNC "%9.8" "" COEFFS 0 8388608 0 0 0 1 /end COMPU_METHOD
/begin COMPU_METHOD RIGHTSH24NP "" RAT_FUNC "%10.9" "" COEFFS 0 16777216 0 0 0 1 /end COMPU_METHOD
/begin COMPU_METHOD RIGHTSH25NP "" RAT_FUNC "%10.9" "" COEFFS 0 33554432 0 0 0 1 /end COMPU_METHOD
/begin COMPU_METHOD RIGHTSH5NP "" RAT_FUNC "%6.4" "" COEFFS 0 32 0 0 0 1 /end COMPU_METHOD
/begin COMPU_METHOD ROT2SA "Rotor [degree] to SteeringAngle [degree]" FORM "%3.1" "Grad" /begin FORMULA "X1" FORMULA_INV "X1" /end FORMULA /end COMPU_METHOD
/begin COMPU_METHOD ROTPOS "" RAT_FUNC "%6.3" "°" COEFFS 0 11.3777777777778 0 0 0 1 /end COMPU_METHOD
/begin COMPU_METHOD ROU_PHI_CALIBRANGE_AU8.CONVERSIONV "@@@@RuleName created by CANape" FORM "%3.1" "" /begin FORMULA "(X1)" /end FORMULA /end COMPU_METHOD
/begin COMPU_METHOD ROU_PHI_REGDIF_ABBMAX_AU8.CONVERSIONV "@@@@RuleName created by CANape" FORM "%3.1" "" /begin FORMULA "(X1)" /end FORMULA /end COMPU_METHOD
/begin COMPU_METHOD RPM_REAL "rotation frequency in rpm for float values" RAT_FUNC "%4.5" "rpm" COEFFS 0 1.0 0.0 0 0 1 /end COMPU_METHOD
/begin COMPU_METHOD RSH15 "" RAT_FUNC "%6.4" "%" COEFFS 0 327.68 0 0 0 1 /end COMPU_METHOD
/begin COMPU_METHOD RSH15GRAD2FACTGRAD "" RAT_FUNC "%6.4" "- / ms" COEFFS 0 32768 0 0 0 1 /end COMPU_METHOD
/begin COMPU_METHOD RSH15_GRAD1S "" RAT_FUNC "%6.4" "% / s" COEFFS 0 327.68 0 0 0 1 /end COMPU_METHOD
/begin COMPU_METHOD Rou_Calib.Conversion "" FORM "%6.3" "" /begin FORMULA "X1 == 3" /end FORMULA /end COMPU_METHOD
/begin COMPU_METHOD Rou_Init.Conversion "" FORM "%6.3" "" /begin FORMULA "(X1 == 1) || (X1 == 2)" /end FORMULA /end COMPU_METHOD
/begin COMPU_METHOD Rou_SWEA.Conversion "" FORM "%6.3" "" /begin FORMULA "((X1==1) || (X1==2)) && ((X2==1) || (X2==2))" /end FORMULA /end COMPU_METHOD
/begin COMPU_METHOD SA "" RAT_FUNC "%6.4" "°" COEFFS 0 22.857 0 0 0 1 /end COMPU_METHOD
/begin COMPU_METHOD SAA "" RAT_FUNC "%6.2" "°/s²" COEFFS 0 1 0 0 0 1 /end COMPU_METHOD
/begin COMPU_METHOD SAS "" RAT_FUNC "%6.3" "°/s" COEFFS 0 2 0 0 0 1 /end COMPU_METHOD
/begin COMPU_METHOD SAS_8 "" RAT_FUNC "%6.3" "°/s" COEFFS 0 8 0 0 0 1 /end COMPU_METHOD
/begin COMPU_METHOD SA_10 "" RAT_FUNC "%6.3" "°" COEFFS 0 10 0 0 0 1 /end COMPU_METHOD
/begin COMPU_METHOD SCRUISE_RACK_SPEED_LIM "" TAB_VERB "%6.3" "Status" COMPU_TAB_REF SCRUISE_RACK_SPEED_LIM /end COMPU_METHOD
/begin COMPU_METHOD SEC2FREQ "Seconds to Freq" FORM "%6.5" "Hz" /begin FORMULA "1000 / X1" FORMULA_INV "1000 / X1" /end FORMULA /end COMPU_METHOD
/begin COMPU_METHOD SM_I "" RAT_FUNC "%6.4" "A" COEFFS 0 16 0 0 0 1 /end COMPU_METHOD
/begin COMPU_METHOD SM_I_S "" RAT_FUNC "%6.4" "A/s" COEFFS 0 0.016 0 0 0 1 /end COMPU_METHOD
/begin COMPU_METHOD STATUS "" RAT_FUNC "%6.2" "Status" COEFFS 0 1 0 0 0 1 /end COMPU_METHOD
/begin COMPU_METHOD STEERING_CHAR_STATE "" TAB_VERB "%6.3" "Status" COMPU_TAB_REF STEERING_CHAR_STATE /end COMPU_METHOD
/begin COMPU_METHOD TBTHIGH "" RAT_FUNC "%6.5" "Nm" COEFFS 0 1024 0 0 0 1 /end COMPU_METHOD
/begin COMPU_METHOD TBTSTIFFHIGH "" RAT_FUNC "%6.5" "NM / °" COEFFS 0 1024 0 0 0 1 /end COMPU_METHOD
/begin COMPU_METHOD TBT_RSH4 "" RAT_FUNC "%6.4" "Nm" COEFFS 0 16 0 0 0 1 /end COMPU_METHOD
/begin COMPU_METHOD TEMP "" RAT_FUNC "%6.2" "°C" COEFFS 0 1 0 0 0 1 /end COMPU_METHOD
/begin COMPU_METHOD TEMP_INT "temperature in °C for integer values" RAT_FUNC "%4.5" "°C" COEFFS 0 1.0 70.0 0 0 1 /end COMPU_METHOD
/begin COMPU_METHOD TIMMS "" RAT_FUNC "%6.2" "ms" COEFFS 0 1 0 0 0 1 /end COMPU_METHOD
/begin COMPU_METHOD TIMMS_10 "" RAT_FUNC "%6.1" "ms" COEFFS 0 0.1 0 0 0 1 /end COMPU_METHOD
/begin COMPU_METHOD TIMS "" RAT_FUNC "%6.2" "s" COEFFS 0 1 0 0 0 1 /end COMPU_METHOD
/begin COMPU_METHOD TIMSEC "" RAT_FUNC "%6.4" "SEC" COEFFS 0 100 0 0 0 1 /end COMPU_METHOD
/begin COMPU_METHOD TIMSEC_1000 "" RAT_FUNC "%6.5" "s" COEFFS 0 1000 0 0 0 1 /end COMPU_METHOD
/begin COMPU_METHOD TIMUS "" RAT_FUNC "%6.2" "us" COEFFS 0 1 0 0 0 1 /end COMPU_METHOD
/begin COMPU_METHOD TIMYEAR "" RAT_FUNC "%4.0" "Jahr" COEFFS 0 1 -2000 0 0 1 /end COMPU_METHOD
/begin COMPU_METHOD TORGRAD "" RAT_FUNC "%6.5" "Nm/ms" COEFFS 0 1024 0 0 0 1 /end COMPU_METHOD
/begin COMPU_METHOD TORGRAD_10MS "" RAT_FUNC "%6.5" "Nm/10ms" COEFFS 0 1024 0 0 0 1 /end COMPU_METHOD
/begin COMPU_METHOD TORGRAD_20MS "" RAT_FUNC "%6.5" "Nm/20ms" COEFFS 0 1024 0 0 0 1 /end COMPU_METHOD
/begin COMPU_METHOD TORQUE2FORCE "" RAT_FUNC "%6.2" "N/Nm" COEFFS 0 1 0 0 0 1 /end COMPU_METHOD
/begin COMPU_METHOD TORQ_GRAD_INT "torque gradient in Nm/ms for integer values" RAT_FUNC "%4.5" "Nm/ms" COEFFS 0 1024.0 0.0 0 0 1 /end COMPU_METHOD
/begin COMPU_METHOD TORQ_GRAD_REAL "torque gradient in Nm/ms for float values" RAT_FUNC "%4.5" "Nm/ms" COEFFS 0 1.0 0.0 0 0 1 /end COMPU_METHOD
/begin COMPU_METHOD TORQ_INT "torque in Nm for integer values" RAT_FUNC "%4.5" "Nm" COEFFS 0 1024.0 0.0 0 0 1 /end COMPU_METHOD
/begin COMPU_METHOD TORQ_REAL "torque in Nm  for float values" RAT_FUNC "%4.5" "Nm" COEFFS 0 1.0 0.0 0 0 1 /end COMPU_METHOD
/begin COMPU_METHOD TORQ_STIFF_INT "torque stiffness in Nm/° for integer values" RAT_FUNC "%4.5" "Nm/°" COEFFS 0 1024.0 0.0 0 0 1 /end COMPU_METHOD
/begin COMPU_METHOD TRQ2 "" RAT_FUNC "%6.3" "Nm" COEFFS 0 2 0 0 0 1 /end COMPU_METHOD
/begin COMPU_METHOD T_MS "time in ms for integer values" RAT_FUNC "%4.5" "ms" COEFFS 0 1.0 0.0 0 0 1 /end COMPU_METHOD
/begin COMPU_METHOD T_NS "time in ns for integer values" RAT_FUNC "%4.5" "ns" COEFFS 0 1.0 0.0 0 0 1 /end COMPU_METHOD
/begin COMPU_METHOD T_S "time in s for integer values" RAT_FUNC "%4.5" "s" COEFFS 0 1.0 0.0 0 0 1 /end COMPU_METHOD
/begin COMPU_METHOD U12V "" RAT_FUNC "%6.2" "V" COEFFS 0 1 0 0 0 1 /end COMPU_METHOD
/begin COMPU_METHOD U64V "" RAT_FUNC "%6.4" "V" COEFFS 0 64 0 0 0 1 /end COMPU_METHOD
/begin COMPU_METHOD VELOCITY "velocity in km/h for integer values" RAT_FUNC "%4.5" "km/h" COEFFS 0 64.0 0.0 0 0 1 /end COMPU_METHOD
/begin COMPU_METHOD VENG "" RAT_FUNC "%6.2" "1/min" COEFFS 0 1 0 0 0 1 /end COMPU_METHOD
/begin COMPU_METHOD VFZHIGH "" RAT_FUNC "%6.4" "km/h" COEFFS 0 64 0 0 0 1 /end COMPU_METHOD
/begin COMPU_METHOD VGRD_10MS_1S "km/h/10ms, VFZHIGH to km/h/s" RAT_FUNC "%4.4" "km/h/s" COEFFS 0 64 0 0 0 100 /end COMPU_METHOD
/begin COMPU_METHOD VROT "" RAT_FUNC "%3.1" "1/min" COEFFS 0 1 0 0 0 1 /end COMPU_METHOD
/begin COMPU_METHOD ZEITASM "" RAT_FUNC "%6.3" "s" COEFFS 0 12.5 0 0 0 1 /end COMPU_METHOD
/begin COMPU_METHOD ZU0 "" RAT_FUNC "%6.2" "" COEFFS 0 1 0 0 0 1 /end COMPU_METHOD
/begin COMPU_METHOD default "" RAT_FUNC "%6.2" "" COEFFS 0 1 0 0 0 1 /end COMPU_METHOD
/begin COMPU_METHOD defaultAscii "" RAT_FUNC "%6.2" "" COEFFS 0 1 0 0 0 1 /end COMPU_METHOD
/begin COMPU_METHOD dia_stFrgAktLuStartStop_mu8.CONVERSIONV "@@@@RuleName created by CANape" FORM "%3.1" "" /begin FORMULA "((X1&(1<<19))==(1<<19))" /end FORMULA /end COMPU_METHOD
/begin COMPU_METHOD dia_stLkuOn_mu8.CONVERSIONV "@@@@RuleName created by CANape" FORM "%3.1" "" /begin FORMULA "((X1&(1<<5))==(1<<5))" /end FORMULA /end COMPU_METHOD
/*********** End of merged COMPU_METHOD blocks ***********/ /*********** Start of merged UNIT blocks ***********/
/begin UNIT AUTOSAR_AISpecification_Units_Bar "Bar" "bar" EXTENDED_SI SI_EXPONENTS -1 1 -2 0 0 0 0 /end UNIT
/begin UNIT AUTOSAR_AISpecification_Units_DegAngle "Degree Centigrade" "deg" EXTENDED_SI SI_EXPONENTS 0 0 0 0 0 0 0 /end UNIT
/begin UNIT AUTOSAR_AISpecification_Units_DegCgrd "Degree Centigrade" "degC" EXTENDED_SI SI_EXPONENTS 0 0 0 0 1 0 0 /end UNIT
/begin UNIT AUTOSAR_AISpecification_Units_HectoPa "Hecto Pascal" "hPa" EXTENDED_SI SI_EXPONENTS -1 1 -2 0 0 0 0 /end UNIT
/begin UNIT AUTOSAR_AISpecification_Units_Hz "Hertz" "Hz" EXTENDED_SI SI_EXPONENTS 0 0 -1 0 0 0 0 /end UNIT
/begin UNIT AUTOSAR_AISpecification_Units_Kelvin "Kelvin" "K" EXTENDED_SI SI_EXPONENTS 0 0 0 0 1 0 0 /end UNIT
/begin UNIT AUTOSAR_AISpecification_Units_KelvinRel "Kelvin Relative" "K" EXTENDED_SI SI_EXPONENTS 0 0 0 0 1 0 0 /end UNIT
/begin UNIT AUTOSAR_AISpecification_Units_KiloGr "Kilo Gram" "kg" EXTENDED_SI SI_EXPONENTS 0 1 0 0 0 0 0 /end UNIT
/begin UNIT AUTOSAR_AISpecification_Units_KiloHz "Kilo Hertz" "kHz" EXTENDED_SI SI_EXPONENTS 0 0 -1 0 0 0 0 /end UNIT
/begin UNIT AUTOSAR_AISpecification_Units_KiloMtr "Kilo Meter" "km" EXTENDED_SI SI_EXPONENTS 1 0 0 0 0 0 0 /end UNIT
/begin UNIT AUTOSAR_AISpecification_Units_KiloMtrPerHr "Kilo Meter" "km/h" EXTENDED_SI SI_EXPONENTS 1 0 -1 0 0 0 0 /end UNIT
/begin UNIT AUTOSAR_AISpecification_Units_Mtr "Meter" "m" EXTENDED_SI SI_EXPONENTS 1 0 0 0 0 0 0 /end UNIT
/begin UNIT AUTOSAR_AISpecification_Units_MtrPerSec "Meter per Second" "m/s" EXTENDED_SI SI_EXPONENTS 1 0 -1 0 0 0 0 /end UNIT
/begin UNIT AUTOSAR_AISpecification_Units_MtrPerSecCubd "Meter per Second Cubed" "m/s^3" EXTENDED_SI SI_EXPONENTS 1 0 -3 0 0 0 0 /end UNIT
/begin UNIT AUTOSAR_AISpecification_Units_MtrPerSecSqd "Meter per Second Squared" "m/s^2" EXTENDED_SI SI_EXPONENTS 1 0 -2 0 0 0 0 /end UNIT
/begin UNIT AUTOSAR_AISpecification_Units_MtrRecpr "Meter Reciprocal" "1/m" EXTENDED_SI SI_EXPONENTS -1 0 0 0 0 0 0 /end UNIT
/begin UNIT AUTOSAR_AISpecification_Units_Nwt "Newton" "N" EXTENDED_SI SI_EXPONENTS 1 1 -2 0 0 0 0 /end UNIT
/begin UNIT AUTOSAR_AISpecification_Units_NwtMtr "Newton Meter" "Nm" EXTENDED_SI SI_EXPONENTS 2 1 -2 0 0 0 0 /end UNIT
/begin UNIT AUTOSAR_AISpecification_Units_NwtMtrPerSec "Newton Meter per Second" "Nm/s" EXTENDED_SI SI_EXPONENTS 2 1 -3 0 0 0 0 /end UNIT
/begin UNIT AUTOSAR_AISpecification_Units_NwtPerMtr "Newton per Meter" "N/m" EXTENDED_SI SI_EXPONENTS 0 1 -2 0 0 0 0 /end UNIT
/begin UNIT AUTOSAR_AISpecification_Units_NwtSecPerMtr "Newton Second per Meter" "Ns/m" EXTENDED_SI SI_EXPONENTS 0 1 -1 0 0 0 0 /end UNIT
/begin UNIT AUTOSAR_AISpecification_Units_Pa "Pascal" "Pa" EXTENDED_SI SI_EXPONENTS -1 1 -2 0 0 0 0 /end UNIT
/begin UNIT AUTOSAR_AISpecification_Units_Perc "Percent" "%" EXTENDED_SI SI_EXPONENTS 0 0 0 0 0 0 0 /end UNIT
/begin UNIT AUTOSAR_AISpecification_Units_PercPerSec "Percent per Second" "%/s" EXTENDED_SI SI_EXPONENTS 0 0 -1 0 0 0 0 /end UNIT
/begin UNIT AUTOSAR_AISpecification_Units_Rad "Radian" "rad" EXTENDED_SI SI_EXPONENTS 0 0 0 0 0 0 0 /end UNIT
/begin UNIT AUTOSAR_AISpecification_Units_RadPerSec "Radian per Second" "rad/s" EXTENDED_SI SI_EXPONENTS 0 0 -1 0 0 0 0 /end UNIT
/begin UNIT AUTOSAR_AISpecification_Units_RadPerSecSqd "Radian per Second Squared" "rad/s^2" EXTENDED_SI SI_EXPONENTS 0 0 -2 0 0 0 0 /end UNIT
/begin UNIT AUTOSAR_AISpecification_Units_Rpm "Rpm" "rpm" EXTENDED_SI SI_EXPONENTS 0 0 -1 0 0 0 0 /end UNIT
/begin UNIT AUTOSAR_AISpecification_Units_RpmPerSec "Revolutions per minute per Second" "rpm/s" EXTENDED_SI SI_EXPONENTS 0 0 -2 0 0 0 0 /end UNIT
/begin UNIT AUTOSAR_AISpecification_Units_Sec "Second" "s" EXTENDED_SI SI_EXPONENTS 0 0 1 0 0 0 0 /end UNIT
/begin UNIT AUTOSAR_AISpecification_Units_U_deg "" "deg" EXTENDED_SI SI_EXPONENTS 0 0 0 0 0 0 0 /end UNIT
/begin UNIT AUTOSAR_AISpecification_Units_U_deg_s "" "deg_s" EXTENDED_SI SI_EXPONENTS 0 0 0 0 0 0 0 /end UNIT
/begin UNIT AUTOSAR_AISpecification_Units_Volt "Volt" "V" EXTENDED_SI SI_EXPONENTS 2 1 -3 -1 0 0 0 /end UNIT
/begin UNIT AUTOSAR_CanIf_Units_NoUnit "No Unit" "noUnit" EXTENDED_SI SI_EXPONENTS 0 0 0 0 0 0 0 /end UNIT
/begin UNIT AUTOSAR_CanNm_Units_NoUnit "No Unit" "noUnit" EXTENDED_SI SI_EXPONENTS 0 0 0 0 0 0 0 /end UNIT
/begin UNIT AUTOSAR_CanSM_Units_NoUnit "No Unit" "noUnit" EXTENDED_SI SI_EXPONENTS 0 0 0 0 0 0 0 /end UNIT
/begin UNIT AUTOSAR_CanTrcv_Units_NoUnit "No Unit" "noUnit" EXTENDED_SI SI_EXPONENTS 0 0 0 0 0 0 0 /end UNIT
/begin UNIT AUTOSAR_ComM_Units_NoUnit "No Unit" "noUnit" EXTENDED_SI SI_EXPONENTS 0 0 0 0 0 0 0 /end UNIT
/begin UNIT AUTOSAR_Com_Units_NoUnit "No Unit" "noUnit" EXTENDED_SI SI_EXPONENTS 0 0 0 0 0 0 0 /end UNIT
/begin UNIT AUTOSAR_IpduM_Units_NoUnit "No Unit" "noUnit" EXTENDED_SI SI_EXPONENTS 0 0 0 0 0 0 0 /end UNIT
/begin UNIT AUTOSAR_Nm_Units_NoUnit "No Unit" "noUnit" EXTENDED_SI SI_EXPONENTS 0 0 0 0 0 0 0 /end UNIT
/begin UNIT AUTOSAR_NvM_Units_NoUnit "No Unit" "noUnit" EXTENDED_SI SI_EXPONENTS 0 0 0 0 0 0 0 /end UNIT
/begin UNIT AUTOSAR_PduR_Units_NoUnit "No Unit" "noUnit" EXTENDED_SI SI_EXPONENTS 0 0 0 0 0 0 0 /end UNIT
/begin UNIT AUTOSAR_Xcp_Units_NoUnit "No Unit" "noUnit" EXTENDED_SI SI_EXPONENTS 0 0 0 0 0 0 0 /end UNIT
/begin UNIT Eps_Repository_CommunicationBusAbstractionVW_AssSysMon_CompuMethods_EPS_ASM_Data_1_Unit "" "Unit_None" EXTENDED_SI /end UNIT
/begin UNIT Eps_Repository_CommunicationBusAbstractionVW_AssSysMon_CompuMethods_EPS_ASM_Data_2_Unit "" "Unit_None" EXTENDED_SI /end UNIT
/begin UNIT Eps_Repository_CommunicationBusAbstractionVW_AssSysMon_CompuMethods_EPS_ASM_Data_3_Unit "" "Unit_None" EXTENDED_SI /end UNIT
/begin UNIT Eps_Repository_CommunicationBusAbstractionVW_AssSysMon_CompuMethods_EPS_ASM_Data_4_Unit "" "Unit_None" EXTENDED_SI /end UNIT
/begin UNIT Eps_Repository_CommunicationBusAbstractionVW_AssSysMon_CompuMethods_EPS_ASM_Data_5_Unit "" "Unit_None" EXTENDED_SI /end UNIT
/begin UNIT Eps_Repository_CommunicationBusAbstractionVW_AssSysMon_CompuMethods_EPS_ASM_Data_6_Unit "" "Unit_None" EXTENDED_SI /end UNIT
/begin UNIT Eps_Repository_CommunicationBusAbstractionVW_AssSysMon_CompuMethods_EPS_ASM_Ereignis_Unit "" "Unit_None" EXTENDED_SI /end UNIT
/begin UNIT Eps_Repository_CommunicationBusAbstractionVW_AssSysMon_CompuMethods_EPS_ASM_Zeitstempel_Unit "" "Unit_None" EXTENDED_SI /end UNIT
/begin UNIT Eps_Repository_CommunicationBusAbstractionVW_DevMessages_CompuMethods_EID_Handmorm_TorqueState_Unit "" "Nm" EXTENDED_SI /end UNIT
/begin UNIT Eps_Repository_CommunicationBusAbstractionVW_DevMessages_CompuMethods_EID_Handmorm_TorsionBarTorque_2_Unit "" "Nm" EXTENDED_SI /end UNIT
/begin UNIT Eps_Repository_CommunicationBusAbstractionVW_DevMessages_CompuMethods_EID_Handmorm_TorsionBarTorque_Unit "" "Nm" EXTENDED_SI /end UNIT
/begin UNIT Eps_Repository_CommunicationBusAbstractionVW_DevMessages_CompuMethods_EID_LW_EndStop_RackPosMax_Unit "" "mm" EXTENDED_SI /end UNIT
/begin UNIT Eps_Repository_CommunicationBusAbstractionVW_DevMessages_CompuMethods_EID_LW_EndStop_RackPosMin_Unit "" "mm" EXTENDED_SI /end UNIT
/begin UNIT Eps_Repository_CommunicationBusAbstractionVW_DevMessages_CompuMethods_EID_LW_RackPosition_Unit "" "mm" EXTENDED_SI /end UNIT
/begin UNIT Eps_Repository_CommunicationBusAbstractionVW_DevMessages_CompuMethods_EID_LW_SteeringAngleSpeed_Unit "" "?/s" EXTENDED_SI /end UNIT
/begin UNIT Eps_Repository_CommunicationBusAbstractionVW_DevMessages_CompuMethods_EID_LW_SteeringAngleSpeed_korr_Unit "" "?/s" EXTENDED_SI /end UNIT
/begin UNIT Eps_Repository_CommunicationBusAbstractionVW_DevMessages_CompuMethods_EID_MotPos_RotorSpeedFilt_Unit "" "rpm" EXTENDED_SI /end UNIT
/begin UNIT Eps_Repository_CommunicationBusAbstractionVW_DevMessages_CompuMethods_EID_Motorm_HLCharCurveBuckleFact_Unit "" "NoUnit" EXTENDED_SI /end UNIT
/begin UNIT Eps_Repository_CommunicationBusAbstractionVW_DevMessages_CompuMethods_EID_Motorm_HLMaxTorqueGradient_Unit "" "Nm/ms" EXTENDED_SI /end UNIT
/begin UNIT Eps_Repository_CommunicationBusAbstractionVW_DevMessages_CompuMethods_EID_Motorm_LimMotTorFactor_Unit "" "NoUnit" EXTENDED_SI /end UNIT
/begin UNIT Eps_Repository_CommunicationBusAbstractionVW_DevMessages_CompuMethods_EID_Motorm_LimitedMotorTorque_Unit "" "Nm" EXTENDED_SI /end UNIT
/begin UNIT Eps_Repository_CommunicationBusAbstractionVW_DevMessages_CompuMethods_EID_Motorm_MotTorLimI_WID_Unit "" "NoUnit" EXTENDED_SI /end UNIT
/begin UNIT Eps_Repository_CommunicationBusAbstractionVW_DevMessages_CompuMethods_EID_Motorm_NominalMotorTorque_Unit "" "Nm" EXTENDED_SI /end UNIT
/begin UNIT Eps_Repository_CommunicationBusAbstractionVW_DevMessages_CompuMethods_EID_Motorm_RequestedMotorTorque_Unit "" "Nm" EXTENDED_SI /end UNIT
/begin UNIT Eps_Repository_CommunicationBusAbstractionVW_DevMessages_CompuMethods_EID_Strom_Bat_Current_Unit "" "A" EXTENDED_SI /end UNIT
/begin UNIT Eps_Repository_CommunicationBusAbstractionVW_DevMessages_CompuMethods_EID_Strom_PhaseCurrentUI_Unit "" "A" EXTENDED_SI /end UNIT
/begin UNIT Eps_Repository_CommunicationBusAbstractionVW_DevMessages_CompuMethods_EID_Strom_PhaseCurrentVI_Unit "" "A" EXTENDED_SI /end UNIT
/begin UNIT Eps_Repository_CommunicationBusAbstractionVW_DevMessages_CompuMethods_EID_Strom_PhaseCurrentWI_Unit "" "A" EXTENDED_SI /end UNIT
/begin UNIT Eps_Repository_CommunicationBusAbstractionVW_DevMessages_CompuMethods_EID_Temp_BoardTemp_Unit "" "?C" EXTENDED_SI /end UNIT
/begin UNIT Eps_Repository_CommunicationBusAbstractionVW_DevMessages_CompuMethods_EID_Temp_CoilTemp_Unit "" "?C" EXTENDED_SI /end UNIT
/begin UNIT Eps_Repository_CommunicationBusAbstractionVW_DevMessages_CompuMethods_EID_Temp_DcLinkCapDeltaTemp_Unit "" "?C" EXTENDED_SI /end UNIT
/begin UNIT Eps_Repository_CommunicationBusAbstractionVW_DevMessages_CompuMethods_EID_Temp_DcLinkCapTemp_Unit "" "?C" EXTENDED_SI /end UNIT
/begin UNIT Eps_Repository_CommunicationBusAbstractionVW_DevMessages_CompuMethods_EID_Temp_GroundPlateTemp_Unit "" "?C" EXTENDED_SI /end UNIT
/begin UNIT Eps_Repository_CommunicationBusAbstractionVW_DevMessages_CompuMethods_EID_Temp_Hwl_TorqueRedLevel_CU_Unit "" "%" EXTENDED_SI /end UNIT
/begin UNIT Eps_Repository_CommunicationBusAbstractionVW_DevMessages_CompuMethods_EID_Temp_Hwl_TorqueRedLevel_Cap_Unit "" "%" EXTENDED_SI /end UNIT
/begin UNIT Eps_Repository_CommunicationBusAbstractionVW_DevMessages_CompuMethods_EID_Temp_Hwl_TorqueRedLevel_Mot_Unit "" "%" EXTENDED_SI /end UNIT
/begin UNIT Eps_Repository_CommunicationBusAbstractionVW_DevMessages_CompuMethods_EID_Temp_Hwl_TorqueRedLevel_Outp_Unit "" "%" EXTENDED_SI /end UNIT
/begin UNIT Eps_Repository_CommunicationBusAbstractionVW_DevMessages_CompuMethods_EID_Temp_Hwl_TrqRedLevel_Board_Unit "" "%" EXTENDED_SI /end UNIT
/begin UNIT Eps_Repository_CommunicationBusAbstractionVW_DevMessages_CompuMethods_EID_Temp_Hwl_TrqRedLevel_FetTemp_Unit "" "%" EXTENDED_SI /end UNIT
/begin UNIT Eps_Repository_CommunicationBusAbstractionVW_DevMessages_CompuMethods_EID_Temp_Outstage_Unit "" "?C" EXTENDED_SI /end UNIT
/begin UNIT Eps_Repository_CommunicationBusAbstractionVW_DevMessages_CompuMethods_EID_Temp_TempCo_U_Unit "" "?C" EXTENDED_SI /end UNIT
/begin UNIT Eps_Repository_CommunicationBusAbstractionVW_DevMessages_CompuMethods_EID_Temp_TempCo_V_Unit "" "?C" EXTENDED_SI /end UNIT
/begin UNIT Eps_Repository_CommunicationBusAbstractionVW_DevMessages_CompuMethods_EID_Temp_TempCo_W_Unit "" "?C" EXTENDED_SI /end UNIT
/begin UNIT Eps_Repository_CommunicationBusAbstractionVW_DevMessages_CompuMethods_EID_Temp_TempHs_U_Unit "" "?C" EXTENDED_SI /end UNIT
/begin UNIT Eps_Repository_CommunicationBusAbstractionVW_DevMessages_CompuMethods_EID_Temp_TempHs_V_Unit "" "?C" EXTENDED_SI /end UNIT
/begin UNIT Eps_Repository_CommunicationBusAbstractionVW_DevMessages_CompuMethods_EID_Temp_TempHs_W_Unit "" "?C" EXTENDED_SI /end UNIT
/begin UNIT Eps_Repository_CommunicationBusAbstractionVW_DevMessages_CompuMethods_EID_Temp_TempLs_U_Unit "" "?C" EXTENDED_SI /end UNIT
/begin UNIT Eps_Repository_CommunicationBusAbstractionVW_DevMessages_CompuMethods_EID_Temp_TempLs_V_Unit "" "?C" EXTENDED_SI /end UNIT
/begin UNIT Eps_Repository_CommunicationBusAbstractionVW_DevMessages_CompuMethods_EID_Temp_TempLs_W_Unit "" "?C" EXTENDED_SI /end UNIT
/begin UNIT Eps_Repository_CommunicationBusAbstractionVW_DevMessages_CompuMethods_EID_Temp_TempRp_Unit "" "?C" EXTENDED_SI /end UNIT
/begin UNIT Eps_Repository_CommunicationBusAbstractionVW_DevMessages_CompuMethods_EID_Temp_UcTemp_Unit "" "?C" EXTENDED_SI /end UNIT
/begin UNIT Eps_Repository_CommunicationBusAbstractionVW_DevMessages_CompuMethods_EID_Testpl_BoardTemp_Unit "" "?C" EXTENDED_SI /end UNIT
/begin UNIT Eps_Repository_CommunicationBusAbstractionVW_DevMessages_CompuMethods_EID_Testpl_motor_torque_setpoint_Unit "" "Nm" EXTENDED_SI /end UNIT
/begin UNIT Eps_Repository_CommunicationBusAbstractionVW_DevMessages_CompuMethods_EID_Testpl_rotor_speed_Unit "" "rpm" EXTENDED_SI /end UNIT
/begin UNIT Eps_Repository_CommunicationBusAbstractionVW_DevMessages_CompuMethods_EID_Testpl_torsionbar_torque_Unit "" "Nm" EXTENDED_SI /end UNIT
/begin UNIT Eps_Repository_CommunicationBusAbstractionVW_DevMessages_CompuMethods_EID_Volt_Act_RedLevel_StateM_Unit "" "NoUnit" EXTENDED_SI /end UNIT
/begin UNIT Eps_Repository_CommunicationBusAbstractionVW_DevMessages_CompuMethods_EID_Volt_Act_RedLevel_Untersp_Unit "" "NoUnit" EXTENDED_SI /end UNIT
/begin UNIT Eps_Repository_CommunicationBusAbstractionVW_DevMessages_CompuMethods_EID_Volt_Hwl_RedLevel_Uebersp_Unit "" "%" EXTENDED_SI /end UNIT
/begin UNIT Eps_Repository_CommunicationBusAbstractionVW_DevMessages_CompuMethods_EID_Volt_Hwl_RedLevel_Untersp_Unit "" "%" EXTENDED_SI /end UNIT
/begin UNIT Eps_Repository_CommunicationBusAbstractionVW_DevMessages_CompuMethods_EID_Volt_SupplyVolt_SupplyVoltag_Unit "" "V" EXTENDED_SI /end UNIT
/begin UNIT Eps_Repository_CommunicationBusAbstractionVW_DevMessages_CompuMethods_EID_intFzGr_AbsVehicleSpeedFilt_Unit "" "km/h" EXTENDED_SI /end UNIT
/begin UNIT Eps_Repository_CommunicationBusAbstractionVW_DevMessages_CompuMethods_EID_intFzGr_EngineSpeed_Unit "" "rpm" EXTENDED_SI /end UNIT
/begin UNIT Eps_Repository_CommunicationBusAbstractionVW_DevMessages_CompuMethods_EPS_Status_Lenkmoment_Unit "" "Nm" EXTENDED_SI /end UNIT
/begin UNIT Eps_Repository_CommunicationBusAbstractionVW_DevMessages_CompuMethods_EPS_Status_PhiRitzel_Unit "" "?" EXTENDED_SI /end UNIT
/begin UNIT Eps_Repository_CommunicationBusAbstractionVW_DevMessages_CompuMethods_EPS_Status_PhvRitzel_Unit "" "?" EXTENDED_SI /end UNIT
/begin UNIT Eps_Repository_CommunicationBusAbstractionVW_DevMessages_CompuMethods_NoUnit "No Unit" "-" EXTENDED_SI SI_EXPONENTS 0 0 0 0 0 0 0 /end UNIT
/begin UNIT Eps_Repository_CommunicationBusAbstractionVW_EpsInput_CompuMethods_AIS_FacStgTqSsty_Unit "" "Unit_PerCent" EXTENDED_SI /end UNIT
/begin UNIT Eps_Repository_CommunicationBusAbstractionVW_EpsInput_CompuMethods_AIS_StgRackPosnFrPlynmCo1_Unit "" "Unit_None" EXTENDED_SI /end UNIT
/begin UNIT Eps_Repository_CommunicationBusAbstractionVW_EpsInput_CompuMethods_AIS_StgRackPosnFrPlynmCo2_Unit "" "Unit_None" EXTENDED_SI /end UNIT
/begin UNIT Eps_Repository_CommunicationBusAbstractionVW_EpsInput_CompuMethods_AIS_StgRackPosnFr_Unit "" "Uniy_MilliMeter" EXTENDED_SI /end UNIT
/begin UNIT Eps_Repository_CommunicationBusAbstractionVW_EpsInput_CompuMethods_AIS_TiIntpPosnCtlFr_Unit "" "Unit_MilliSecon" EXTENDED_SI /end UNIT
/begin UNIT Eps_Repository_CommunicationBusAbstractionVW_EpsInput_CompuMethods_ALR_Ist_Proz_Unit "" "Unit_PerCent" EXTENDED_SI /end UNIT
/begin UNIT Eps_Repository_CommunicationBusAbstractionVW_EpsInput_CompuMethods_ASM_Masterzeit_Unit "" "Unit_Secon" EXTENDED_SI /end UNIT
/begin UNIT Eps_Repository_CommunicationBusAbstractionVW_EpsInput_CompuMethods_AWV_AWA_Anf_Lenkmomoffset_Unit "" "Unit_NewtoMeter" EXTENDED_SI /end UNIT
/begin UNIT Eps_Repository_CommunicationBusAbstractionVW_EpsInput_CompuMethods_AWV_QFK_KrSoll_Unit "" "Unit_MeterInver" EXTENDED_SI /end UNIT
/begin UNIT Eps_Repository_CommunicationBusAbstractionVW_EpsInput_CompuMethods_AWV_QFK_KruemmSoll_Unit "" "Unit_MeterInver" EXTENDED_SI /end UNIT
/begin UNIT Eps_Repository_CommunicationBusAbstractionVW_EpsInput_CompuMethods_AWV_QFK_Spuerb_Unit "" "Unit_PerCent" EXTENDED_SI /end UNIT
/begin UNIT Eps_Repository_CommunicationBusAbstractionVW_EpsInput_CompuMethods_BDM_Spannung_FuSi_Unit "" "Unit_Volt" EXTENDED_SI /end UNIT
/begin UNIT Eps_Repository_CommunicationBusAbstractionVW_EpsInput_CompuMethods_DSR_QFK_KrSoll_Unit "" "Unit_MeterInver" EXTENDED_SI /end UNIT
/begin UNIT Eps_Repository_CommunicationBusAbstractionVW_EpsInput_CompuMethods_DSR_QFK_KruemmSoll_Unit "" "Unit_MeterInver" EXTENDED_SI /end UNIT
/begin UNIT Eps_Repository_CommunicationBusAbstractionVW_EpsInput_CompuMethods_DSR_QFK_Spuerb_Unit "" "Unit_PerCent" EXTENDED_SI /end UNIT
/begin UNIT Eps_Repository_CommunicationBusAbstractionVW_EpsInput_CompuMethods_DTMP_01__QFK_ZPosSoll_Unit "" "Unit_Millimeter" EXTENDED_SI /end UNIT
/begin UNIT Eps_Repository_CommunicationBusAbstractionVW_EpsInput_CompuMethods_DTMS_01_QFK_ZPosSoll_Unit "" "Unit_Millimeter" EXTENDED_SI /end UNIT
/begin UNIT Eps_Repository_CommunicationBusAbstractionVW_EpsInput_CompuMethods_EPS_LdResv_Unit "" "Unit_PerCent" EXTENDED_SI /end UNIT
/begin UNIT Eps_Repository_CommunicationBusAbstractionVW_EpsInput_CompuMethods_ESC_Lenkuebersetzung_x_1_Unit "" "Unit_DegreOfArc" EXTENDED_SI /end UNIT
/begin UNIT Eps_Repository_CommunicationBusAbstractionVW_EpsInput_CompuMethods_ESC_Lenkuebersetzung_x_2_Unit "" "Unit_DegreOfArc" EXTENDED_SI /end UNIT
/begin UNIT Eps_Repository_CommunicationBusAbstractionVW_EpsInput_CompuMethods_ESC_Lenkuebersetzung_x_3_Unit "" "Unit_DegreOfArc" EXTENDED_SI /end UNIT
/begin UNIT Eps_Repository_CommunicationBusAbstractionVW_EpsInput_CompuMethods_ESC_Lenkuebersetzung_x_4_Unit "" "Unit_DegreOfArc" EXTENDED_SI /end UNIT
/begin UNIT Eps_Repository_CommunicationBusAbstractionVW_EpsInput_CompuMethods_ESC_Lenkuebersetzung_x_5_Unit "" "Unit_DegreOfArc" EXTENDED_SI /end UNIT
/begin UNIT Eps_Repository_CommunicationBusAbstractionVW_EpsInput_CompuMethods_ESC_Radstand_Unit "" "Unit_Meter" EXTENDED_SI /end UNIT
/begin UNIT Eps_Repository_CommunicationBusAbstractionVW_EpsInput_CompuMethods_ESP_02_Gierrate_Unit "" "Unit_DegreOfArcPerSecon" EXTENDED_SI /end UNIT
/begin UNIT Eps_Repository_CommunicationBusAbstractionVW_EpsInput_CompuMethods_ESP_02_Laengsbeschl_Unit "" "Unit_MeterPerSeconSquar" EXTENDED_SI /end UNIT
/begin UNIT Eps_Repository_CommunicationBusAbstractionVW_EpsInput_CompuMethods_ESP_02_Querbeschleunigung_Unit "" "Unit_ForceOfGravi" EXTENDED_SI /end UNIT
/begin UNIT Eps_Repository_CommunicationBusAbstractionVW_EpsInput_CompuMethods_ESP_05_Bremsdruck_Unit "" "Unit_Bar" EXTENDED_SI /end UNIT
/begin UNIT Eps_Repository_CommunicationBusAbstractionVW_EpsInput_CompuMethods_ESP_14_Anf_Lenkmomoffset_DSR_Unit "" "Unit_NewtoMeter" EXTENDED_SI /end UNIT
/begin UNIT Eps_Repository_CommunicationBusAbstractionVW_EpsInput_CompuMethods_ESP_19_HL_Radgeschw_02_Unit "" "Unit_KiloMeterPerHour" EXTENDED_SI /end UNIT
/begin UNIT Eps_Repository_CommunicationBusAbstractionVW_EpsInput_CompuMethods_ESP_19_HR_Radgeschw_02_Unit "" "Unit_KiloMeterPerHour" EXTENDED_SI /end UNIT
/begin UNIT Eps_Repository_CommunicationBusAbstractionVW_EpsInput_CompuMethods_ESP_19_VL_Radgeschw_02_Unit "" "Unit_KiloMeterPerHour" EXTENDED_SI /end UNIT
/begin UNIT Eps_Repository_CommunicationBusAbstractionVW_EpsInput_CompuMethods_ESP_19_VR_Radgeschw_02_Unit "" "Unit_KiloMeterPerHour" EXTENDED_SI /end UNIT
/begin UNIT Eps_Repository_CommunicationBusAbstractionVW_EpsInput_CompuMethods_ESP_Bremsdruck_Unit "" "Unit_Bar" EXTENDED_SI /end UNIT
/begin UNIT Eps_Repository_CommunicationBusAbstractionVW_EpsInput_CompuMethods_ESP_Gierrate_Unit "" "Unit_DegreOfArcPerSecon" EXTENDED_SI /end UNIT
/begin UNIT Eps_Repository_CommunicationBusAbstractionVW_EpsInput_CompuMethods_ESP_HL_Radgeschw_02_Unit "" "Unit_KiloMeterPerHour" EXTENDED_SI /end UNIT
/begin UNIT Eps_Repository_CommunicationBusAbstractionVW_EpsInput_CompuMethods_ESP_HR_Radgeschw_02_Unit "" "Unit_KiloMeterPerHour" EXTENDED_SI /end UNIT
/begin UNIT Eps_Repository_CommunicationBusAbstractionVW_EpsInput_CompuMethods_ESP_Laengsbeschl_Unit "" "Unit_MeterPerSeconSquar" EXTENDED_SI /end UNIT
/begin UNIT Eps_Repository_CommunicationBusAbstractionVW_EpsInput_CompuMethods_ESP_Querbeschleunigung_Unit "" "Unit_ForceOfGravi" EXTENDED_SI /end UNIT
/begin UNIT Eps_Repository_CommunicationBusAbstractionVW_EpsInput_CompuMethods_ESP_VL_Radgeschw_02_Unit "" "Unit_KiloMeterPerHour" EXTENDED_SI /end UNIT
/begin UNIT Eps_Repository_CommunicationBusAbstractionVW_EpsInput_CompuMethods_ESP_VR_Radgeschw_02_Unit "" "Unit_KiloMeterPerHour" EXTENDED_SI /end UNIT
/begin UNIT Eps_Repository_CommunicationBusAbstractionVW_EpsInput_CompuMethods_ESP_v_Signal_Unit "" "Unit_KiloMeterPerHour" EXTENDED_SI /end UNIT
/begin UNIT Eps_Repository_CommunicationBusAbstractionVW_EpsInput_CompuMethods_HCA_01_LM_Offset_Unit "" "Unit_NewtoMeter" EXTENDED_SI /end UNIT
/begin UNIT Eps_Repository_CommunicationBusAbstractionVW_EpsInput_CompuMethods_HCA_01_Vib_Amp_Unit "" "Unit_NewtoMeter" EXTENDED_SI /end UNIT
/begin UNIT Eps_Repository_CommunicationBusAbstractionVW_EpsInput_CompuMethods_HCA_01_Vib_Freq_Unit "" "Unit_Hertz" EXTENDED_SI /end UNIT
/begin FUNCTION SecondAutosarComponentHandling ""
 /begin DEF_CHARACTERISTIC fSacHndl_DisableMonitoring_XDU8 fSacHndl_EnableVibration_XDU8 fSacHndl_UseNoOvstForce4DParts_XDU8 fSacHndl_UseOvstForce4DParts_XDU8 fSacHndl_UseVibrationForce4DParts_XDU8 xSacHndl_DPartsFactor_XAU16 xSacHndl_FallingFactGrad4DParts_XDU16 xSacHndl_RisingFactGrad4DParts_XDU16 /end DEF_CHARACTERISTIC
 /begin OUT_MEASUREMENT fSacHndl_CheckVibration_xdu8 fSacHndl_PlausiSacDeactivated_xdu8 kSacHndl_AbsRackForce4DPartsFact_xdu16 kSacHndl_CalcVibrationRackForce_xds16 mSacHndl_MMotOffsetGearSignQHM_xds32 mSacHndl_MMotOffsetGearSignQPR_xds32 mSacHndl_MotorTorqueOffsetQHM_xds32 mSacHndl_MotorTorqueOffsetQPR_xds32 /end OUT_MEASUREMENT
/end FUNCTION
/begin FUNCTION SecondAutosarComponentHandlingInterface ""
 /begin OUT_MEASUREMENT fSacHndlI_SacDeactivated_xdu8 mSCruiseI_MotTrq_xds16 mSacHndlI_YawTorqueRequest_xds16 sSacHndlI_Fas01StateStateQfkPla_xdu8 sSacHndlI_Fas02StateStateQfkAwv_xdu8 sSacHndlI_Fas03StateStateQfkHca_xdu8 sSacHndlI_Fas04StateStateQfkDsr_xdu8 xSacHndlI_ActualRackForce_xds16 xSacHndlI_DPartsFactor_xdu16 /end OUT_MEASUREMENT
/end FUNCTION
/begin FUNCTION SignalConditioning ""
 /begin DEF_CHARACTERISTIC fSigCond_UseTBTBandstop_XDU8 xSigCond_Bandsperre_A2_XDF32 xSigCond_Bandsperre_A3_XDF32 xSigCond_Bandsperre_B2_XDF32 xSigCond_Bandsperre_S1_XDF32 xSigCond_BandstopFact_XAU16 xSigCond_CompTorqueFilterFactor_XAU16 /end DEF_CHARACTERISTIC
 /begin IN_MEASUREMENT vApplI_AbsSteeringAngleSpeed_xdu16 vApplI_AbsVehicleSpeedFilt_xdu16 /end IN_MEASUREMENT
/end FUNCTION
/begin FUNCTION SignalConditioningI "Signal Conditioning"
 /begin OUT_MEASUREMENT mSigCondI_BandPT1TBT_xds16 mSigCondI_BandStopTBT_xds16 mSigCondI_CondTorsionBarTorque_xds16 /end OUT_MEASUREMENT
/end FUNCTION
/begin FUNCTION SmartActuatorVibration "SmartActuatorVibration " /begin IN_MEASUREMENT vApplI_AbsVehicleSpeedFilt_xdu16 /end IN_MEASUREMENT /end FUNCTION
/begin FUNCTION SmtActRackPosCtrlCheckI "SmartActuatorRackposControlCheck - Interface"
 /begin OUT_MEASUREMENT fSmtActrRPCCheckI_ReqdRackPosnMonSafeOK_xdb fSmtActrRPCCheckI_ReqdStateMonSafeOK_xdb fSmtActrRPCCheckI_RotPosArrayMonSafeOK_xdb fSmtActrRPCCheckI_SelQFKMonSafeOK_xdb lEpsInI_SCruiseReqdRackPosn_xds32 sEpsInI_SCruiseReqdState_xdu8 sSmtActrRPCI_EpsSelQFK_xdu8 wSCruiseI_RotPosArrayEmgyTraj_xas16 /end OUT_MEASUREMENT
/end FUNCTION
/begin FUNCTION SmtActRackPosCtrlI "SmartActuatorRackposControl - Interface"
 /begin OUT_MEASUREMENT lSmtActrRPCI_SCruiseReqdRackPosn4Check_xdf32 sSmtActrRPCI_EpsSelQFK4Check_xdu8 sSmtActrRPCI_SCruiseReqdState4Check_xdu8 tEpsInI_SCruiseCmftFadeOutTi_xdu16 wSmtActrRPCI_RotPosArrayEmgyTraj4Check_xas16 /end OUT_MEASUREMENT
/end FUNCTION
/begin FUNCTION SmtActrRackPosCtrl "SmartActuatorRackposControl"
 /begin DEF_CHARACTERISTIC fSmtActrRPC_EnableEmergencyTraject_XDB fSmtActrRPC_EnableXcpActvSw_XDB fSmtActrRPC_XCPSetPolynomParamsInvalid_XDB fSmtActrRPC_XCPSetTargetRackposInvalid_XDB lSmtActrRPC_XCPAisStgRackPosnFr_XDS16 lSmtActrRPC_XCPSmartActPolynomCoeff1_XDS32 lSmtActrRPC_XCPSmartActPolynomCoeff2_XDS32 sSmtActrRPC_XCPAisLvlStgRackPosnFr_XDU8 tSmtActrRPC_CmftFadeOutTiForEmergencyTrajectAndKLA_XDU16 tSmtActrRPC_EmergencyTrajectDuration_XDU16 tSmtActrRPC_EmergencyTrajectFutureOffset_XDS16 tSmtActrRPC_EmgyTrajArrSteps_XDU16 vSmtActrRPC_MaxVehSpeedParkingMode_XDU16 xSmtActrRPC_EmergencyTrajectCorrFact_XAU16 ySmtActrRPC_DeactivateRackposCtrl_XDU8 ySmtActrRPC_EnaDTCsBitmask_XDU8 ySmtActrRPC_SCruiseCnclCndForDTCBitmask_XDU32 /end DEF_CHARACTERISTIC
 /begin IN_MEASUREMENT vApplI_AbsSafeVehicleSpeed_xdu16 /end IN_MEASUREMENT
 /begin OUT_MEASUREMENT tSmtActrRPC_EmergencyTrajectTimer_xdu16 wSmtActrRPC_CenterOffsetComp_xds32 ySmtActrRPC_ErrorReasonBitmask_xdu8 /end OUT_MEASUREMENT
/end FUNCTION
/begin FUNCTION SmtActrRackPosCtrlCheck "SmartActuatorRackposControlCheck"
 /begin OUT_MEASUREMENT lSmtActrRPCCheck_ReqdRackPosnCalc_xdf32 sSmtActrRPCCheck_EpsSelQFKCalc_xdu8 /end OUT_MEASUREMENT
/end FUNCTION
/begin FUNCTION SteeringControlInterpol "Steering Control (interpolate vehicle speed depended characteristic curves)"
 /begin DEF_CHARACTERISTIC mSteerCtrlDFadingV0_XAU16 mSteerCtrlDFadingV1_XAU16 mSteerCtrlDFadingV2_XAU16 mSteerCtrlDFadingV3_XAU16 mSteerCtrlDFadingV4_XAU16 mSteerCtrlDOffsetFadingV0_XAU16 mSteerCtrlDOffsetFadingV1_XAU16 mSteerCtrlDOffsetFadingV2_XAU16 mSteerCtrlDOffsetFadingV3_XAU16 mSteerCtrlDOffsetFadingV4_XAU16 xSteerCtrlDFactAuto_XDU16 xSteerCtrlDFactDyn_XDU16 xSteerCtrlDFactKom_XDU16 xSteerCtrlDOffsetFactAuto_XDU16 xSteerCtrlDOffsetFactDyn_XDU16 xSteerCtrlDOffsetFactKom_XDU16 xSteerCtrlV0DOffsetFactor_XAU16 xSteerCtrlV0DPartFactor_XAU16 xSteerCtrlV1DOffsetFactor_XAU16 xSteerCtrlV1DPartFactor_XAU16 xSteerCtrlV2DOffsetFactor_XAU16 xSteerCtrlV2DPartFactor_XAU16 xSteerCtrlV3DOffsetFactor_XAU16 xSteerCtrlV3DPartFactor_XAU16 zSteerCtrlInterpolCharSelect_XAU16 zSteerCtrlVehSpeedsForDFading_XAU16 zSteerCtrlVehSpeedsForDOffsetFading_XAU16 /end DEF_CHARACTERISTIC
 /begin IN_MEASUREMENT nApplI_AbsRotorSpeedFilt_xdu16 /end IN_MEASUREMENT
 /begin OUT_MEASUREMENT mSteerCtrlAbsAtRawD_xdu16 mSteerCtrlAbsStRawDOffset_xdu16 mSteerCtrlAtRawD_xds32 mSteerCtrlStRawDOffset_xds32 vSteerCtrl_AbsVehicleSpeedFilt4Interpol_xdu16 /end OUT_MEASUREMENT
/end FUNCTION
/begin FUNCTION SteeringControlV2 "SteeringControlV2"
 /begin DEF_CHARACTERISTIC fSteerCtrl_DeactivateDPartAtEndstop_XDU16 fSteerCtrl_NoRotSpDoffLockstop_XDU8 mSteerCtrl_DOffsetDeadband_XDU16 vSteerCtrl_MaxVehSpeedRedDueChatter_XDU16 xSteerCtrl_ChatterReduction_XAU16 xSteerCtrl_DOffsetFactorEndStop_XAU16 xSteerCtrl_SubstDOffsetFactChatter_XDU16 xSteerCtrl_SubstDPartFactChatter_XDU16 zSteerCtrl_ChatteringDetected_XDU8 /end DEF_CHARACTERISTIC
 /begin IN_MEASUREMENT vSteerCtrl_AbsVehicleSpeedFilt4Interpol_xdu16 zcrChatterPeriodsCount_xdu8 /end IN_MEASUREMENT
 /begin OUT_MEASUREMENT mSteerCtrlDFadingXAxis_xau16 mSteerCtrlDFadingYAxis_xau16 mSteerCtrlDOffsetFadingXAxis_xau16 mSteerCtrlDOffsetFadingYAxis_xau16 mSteerCtrl_DOffset_xds16 mSteerCtrl_DPart_xds16 xSteerCtrlDOffsetXAxis_xau16 xSteerCtrlDOffsetYAxis_xau16 xSteerCtrlDPartFactorXAxis_xau16 xSteerCtrlDPartFactorYAxis_xau16 /end OUT_MEASUREMENT
/end FUNCTION
/begin FUNCTION SystemData "Systemdaten" /begin IN_MEASUREMENT wApplI_AbsSteeringAngle_xdu16 /end IN_MEASUREMENT /end FUNCTION
/begin FUNCTION TaskControlSupp_Multicore "TaskControlSupp_Multicore"
 /begin OUT_MEASUREMENT tTaskCtrlSupp_1msGrossExTim_xdu16 tTaskCtrlSupp_HWLibStarttime_xdu16 /end OUT_MEASUREMENT
/end FUNCTION
/begin FUNCTION TorqueCorrectorDamosInterface "Interfaces der Torque used in ROM Kennlinie in the SDK" /begin OUT_MEASUREMENT mApplI_RequestedMotorTorque_xds16 /end OUT_MEASUREMENT /end FUNCTION
/begin FUNCTION TorqueReductionCoordinator "Begrenzung des Maximalmoments"
 /begin DEF_CHARACTERISTIC mtrcMaxTorGradVehicleMoving_XDU16 mtrcMaxTorGradVehicleStanding_XDU16 /end DEF_CHARACTERISTIC
/end FUNCTION
/begin FUNCTION TorqueReductionCoordinatorConf "Konfiguration der TRC Kanï¿½le" /begin OUT_MEASUREMENT xtcActualTorqueRedLevel_xau16 /end OUT_MEASUREMENT /end FUNCTION
/begin FUNCTION TorqueSensorFallback "TorqueSensorFallback - Main" /begin OUT_MEASUREMENT nTsf_AbsRotorSpeed_xdu16 /end OUT_MEASUREMENT /end FUNCTION
/begin FUNCTION TorqueSignalConditioning "Messgroessen und Parameter der TorqueSignalConditioning SDK"
 /begin DEF_CHARACTERISTIC mTsc_DeadZoneExtrapolGrad_XAU16 mTsc_HysteresisTBT_XAU16 tTsc_SystemDelay_us_XDU16 vTsc_SubstituteSpeed_XDU16 xTsc_ExtrapolFactor_XAU16 xTsc_PT1tauGradTBT_XAU16 xTsc_SubstExtrapolFactChatter_XDU16 zTsc_ChatteringDetected_XDU8 /end DEF_CHARACTERISTIC
 /begin IN_MEASUREMENT nApplI_AbsRotorSpeedFilt_xdu16 /end IN_MEASUREMENT
 /begin OUT_MEASUREMENT mTsc_DeadZoneExtrapolGrad_xdu16 tTsc_GradSysT_TBTST_us_xdu16 vTsc_AbsVehicleSpeedFilt4Interpol_xdu16 xTsc_ExtrapolFactor_xdu16 /end OUT_MEASUREMENT
/end FUNCTION
/begin FUNCTION TorqueSignalConditioningI "Interfaces der TorqueSignalConditioning SDK"
 /begin OUT_MEASUREMENT mTscI_ExtrapolTBT_xds16 mTscI_HysteresisTBT_xdu16 tTscI_GradTBTST_xdu16 xTscI_PT1tauGradTBT_xdu16 /end OUT_MEASUREMENT
/end FUNCTION
/begin FUNCTION TorqueSignalConditioningcheck "Messgroessen und Parameter der TorqueSignalConditioning SDK" /begin IN_MEASUREMENT vTsc_AbsVehicleSpeedFilt4Interpol_xdu16 /end IN_MEASUREMENT /end FUNCTION
/begin FUNCTION TorqueSignalConditioningcheckI "Interfaces der TorqueSignalConditioning SDK" /begin OUT_MEASUREMENT mApplI_TorsionBarTorque_xds16 /end OUT_MEASUREMENT /end FUNCTION
/begin FUNCTION TscGrad "Messgroessen und Parameter der TscGrad SDK"
 /begin DEF_CHARACTERISTIC vTsc_VehicleSpeedHysteresis_XDU16 vTsc_VehicleSpeedLimit4LowSample_XDU16 zTsc_TBTDiffDelaySelector_XAU8 /end DEF_CHARACTERISTIC
 /begin OUT_MEASUREMENT mTsc_FiltGradTBT_xds16 mTsc_FiltGradXtplTBT_xds16 mTsc_HystTorsionBarTorque_xds16 mTsc_HystXtplTorsionBarTorque_xds16 /end OUT_MEASUREMENT
/end FUNCTION
/begin FUNCTION TscGradI "Interfaces der TscGrad SDK" /begin OUT_MEASUREMENT mApplI_GradTorsionBarTorque_xds16 /end OUT_MEASUREMENT /end FUNCTION
/begin FUNCTION TscSupp "TscSupp" /begin DEF_CHARACTERISTIC fTsc_Use_GradXtplTBT_XDU8 /end DEF_CHARACTERISTIC /end FUNCTION
/begin FUNCTION TscSuppI "TscSupp - interface" /begin OUT_MEASUREMENT fTscI_Use_GradXtplTBT_xdb mTscI_TorsionBarTorque_xds16 /end OUT_MEASUREMENT /end FUNCTION
/begin FUNCTION VehSp_CheckI "Check the vehicle speeds - interface" /begin OUT_MEASUREMENT vVehSpI_AbsMaxSafeVehSpd_xdu16 /end OUT_MEASUREMENT /end FUNCTION
/begin FUNCTION WarningLightCalculation "Warning Light Calculation" /begin OUT_MEASUREMENT xWlcI_ReductionLevel_xdu16 /end OUT_MEASUREMENT /end FUNCTION
/begin FUNCTION WarningLightCalculation_Asymmetric "Warning Light Calculation" /begin DEF_CHARACTERISTIC fWlc_DevWarningsActive_XDU8 /end DEF_CHARACTERISTIC /end FUNCTION
/begin RECORD_LAYOUT AblGLKFuw AXIS_PTS_X 1 UWORD INDEX_INCR DIRECT AXIS_PTS_Y 2 UWORD INDEX_INCR DIRECT FNC_VALUES 3 UWORD COLUMN_DIR DIRECT /end RECORD_LAYOUT
/begin RECORD_LAYOUT AblGLKLuw NO_AXIS_PTS_X 1 UWORD AXIS_PTS_X 2 UWORD INDEX_INCR DIRECT FNC_VALUES 3 UWORD COLUMN_DIR DIRECT /end RECORD_LAYOUT
/begin RECORD_LAYOUT AblGLKWBub FNC_VALUES 1 UBYTE COLUMN_DIR DIRECT /end RECORD_LAYOUT
/begin RECORD_LAYOUT AblGLKWBuw FNC_VALUES 1 UWORD COLUMN_DIR DIRECT /end RECORD_LAYOUT
/begin RECORD_LAYOUT AblGLKWfl4 FNC_VALUES 1 FLOAT32_IEEE COLUMN_DIR DIRECT /end RECORD_LAYOUT
/begin RECORD_LAYOUT AblGLKWsl FNC_VALUES 1 SLONG COLUMN_DIR DIRECT /end RECORD_LAYOUT
/begin RECORD_LAYOUT AblGLKWsw FNC_VALUES 1 SWORD COLUMN_DIR DIRECT /end RECORD_LAYOUT
/begin RECORD_LAYOUT AblGLKWub FNC_VALUES 1 UBYTE COLUMN_DIR DIRECT /end RECORD_LAYOUT
/begin RECORD_LAYOUT AblGLKWul FNC_VALUES 1 ULONG COLUMN_DIR DIRECT /end RECORD_LAYOUT
/begin RECORD_LAYOUT AblGLKWuw FNC_VALUES 1 UWORD COLUMN_DIR DIRECT /end RECORD_LAYOUT
/begin RECORD_LAYOUT AblGLSstuw AXIS_PTS_X 1 UWORD INDEX_INCR DIRECT /end RECORD_LAYOUT
/begin RECORD_LAYOUT __UWORD_S FNC_VALUES 1 UWORD COLUMN_DIR DIRECT /end RECORD_LAYOUT
/begin RECORD_LAYOUT rlValuesw FNC_VALUES 1 SWORD COLUMN_DIR DIRECT /end RECORD_LAYOUT
/begin COMPU_VTAB ECU_STATE "" TAB_VERB 9 0 "undefined" 1 "EcuInit" 2 "ApplicationInit" 3 "Normal" 4 "Production" 5 "FailOp" 6 "PostRun" 7 "Error" 8 "ApplicationOff" /end COMPU_VTAB
/begin COMPU_VTAB SCRUISE_RACK_SPEED_LIM "" TAB_VERB 6 0 "SFC" 1 "HandsOn" 2 "Prkg" 3 "HandsFree" 4 "HandsOnInc" 5 "ESSactive" DEFAULT_VALUE "undefined" /end COMPU_VTAB
/begin COMPU_VTAB STEERING_CHAR_STATE "" TAB_VERB 6 0 "undefined" 1 "0x00 selection via the Charisma coordinator" 2 "0x01 comfort (soft identifier)" 4 "0x02 auto (normal identifier)" 8 "0x03 dynamics (tight identifier)" 16 "0x04 ROM characteristic curve" DEFAULT_VALUE "undefined" /end COMPU_VTAB
/end MODULE
/end PROJECT
